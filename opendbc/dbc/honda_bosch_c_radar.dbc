VERSION "Honda Bosch C radar objects; receive-only; generated by bosch-c-research scripts/make_candidate_dbc.py"
NS_ :

BS_:
BU_: UNKNOWN LOGGER

BO_ 114 BOSCH_C_OBJECT_08: 64 UNKNOWN
 SG_ CRC16_RAW : 0|16@1+ (1,0) [0|65535] "" LOGGER
 SG_ FRAME_COUNTER_RAW : 16|8@1+ (1,0) [0|255] "" LOGGER
 SG_ FRAME_PHASE_RAW : 24|4@1+ (1,0) [0|15] "" LOGGER
 SG_ OBJECT_ID_RAW : 32|16@1+ (1,0) [0|65535] "" LOGGER
 SG_ POSITION_X_RAW : 48|12@1+ (1,0) [0|4095] "" LOGGER
 SG_ OBJECT_CLASS_RAW : 60|4@1+ (1,0) [0|15] "" LOGGER
 SG_ POSITION_Y_RAW : 64|13@1+ (1,0) [0|8191] "" LOGGER
 SG_ Y_COMPANION_RAW : 77|3@1+ (1,0) [0|7] "" LOGGER
 SG_ VELOCITY_RAW : 80|11@1+ (1,0) [0|2047] "" LOGGER
 SG_ LATERAL_VELOCITY_CANDIDATE_RAW : 96|10@1+ (1,0) [0|1023] "" LOGGER
 SG_ NORMALIZED_RATE_CANDIDATE_RAW : 128|16@1+ (1,0) [0|65535] "" LOGGER
 SG_ QUALITY_CONTAINER_RAW : 144|16@1+ (1,0) [0|65535] "" LOGGER
 SG_ LIFECYCLE_RAW : 271|12@1+ (1,0) [0|4095] "" LOGGER
 SG_ UNCERTAINTY_160_CANDIDATE_RAW : 160|8@1+ (1,0) [0|255] "" LOGGER
 SG_ REL_VELOCITY_UNCERTAINTY_RAW : 176|10@1+ (1,0) [0|1023] "" LOGGER
 SG_ ACQUISITION_186_CANDIDATE_RAW : 186|5@1+ (1,0) [0|31] "" LOGGER
 SG_ UNCERTAINTY_192_CANDIDATE_RAW : 192|8@1+ (1,0) [0|255] "" LOGGER
 SG_ TTC_RAW : 201|11@1+ (1,0) [0|2047] "" LOGGER
 SG_ TTC_SIGMA_CANDIDATE_RAW : 240|7@1+ (1,0) [0|127] "" LOGGER
 SG_ WIDTH_FINE_258_CANDIDATE_RAW : 258|6@1+ (1,0) [0|63] "" LOGGER
 SG_ NORMALIZED_CLOSING_SIGMA_RAW : 288|9@1+ (1,0) [0|511] "" LOGGER
 SG_ AUX_LATERAL_MOTION_304_CANDIDATE_RAW : 304|16@1+ (1,0) [0|65535] "" LOGGER
 SG_ AUX_LATERAL_DIRECTION_320_CANDIDATE_RAW : 320|1@1+ (1,0) [0|1] "" LOGGER
 SG_ AUX_328_CANDIDATE_RAW : 328|13@1+ (1,0) [0|8191] "" LOGGER
 SG_ AUX2_378_CANDIDATE_RAW : 378|13@1+ (1,0) [0|8191] "" LOGGER
 SG_ MATURITY_398_CANDIDATE_RAW : 398|4@1+ (1,0) [0|15] "" LOGGER
 SG_ AZIMUTH_CENTER_RAW : 411|13@1+ (1,0) [0|8191] "" LOGGER
 SG_ AZIMUTH_EDGE_A_RAW : 424|13@1+ (1,0) [0|8191] "" LOGGER
 SG_ AZIMUTH_EDGE_B_RAW : 440|13@1+ (1,0) [0|8191] "" LOGGER
 SG_ MOTION_CLASS_CANDIDATE_RAW : 464|4@1+ (1,0) [0|15] "" LOGGER
 SG_ ANGULAR_WIDTH_COARSE_CANDIDATE_RAW : 472|8@1+ (1,0) [0|255] "" LOGGER
 SG_ ANGULAR_WIDTH_COARSE_COPY_CANDIDATE_RAW : 488|8@1+ (1,0) [0|255] "" LOGGER
 SG_ FLAG_106_CANDIDATE_RAW : 106|1@1+ (1,0) [0|1] "" LOGGER
 SG_ FLAG_107_CANDIDATE_RAW : 107|1@1+ (1,0) [0|1] "" LOGGER
 SG_ ENUM_109_CANDIDATE_RAW : 109|3@1+ (1,0) [0|7] "" LOGGER
 SG_ EXISTENCE_PROBABILITY_RAW : 121|6@1+ (1,0) [0|63] "" LOGGER
 SG_ ANGULAR_WIDTH_480_RAW : 480|8@1+ (1,0) [0|255] "" LOGGER
 SG_ DREL : 48|12@1+ (0.05,-4.296) [-4.296|200.454] "m" LOGGER
 SG_ YREL : 64|14@1+ (0.01,-81.92) [-81.92|81.91] "m" LOGGER
 SG_ VREL : 80|11@1+ (0.1,-153.9) [-153.9|50.8] "m/s" LOGGER
 SG_ AZIMUTH_CENTER : 411|13@1+ (0.000244140625,-1) [-1|0.999755859375] "rad" LOGGER
 SG_ AZIMUTH_EDGE_A : 424|13@1+ (0.000244140625,-1) [-1|0.999755859375] "rad" LOGGER
 SG_ AZIMUTH_EDGE_B : 440|13@1+ (0.000244140625,-1) [-1|0.999755859375] "rad" LOGGER
 SG_ TTC : 201|11@1+ (0.0078125,-8) [-8|7.9921875] "s" LOGGER

BO_ 116 BOSCH_C_OBJECT_09: 64 UNKNOWN
 SG_ CRC16_RAW : 0|16@1+ (1,0) [0|65535] "" LOGGER
 SG_ FRAME_COUNTER_RAW : 16|8@1+ (1,0) [0|255] "" LOGGER
 SG_ FRAME_PHASE_RAW : 24|4@1+ (1,0) [0|15] "" LOGGER
 SG_ OBJECT_ID_RAW : 32|16@1+ (1,0) [0|65535] "" LOGGER
 SG_ POSITION_X_RAW : 48|12@1+ (1,0) [0|4095] "" LOGGER
 SG_ OBJECT_CLASS_RAW : 60|4@1+ (1,0) [0|15] "" LOGGER
 SG_ POSITION_Y_RAW : 64|13@1+ (1,0) [0|8191] "" LOGGER
 SG_ Y_COMPANION_RAW : 77|3@1+ (1,0) [0|7] "" LOGGER
 SG_ VELOCITY_RAW : 80|11@1+ (1,0) [0|2047] "" LOGGER
 SG_ LATERAL_VELOCITY_CANDIDATE_RAW : 96|10@1+ (1,0) [0|1023] "" LOGGER
 SG_ NORMALIZED_RATE_CANDIDATE_RAW : 128|16@1+ (1,0) [0|65535] "" LOGGER
 SG_ QUALITY_CONTAINER_RAW : 144|16@1+ (1,0) [0|65535] "" LOGGER
 SG_ LIFECYCLE_RAW : 271|12@1+ (1,0) [0|4095] "" LOGGER
 SG_ UNCERTAINTY_160_CANDIDATE_RAW : 160|8@1+ (1,0) [0|255] "" LOGGER
 SG_ REL_VELOCITY_UNCERTAINTY_RAW : 176|10@1+ (1,0) [0|1023] "" LOGGER
 SG_ ACQUISITION_186_CANDIDATE_RAW : 186|5@1+ (1,0) [0|31] "" LOGGER
 SG_ UNCERTAINTY_192_CANDIDATE_RAW : 192|8@1+ (1,0) [0|255] "" LOGGER
 SG_ TTC_RAW : 201|11@1+ (1,0) [0|2047] "" LOGGER
 SG_ TTC_SIGMA_CANDIDATE_RAW : 240|7@1+ (1,0) [0|127] "" LOGGER
 SG_ WIDTH_FINE_258_CANDIDATE_RAW : 258|6@1+ (1,0) [0|63] "" LOGGER
 SG_ NORMALIZED_CLOSING_SIGMA_RAW : 288|9@1+ (1,0) [0|511] "" LOGGER
 SG_ AUX_LATERAL_MOTION_304_CANDIDATE_RAW : 304|16@1+ (1,0) [0|65535] "" LOGGER
 SG_ AUX_LATERAL_DIRECTION_320_CANDIDATE_RAW : 320|1@1+ (1,0) [0|1] "" LOGGER
 SG_ AUX_328_CANDIDATE_RAW : 328|13@1+ (1,0) [0|8191] "" LOGGER
 SG_ AUX2_378_CANDIDATE_RAW : 378|13@1+ (1,0) [0|8191] "" LOGGER
 SG_ MATURITY_398_CANDIDATE_RAW : 398|4@1+ (1,0) [0|15] "" LOGGER
 SG_ AZIMUTH_CENTER_RAW : 411|13@1+ (1,0) [0|8191] "" LOGGER
 SG_ AZIMUTH_EDGE_A_RAW : 424|13@1+ (1,0) [0|8191] "" LOGGER
 SG_ AZIMUTH_EDGE_B_RAW : 440|13@1+ (1,0) [0|8191] "" LOGGER
 SG_ MOTION_CLASS_CANDIDATE_RAW : 464|4@1+ (1,0) [0|15] "" LOGGER
 SG_ ANGULAR_WIDTH_COARSE_CANDIDATE_RAW : 472|8@1+ (1,0) [0|255] "" LOGGER
 SG_ ANGULAR_WIDTH_COARSE_COPY_CANDIDATE_RAW : 488|8@1+ (1,0) [0|255] "" LOGGER
 SG_ FLAG_106_CANDIDATE_RAW : 106|1@1+ (1,0) [0|1] "" LOGGER
 SG_ FLAG_107_CANDIDATE_RAW : 107|1@1+ (1,0) [0|1] "" LOGGER
 SG_ ENUM_109_CANDIDATE_RAW : 109|3@1+ (1,0) [0|7] "" LOGGER
 SG_ EXISTENCE_PROBABILITY_RAW : 121|6@1+ (1,0) [0|63] "" LOGGER
 SG_ ANGULAR_WIDTH_480_RAW : 480|8@1+ (1,0) [0|255] "" LOGGER
 SG_ DREL : 48|12@1+ (0.05,-4.296) [-4.296|200.454] "m" LOGGER
 SG_ YREL : 64|14@1+ (0.01,-81.92) [-81.92|81.91] "m" LOGGER
 SG_ VREL : 80|11@1+ (0.1,-153.9) [-153.9|50.8] "m/s" LOGGER
 SG_ AZIMUTH_CENTER : 411|13@1+ (0.000244140625,-1) [-1|0.999755859375] "rad" LOGGER
 SG_ AZIMUTH_EDGE_A : 424|13@1+ (0.000244140625,-1) [-1|0.999755859375] "rad" LOGGER
 SG_ AZIMUTH_EDGE_B : 440|13@1+ (0.000244140625,-1) [-1|0.999755859375] "rad" LOGGER
 SG_ TTC : 201|11@1+ (0.0078125,-8) [-8|7.9921875] "s" LOGGER

BO_ 118 BOSCH_C_OBJECT_10: 64 UNKNOWN
 SG_ CRC16_RAW : 0|16@1+ (1,0) [0|65535] "" LOGGER
 SG_ FRAME_COUNTER_RAW : 16|8@1+ (1,0) [0|255] "" LOGGER
 SG_ FRAME_PHASE_RAW : 24|4@1+ (1,0) [0|15] "" LOGGER
 SG_ OBJECT_ID_RAW : 32|16@1+ (1,0) [0|65535] "" LOGGER
 SG_ POSITION_X_RAW : 48|12@1+ (1,0) [0|4095] "" LOGGER
 SG_ OBJECT_CLASS_RAW : 60|4@1+ (1,0) [0|15] "" LOGGER
 SG_ POSITION_Y_RAW : 64|13@1+ (1,0) [0|8191] "" LOGGER
 SG_ Y_COMPANION_RAW : 77|3@1+ (1,0) [0|7] "" LOGGER
 SG_ VELOCITY_RAW : 80|11@1+ (1,0) [0|2047] "" LOGGER
 SG_ LATERAL_VELOCITY_CANDIDATE_RAW : 96|10@1+ (1,0) [0|1023] "" LOGGER
 SG_ NORMALIZED_RATE_CANDIDATE_RAW : 128|16@1+ (1,0) [0|65535] "" LOGGER
 SG_ QUALITY_CONTAINER_RAW : 144|16@1+ (1,0) [0|65535] "" LOGGER
 SG_ LIFECYCLE_RAW : 271|12@1+ (1,0) [0|4095] "" LOGGER
 SG_ UNCERTAINTY_160_CANDIDATE_RAW : 160|8@1+ (1,0) [0|255] "" LOGGER
 SG_ REL_VELOCITY_UNCERTAINTY_RAW : 176|10@1+ (1,0) [0|1023] "" LOGGER
 SG_ ACQUISITION_186_CANDIDATE_RAW : 186|5@1+ (1,0) [0|31] "" LOGGER
 SG_ UNCERTAINTY_192_CANDIDATE_RAW : 192|8@1+ (1,0) [0|255] "" LOGGER
 SG_ TTC_RAW : 201|11@1+ (1,0) [0|2047] "" LOGGER
 SG_ TTC_SIGMA_CANDIDATE_RAW : 240|7@1+ (1,0) [0|127] "" LOGGER
 SG_ WIDTH_FINE_258_CANDIDATE_RAW : 258|6@1+ (1,0) [0|63] "" LOGGER
 SG_ NORMALIZED_CLOSING_SIGMA_RAW : 288|9@1+ (1,0) [0|511] "" LOGGER
 SG_ AUX_LATERAL_MOTION_304_CANDIDATE_RAW : 304|16@1+ (1,0) [0|65535] "" LOGGER
 SG_ AUX_LATERAL_DIRECTION_320_CANDIDATE_RAW : 320|1@1+ (1,0) [0|1] "" LOGGER
 SG_ AUX_328_CANDIDATE_RAW : 328|13@1+ (1,0) [0|8191] "" LOGGER
 SG_ AUX2_378_CANDIDATE_RAW : 378|13@1+ (1,0) [0|8191] "" LOGGER
 SG_ MATURITY_398_CANDIDATE_RAW : 398|4@1+ (1,0) [0|15] "" LOGGER
 SG_ AZIMUTH_CENTER_RAW : 411|13@1+ (1,0) [0|8191] "" LOGGER
 SG_ AZIMUTH_EDGE_A_RAW : 424|13@1+ (1,0) [0|8191] "" LOGGER
 SG_ AZIMUTH_EDGE_B_RAW : 440|13@1+ (1,0) [0|8191] "" LOGGER
 SG_ MOTION_CLASS_CANDIDATE_RAW : 464|4@1+ (1,0) [0|15] "" LOGGER
 SG_ ANGULAR_WIDTH_COARSE_CANDIDATE_RAW : 472|8@1+ (1,0) [0|255] "" LOGGER
 SG_ ANGULAR_WIDTH_COARSE_COPY_CANDIDATE_RAW : 488|8@1+ (1,0) [0|255] "" LOGGER
 SG_ FLAG_106_CANDIDATE_RAW : 106|1@1+ (1,0) [0|1] "" LOGGER
 SG_ FLAG_107_CANDIDATE_RAW : 107|1@1+ (1,0) [0|1] "" LOGGER
 SG_ ENUM_109_CANDIDATE_RAW : 109|3@1+ (1,0) [0|7] "" LOGGER
 SG_ EXISTENCE_PROBABILITY_RAW : 121|6@1+ (1,0) [0|63] "" LOGGER
 SG_ ANGULAR_WIDTH_480_RAW : 480|8@1+ (1,0) [0|255] "" LOGGER
 SG_ DREL : 48|12@1+ (0.05,-4.296) [-4.296|200.454] "m" LOGGER
 SG_ YREL : 64|14@1+ (0.01,-81.92) [-81.92|81.91] "m" LOGGER
 SG_ VREL : 80|11@1+ (0.1,-153.9) [-153.9|50.8] "m/s" LOGGER
 SG_ AZIMUTH_CENTER : 411|13@1+ (0.000244140625,-1) [-1|0.999755859375] "rad" LOGGER
 SG_ AZIMUTH_EDGE_A : 424|13@1+ (0.000244140625,-1) [-1|0.999755859375] "rad" LOGGER
 SG_ AZIMUTH_EDGE_B : 440|13@1+ (0.000244140625,-1) [-1|0.999755859375] "rad" LOGGER
 SG_ TTC : 201|11@1+ (0.0078125,-8) [-8|7.9921875] "s" LOGGER

BO_ 120 BOSCH_C_OBJECT_11: 64 UNKNOWN
 SG_ CRC16_RAW : 0|16@1+ (1,0) [0|65535] "" LOGGER
 SG_ FRAME_COUNTER_RAW : 16|8@1+ (1,0) [0|255] "" LOGGER
 SG_ FRAME_PHASE_RAW : 24|4@1+ (1,0) [0|15] "" LOGGER
 SG_ OBJECT_ID_RAW : 32|16@1+ (1,0) [0|65535] "" LOGGER
 SG_ POSITION_X_RAW : 48|12@1+ (1,0) [0|4095] "" LOGGER
 SG_ OBJECT_CLASS_RAW : 60|4@1+ (1,0) [0|15] "" LOGGER
 SG_ POSITION_Y_RAW : 64|13@1+ (1,0) [0|8191] "" LOGGER
 SG_ Y_COMPANION_RAW : 77|3@1+ (1,0) [0|7] "" LOGGER
 SG_ VELOCITY_RAW : 80|11@1+ (1,0) [0|2047] "" LOGGER
 SG_ LATERAL_VELOCITY_CANDIDATE_RAW : 96|10@1+ (1,0) [0|1023] "" LOGGER
 SG_ NORMALIZED_RATE_CANDIDATE_RAW : 128|16@1+ (1,0) [0|65535] "" LOGGER
 SG_ QUALITY_CONTAINER_RAW : 144|16@1+ (1,0) [0|65535] "" LOGGER
 SG_ LIFECYCLE_RAW : 271|12@1+ (1,0) [0|4095] "" LOGGER
 SG_ UNCERTAINTY_160_CANDIDATE_RAW : 160|8@1+ (1,0) [0|255] "" LOGGER
 SG_ REL_VELOCITY_UNCERTAINTY_RAW : 176|10@1+ (1,0) [0|1023] "" LOGGER
 SG_ ACQUISITION_186_CANDIDATE_RAW : 186|5@1+ (1,0) [0|31] "" LOGGER
 SG_ UNCERTAINTY_192_CANDIDATE_RAW : 192|8@1+ (1,0) [0|255] "" LOGGER
 SG_ TTC_RAW : 201|11@1+ (1,0) [0|2047] "" LOGGER
 SG_ TTC_SIGMA_CANDIDATE_RAW : 240|7@1+ (1,0) [0|127] "" LOGGER
 SG_ WIDTH_FINE_258_CANDIDATE_RAW : 258|6@1+ (1,0) [0|63] "" LOGGER
 SG_ NORMALIZED_CLOSING_SIGMA_RAW : 288|9@1+ (1,0) [0|511] "" LOGGER
 SG_ AUX_LATERAL_MOTION_304_CANDIDATE_RAW : 304|16@1+ (1,0) [0|65535] "" LOGGER
 SG_ AUX_LATERAL_DIRECTION_320_CANDIDATE_RAW : 320|1@1+ (1,0) [0|1] "" LOGGER
 SG_ AUX_328_CANDIDATE_RAW : 328|13@1+ (1,0) [0|8191] "" LOGGER
 SG_ AUX2_378_CANDIDATE_RAW : 378|13@1+ (1,0) [0|8191] "" LOGGER
 SG_ MATURITY_398_CANDIDATE_RAW : 398|4@1+ (1,0) [0|15] "" LOGGER
 SG_ AZIMUTH_CENTER_RAW : 411|13@1+ (1,0) [0|8191] "" LOGGER
 SG_ AZIMUTH_EDGE_A_RAW : 424|13@1+ (1,0) [0|8191] "" LOGGER
 SG_ AZIMUTH_EDGE_B_RAW : 440|13@1+ (1,0) [0|8191] "" LOGGER
 SG_ MOTION_CLASS_CANDIDATE_RAW : 464|4@1+ (1,0) [0|15] "" LOGGER
 SG_ ANGULAR_WIDTH_COARSE_CANDIDATE_RAW : 472|8@1+ (1,0) [0|255] "" LOGGER
 SG_ ANGULAR_WIDTH_COARSE_COPY_CANDIDATE_RAW : 488|8@1+ (1,0) [0|255] "" LOGGER
 SG_ FLAG_106_CANDIDATE_RAW : 106|1@1+ (1,0) [0|1] "" LOGGER
 SG_ FLAG_107_CANDIDATE_RAW : 107|1@1+ (1,0) [0|1] "" LOGGER
 SG_ ENUM_109_CANDIDATE_RAW : 109|3@1+ (1,0) [0|7] "" LOGGER
 SG_ EXISTENCE_PROBABILITY_RAW : 121|6@1+ (1,0) [0|63] "" LOGGER
 SG_ ANGULAR_WIDTH_480_RAW : 480|8@1+ (1,0) [0|255] "" LOGGER
 SG_ DREL : 48|12@1+ (0.05,-4.296) [-4.296|200.454] "m" LOGGER
 SG_ YREL : 64|14@1+ (0.01,-81.92) [-81.92|81.91] "m" LOGGER
 SG_ VREL : 80|11@1+ (0.1,-153.9) [-153.9|50.8] "m/s" LOGGER
 SG_ AZIMUTH_CENTER : 411|13@1+ (0.000244140625,-1) [-1|0.999755859375] "rad" LOGGER
 SG_ AZIMUTH_EDGE_A : 424|13@1+ (0.000244140625,-1) [-1|0.999755859375] "rad" LOGGER
 SG_ AZIMUTH_EDGE_B : 440|13@1+ (0.000244140625,-1) [-1|0.999755859375] "rad" LOGGER
 SG_ TTC : 201|11@1+ (0.0078125,-8) [-8|7.9921875] "s" LOGGER

BO_ 122 BOSCH_C_OBJECT_12: 64 UNKNOWN
 SG_ CRC16_RAW : 0|16@1+ (1,0) [0|65535] "" LOGGER
 SG_ FRAME_COUNTER_RAW : 16|8@1+ (1,0) [0|255] "" LOGGER
 SG_ FRAME_PHASE_RAW : 24|4@1+ (1,0) [0|15] "" LOGGER
 SG_ OBJECT_ID_RAW : 32|16@1+ (1,0) [0|65535] "" LOGGER
 SG_ POSITION_X_RAW : 48|12@1+ (1,0) [0|4095] "" LOGGER
 SG_ OBJECT_CLASS_RAW : 60|4@1+ (1,0) [0|15] "" LOGGER
 SG_ POSITION_Y_RAW : 64|13@1+ (1,0) [0|8191] "" LOGGER
 SG_ Y_COMPANION_RAW : 77|3@1+ (1,0) [0|7] "" LOGGER
 SG_ VELOCITY_RAW : 80|11@1+ (1,0) [0|2047] "" LOGGER
 SG_ LATERAL_VELOCITY_CANDIDATE_RAW : 96|10@1+ (1,0) [0|1023] "" LOGGER
 SG_ NORMALIZED_RATE_CANDIDATE_RAW : 128|16@1+ (1,0) [0|65535] "" LOGGER
 SG_ QUALITY_CONTAINER_RAW : 144|16@1+ (1,0) [0|65535] "" LOGGER
 SG_ LIFECYCLE_RAW : 271|12@1+ (1,0) [0|4095] "" LOGGER
 SG_ UNCERTAINTY_160_CANDIDATE_RAW : 160|8@1+ (1,0) [0|255] "" LOGGER
 SG_ REL_VELOCITY_UNCERTAINTY_RAW : 176|10@1+ (1,0) [0|1023] "" LOGGER
 SG_ ACQUISITION_186_CANDIDATE_RAW : 186|5@1+ (1,0) [0|31] "" LOGGER
 SG_ UNCERTAINTY_192_CANDIDATE_RAW : 192|8@1+ (1,0) [0|255] "" LOGGER
 SG_ TTC_RAW : 201|11@1+ (1,0) [0|2047] "" LOGGER
 SG_ TTC_SIGMA_CANDIDATE_RAW : 240|7@1+ (1,0) [0|127] "" LOGGER
 SG_ WIDTH_FINE_258_CANDIDATE_RAW : 258|6@1+ (1,0) [0|63] "" LOGGER
 SG_ NORMALIZED_CLOSING_SIGMA_RAW : 288|9@1+ (1,0) [0|511] "" LOGGER
 SG_ AUX_LATERAL_MOTION_304_CANDIDATE_RAW : 304|16@1+ (1,0) [0|65535] "" LOGGER
 SG_ AUX_LATERAL_DIRECTION_320_CANDIDATE_RAW : 320|1@1+ (1,0) [0|1] "" LOGGER
 SG_ AUX_328_CANDIDATE_RAW : 328|13@1+ (1,0) [0|8191] "" LOGGER
 SG_ AUX2_378_CANDIDATE_RAW : 378|13@1+ (1,0) [0|8191] "" LOGGER
 SG_ MATURITY_398_CANDIDATE_RAW : 398|4@1+ (1,0) [0|15] "" LOGGER
 SG_ AZIMUTH_CENTER_RAW : 411|13@1+ (1,0) [0|8191] "" LOGGER
 SG_ AZIMUTH_EDGE_A_RAW : 424|13@1+ (1,0) [0|8191] "" LOGGER
 SG_ AZIMUTH_EDGE_B_RAW : 440|13@1+ (1,0) [0|8191] "" LOGGER
 SG_ MOTION_CLASS_CANDIDATE_RAW : 464|4@1+ (1,0) [0|15] "" LOGGER
 SG_ ANGULAR_WIDTH_COARSE_CANDIDATE_RAW : 472|8@1+ (1,0) [0|255] "" LOGGER
 SG_ ANGULAR_WIDTH_COARSE_COPY_CANDIDATE_RAW : 488|8@1+ (1,0) [0|255] "" LOGGER
 SG_ FLAG_106_CANDIDATE_RAW : 106|1@1+ (1,0) [0|1] "" LOGGER
 SG_ FLAG_107_CANDIDATE_RAW : 107|1@1+ (1,0) [0|1] "" LOGGER
 SG_ ENUM_109_CANDIDATE_RAW : 109|3@1+ (1,0) [0|7] "" LOGGER
 SG_ EXISTENCE_PROBABILITY_RAW : 121|6@1+ (1,0) [0|63] "" LOGGER
 SG_ ANGULAR_WIDTH_480_RAW : 480|8@1+ (1,0) [0|255] "" LOGGER
 SG_ DREL : 48|12@1+ (0.05,-4.296) [-4.296|200.454] "m" LOGGER
 SG_ YREL : 64|14@1+ (0.01,-81.92) [-81.92|81.91] "m" LOGGER
 SG_ VREL : 80|11@1+ (0.1,-153.9) [-153.9|50.8] "m/s" LOGGER
 SG_ AZIMUTH_CENTER : 411|13@1+ (0.000244140625,-1) [-1|0.999755859375] "rad" LOGGER
 SG_ AZIMUTH_EDGE_A : 424|13@1+ (0.000244140625,-1) [-1|0.999755859375] "rad" LOGGER
 SG_ AZIMUTH_EDGE_B : 440|13@1+ (0.000244140625,-1) [-1|0.999755859375] "rad" LOGGER
 SG_ TTC : 201|11@1+ (0.0078125,-8) [-8|7.9921875] "s" LOGGER

BO_ 124 BOSCH_C_OBJECT_13: 64 UNKNOWN
 SG_ CRC16_RAW : 0|16@1+ (1,0) [0|65535] "" LOGGER
 SG_ FRAME_COUNTER_RAW : 16|8@1+ (1,0) [0|255] "" LOGGER
 SG_ FRAME_PHASE_RAW : 24|4@1+ (1,0) [0|15] "" LOGGER
 SG_ OBJECT_ID_RAW : 32|16@1+ (1,0) [0|65535] "" LOGGER
 SG_ POSITION_X_RAW : 48|12@1+ (1,0) [0|4095] "" LOGGER
 SG_ OBJECT_CLASS_RAW : 60|4@1+ (1,0) [0|15] "" LOGGER
 SG_ POSITION_Y_RAW : 64|13@1+ (1,0) [0|8191] "" LOGGER
 SG_ Y_COMPANION_RAW : 77|3@1+ (1,0) [0|7] "" LOGGER
 SG_ VELOCITY_RAW : 80|11@1+ (1,0) [0|2047] "" LOGGER
 SG_ LATERAL_VELOCITY_CANDIDATE_RAW : 96|10@1+ (1,0) [0|1023] "" LOGGER
 SG_ NORMALIZED_RATE_CANDIDATE_RAW : 128|16@1+ (1,0) [0|65535] "" LOGGER
 SG_ QUALITY_CONTAINER_RAW : 144|16@1+ (1,0) [0|65535] "" LOGGER
 SG_ LIFECYCLE_RAW : 271|12@1+ (1,0) [0|4095] "" LOGGER
 SG_ UNCERTAINTY_160_CANDIDATE_RAW : 160|8@1+ (1,0) [0|255] "" LOGGER
 SG_ REL_VELOCITY_UNCERTAINTY_RAW : 176|10@1+ (1,0) [0|1023] "" LOGGER
 SG_ ACQUISITION_186_CANDIDATE_RAW : 186|5@1+ (1,0) [0|31] "" LOGGER
 SG_ UNCERTAINTY_192_CANDIDATE_RAW : 192|8@1+ (1,0) [0|255] "" LOGGER
 SG_ TTC_RAW : 201|11@1+ (1,0) [0|2047] "" LOGGER
 SG_ TTC_SIGMA_CANDIDATE_RAW : 240|7@1+ (1,0) [0|127] "" LOGGER
 SG_ WIDTH_FINE_258_CANDIDATE_RAW : 258|6@1+ (1,0) [0|63] "" LOGGER
 SG_ NORMALIZED_CLOSING_SIGMA_RAW : 288|9@1+ (1,0) [0|511] "" LOGGER
 SG_ AUX_LATERAL_MOTION_304_CANDIDATE_RAW : 304|16@1+ (1,0) [0|65535] "" LOGGER
 SG_ AUX_LATERAL_DIRECTION_320_CANDIDATE_RAW : 320|1@1+ (1,0) [0|1] "" LOGGER
 SG_ AUX_328_CANDIDATE_RAW : 328|13@1+ (1,0) [0|8191] "" LOGGER
 SG_ AUX2_378_CANDIDATE_RAW : 378|13@1+ (1,0) [0|8191] "" LOGGER
 SG_ MATURITY_398_CANDIDATE_RAW : 398|4@1+ (1,0) [0|15] "" LOGGER
 SG_ AZIMUTH_CENTER_RAW : 411|13@1+ (1,0) [0|8191] "" LOGGER
 SG_ AZIMUTH_EDGE_A_RAW : 424|13@1+ (1,0) [0|8191] "" LOGGER
 SG_ AZIMUTH_EDGE_B_RAW : 440|13@1+ (1,0) [0|8191] "" LOGGER
 SG_ MOTION_CLASS_CANDIDATE_RAW : 464|4@1+ (1,0) [0|15] "" LOGGER
 SG_ ANGULAR_WIDTH_COARSE_CANDIDATE_RAW : 472|8@1+ (1,0) [0|255] "" LOGGER
 SG_ ANGULAR_WIDTH_COARSE_COPY_CANDIDATE_RAW : 488|8@1+ (1,0) [0|255] "" LOGGER
 SG_ FLAG_106_CANDIDATE_RAW : 106|1@1+ (1,0) [0|1] "" LOGGER
 SG_ FLAG_107_CANDIDATE_RAW : 107|1@1+ (1,0) [0|1] "" LOGGER
 SG_ ENUM_109_CANDIDATE_RAW : 109|3@1+ (1,0) [0|7] "" LOGGER
 SG_ EXISTENCE_PROBABILITY_RAW : 121|6@1+ (1,0) [0|63] "" LOGGER
 SG_ ANGULAR_WIDTH_480_RAW : 480|8@1+ (1,0) [0|255] "" LOGGER
 SG_ DREL : 48|12@1+ (0.05,-4.296) [-4.296|200.454] "m" LOGGER
 SG_ YREL : 64|14@1+ (0.01,-81.92) [-81.92|81.91] "m" LOGGER
 SG_ VREL : 80|11@1+ (0.1,-153.9) [-153.9|50.8] "m/s" LOGGER
 SG_ AZIMUTH_CENTER : 411|13@1+ (0.000244140625,-1) [-1|0.999755859375] "rad" LOGGER
 SG_ AZIMUTH_EDGE_A : 424|13@1+ (0.000244140625,-1) [-1|0.999755859375] "rad" LOGGER
 SG_ AZIMUTH_EDGE_B : 440|13@1+ (0.000244140625,-1) [-1|0.999755859375] "rad" LOGGER
 SG_ TTC : 201|11@1+ (0.0078125,-8) [-8|7.9921875] "s" LOGGER

BO_ 126 BOSCH_C_OBJECT_14: 64 UNKNOWN
 SG_ CRC16_RAW : 0|16@1+ (1,0) [0|65535] "" LOGGER
 SG_ FRAME_COUNTER_RAW : 16|8@1+ (1,0) [0|255] "" LOGGER
 SG_ FRAME_PHASE_RAW : 24|4@1+ (1,0) [0|15] "" LOGGER
 SG_ OBJECT_ID_RAW : 32|16@1+ (1,0) [0|65535] "" LOGGER
 SG_ POSITION_X_RAW : 48|12@1+ (1,0) [0|4095] "" LOGGER
 SG_ OBJECT_CLASS_RAW : 60|4@1+ (1,0) [0|15] "" LOGGER
 SG_ POSITION_Y_RAW : 64|13@1+ (1,0) [0|8191] "" LOGGER
 SG_ Y_COMPANION_RAW : 77|3@1+ (1,0) [0|7] "" LOGGER
 SG_ VELOCITY_RAW : 80|11@1+ (1,0) [0|2047] "" LOGGER
 SG_ LATERAL_VELOCITY_CANDIDATE_RAW : 96|10@1+ (1,0) [0|1023] "" LOGGER
 SG_ NORMALIZED_RATE_CANDIDATE_RAW : 128|16@1+ (1,0) [0|65535] "" LOGGER
 SG_ QUALITY_CONTAINER_RAW : 144|16@1+ (1,0) [0|65535] "" LOGGER
 SG_ LIFECYCLE_RAW : 271|12@1+ (1,0) [0|4095] "" LOGGER
 SG_ UNCERTAINTY_160_CANDIDATE_RAW : 160|8@1+ (1,0) [0|255] "" LOGGER
 SG_ REL_VELOCITY_UNCERTAINTY_RAW : 176|10@1+ (1,0) [0|1023] "" LOGGER
 SG_ ACQUISITION_186_CANDIDATE_RAW : 186|5@1+ (1,0) [0|31] "" LOGGER
 SG_ UNCERTAINTY_192_CANDIDATE_RAW : 192|8@1+ (1,0) [0|255] "" LOGGER
 SG_ TTC_RAW : 201|11@1+ (1,0) [0|2047] "" LOGGER
 SG_ TTC_SIGMA_CANDIDATE_RAW : 240|7@1+ (1,0) [0|127] "" LOGGER
 SG_ WIDTH_FINE_258_CANDIDATE_RAW : 258|6@1+ (1,0) [0|63] "" LOGGER
 SG_ NORMALIZED_CLOSING_SIGMA_RAW : 288|9@1+ (1,0) [0|511] "" LOGGER
 SG_ AUX_LATERAL_MOTION_304_CANDIDATE_RAW : 304|16@1+ (1,0) [0|65535] "" LOGGER
 SG_ AUX_LATERAL_DIRECTION_320_CANDIDATE_RAW : 320|1@1+ (1,0) [0|1] "" LOGGER
 SG_ AUX_328_CANDIDATE_RAW : 328|13@1+ (1,0) [0|8191] "" LOGGER
 SG_ AUX2_378_CANDIDATE_RAW : 378|13@1+ (1,0) [0|8191] "" LOGGER
 SG_ MATURITY_398_CANDIDATE_RAW : 398|4@1+ (1,0) [0|15] "" LOGGER
 SG_ AZIMUTH_CENTER_RAW : 411|13@1+ (1,0) [0|8191] "" LOGGER
 SG_ AZIMUTH_EDGE_A_RAW : 424|13@1+ (1,0) [0|8191] "" LOGGER
 SG_ AZIMUTH_EDGE_B_RAW : 440|13@1+ (1,0) [0|8191] "" LOGGER
 SG_ MOTION_CLASS_CANDIDATE_RAW : 464|4@1+ (1,0) [0|15] "" LOGGER
 SG_ ANGULAR_WIDTH_COARSE_CANDIDATE_RAW : 472|8@1+ (1,0) [0|255] "" LOGGER
 SG_ ANGULAR_WIDTH_COARSE_COPY_CANDIDATE_RAW : 488|8@1+ (1,0) [0|255] "" LOGGER
 SG_ FLAG_106_CANDIDATE_RAW : 106|1@1+ (1,0) [0|1] "" LOGGER
 SG_ FLAG_107_CANDIDATE_RAW : 107|1@1+ (1,0) [0|1] "" LOGGER
 SG_ ENUM_109_CANDIDATE_RAW : 109|3@1+ (1,0) [0|7] "" LOGGER
 SG_ EXISTENCE_PROBABILITY_RAW : 121|6@1+ (1,0) [0|63] "" LOGGER
 SG_ ANGULAR_WIDTH_480_RAW : 480|8@1+ (1,0) [0|255] "" LOGGER
 SG_ DREL : 48|12@1+ (0.05,-4.296) [-4.296|200.454] "m" LOGGER
 SG_ YREL : 64|14@1+ (0.01,-81.92) [-81.92|81.91] "m" LOGGER
 SG_ VREL : 80|11@1+ (0.1,-153.9) [-153.9|50.8] "m/s" LOGGER
 SG_ AZIMUTH_CENTER : 411|13@1+ (0.000244140625,-1) [-1|0.999755859375] "rad" LOGGER
 SG_ AZIMUTH_EDGE_A : 424|13@1+ (0.000244140625,-1) [-1|0.999755859375] "rad" LOGGER
 SG_ AZIMUTH_EDGE_B : 440|13@1+ (0.000244140625,-1) [-1|0.999755859375] "rad" LOGGER
 SG_ TTC : 201|11@1+ (0.0078125,-8) [-8|7.9921875] "s" LOGGER

BO_ 128 BOSCH_C_OBJECT_15: 64 UNKNOWN
 SG_ CRC16_RAW : 0|16@1+ (1,0) [0|65535] "" LOGGER
 SG_ FRAME_COUNTER_RAW : 16|8@1+ (1,0) [0|255] "" LOGGER
 SG_ FRAME_PHASE_RAW : 24|4@1+ (1,0) [0|15] "" LOGGER
 SG_ OBJECT_ID_RAW : 32|16@1+ (1,0) [0|65535] "" LOGGER
 SG_ POSITION_X_RAW : 48|12@1+ (1,0) [0|4095] "" LOGGER
 SG_ OBJECT_CLASS_RAW : 60|4@1+ (1,0) [0|15] "" LOGGER
 SG_ POSITION_Y_RAW : 64|13@1+ (1,0) [0|8191] "" LOGGER
 SG_ Y_COMPANION_RAW : 77|3@1+ (1,0) [0|7] "" LOGGER
 SG_ VELOCITY_RAW : 80|11@1+ (1,0) [0|2047] "" LOGGER
 SG_ LATERAL_VELOCITY_CANDIDATE_RAW : 96|10@1+ (1,0) [0|1023] "" LOGGER
 SG_ NORMALIZED_RATE_CANDIDATE_RAW : 128|16@1+ (1,0) [0|65535] "" LOGGER
 SG_ QUALITY_CONTAINER_RAW : 144|16@1+ (1,0) [0|65535] "" LOGGER
 SG_ LIFECYCLE_RAW : 271|12@1+ (1,0) [0|4095] "" LOGGER
 SG_ UNCERTAINTY_160_CANDIDATE_RAW : 160|8@1+ (1,0) [0|255] "" LOGGER
 SG_ REL_VELOCITY_UNCERTAINTY_RAW : 176|10@1+ (1,0) [0|1023] "" LOGGER
 SG_ ACQUISITION_186_CANDIDATE_RAW : 186|5@1+ (1,0) [0|31] "" LOGGER
 SG_ UNCERTAINTY_192_CANDIDATE_RAW : 192|8@1+ (1,0) [0|255] "" LOGGER
 SG_ TTC_RAW : 201|11@1+ (1,0) [0|2047] "" LOGGER
 SG_ TTC_SIGMA_CANDIDATE_RAW : 240|7@1+ (1,0) [0|127] "" LOGGER
 SG_ WIDTH_FINE_258_CANDIDATE_RAW : 258|6@1+ (1,0) [0|63] "" LOGGER
 SG_ NORMALIZED_CLOSING_SIGMA_RAW : 288|9@1+ (1,0) [0|511] "" LOGGER
 SG_ AUX_LATERAL_MOTION_304_CANDIDATE_RAW : 304|16@1+ (1,0) [0|65535] "" LOGGER
 SG_ AUX_LATERAL_DIRECTION_320_CANDIDATE_RAW : 320|1@1+ (1,0) [0|1] "" LOGGER
 SG_ AUX_328_CANDIDATE_RAW : 328|13@1+ (1,0) [0|8191] "" LOGGER
 SG_ AUX2_378_CANDIDATE_RAW : 378|13@1+ (1,0) [0|8191] "" LOGGER
 SG_ MATURITY_398_CANDIDATE_RAW : 398|4@1+ (1,0) [0|15] "" LOGGER
 SG_ AZIMUTH_CENTER_RAW : 411|13@1+ (1,0) [0|8191] "" LOGGER
 SG_ AZIMUTH_EDGE_A_RAW : 424|13@1+ (1,0) [0|8191] "" LOGGER
 SG_ AZIMUTH_EDGE_B_RAW : 440|13@1+ (1,0) [0|8191] "" LOGGER
 SG_ MOTION_CLASS_CANDIDATE_RAW : 464|4@1+ (1,0) [0|15] "" LOGGER
 SG_ ANGULAR_WIDTH_COARSE_CANDIDATE_RAW : 472|8@1+ (1,0) [0|255] "" LOGGER
 SG_ ANGULAR_WIDTH_COARSE_COPY_CANDIDATE_RAW : 488|8@1+ (1,0) [0|255] "" LOGGER
 SG_ FLAG_106_CANDIDATE_RAW : 106|1@1+ (1,0) [0|1] "" LOGGER
 SG_ FLAG_107_CANDIDATE_RAW : 107|1@1+ (1,0) [0|1] "" LOGGER
 SG_ ENUM_109_CANDIDATE_RAW : 109|3@1+ (1,0) [0|7] "" LOGGER
 SG_ EXISTENCE_PROBABILITY_RAW : 121|6@1+ (1,0) [0|63] "" LOGGER
 SG_ ANGULAR_WIDTH_480_RAW : 480|8@1+ (1,0) [0|255] "" LOGGER
 SG_ DREL : 48|12@1+ (0.05,-4.296) [-4.296|200.454] "m" LOGGER
 SG_ YREL : 64|14@1+ (0.01,-81.92) [-81.92|81.91] "m" LOGGER
 SG_ VREL : 80|11@1+ (0.1,-153.9) [-153.9|50.8] "m/s" LOGGER
 SG_ AZIMUTH_CENTER : 411|13@1+ (0.000244140625,-1) [-1|0.999755859375] "rad" LOGGER
 SG_ AZIMUTH_EDGE_A : 424|13@1+ (0.000244140625,-1) [-1|0.999755859375] "rad" LOGGER
 SG_ AZIMUTH_EDGE_B : 440|13@1+ (0.000244140625,-1) [-1|0.999755859375] "rad" LOGGER
 SG_ TTC : 201|11@1+ (0.0078125,-8) [-8|7.9921875] "s" LOGGER

BO_ 1025 BOSCH_C_EGO_MOTION: 64 UNKNOWN
 SG_ YAW_RATE : 366|12@0- (0.0005257,0) [-1.0766336|1.0761079] "rad/s" LOGGER
 SG_ LAT_ACCEL : 80|8@1- (0.198,0) [-25.344|25.146] "m/s^2" LOGGER
 SG_ SPEED_CANDIDATE_RAW : 31|10@0+ (1,0) [0|1023] "" LOGGER
 SG_ STEER_ANGLE_CANDIDATE_RAW : 103|9@1- (1,0) [-256|255] "" LOGGER
 SG_ ACCEL_CANDIDATE_RAW : 88|8@1- (1,0) [-128|127] "" LOGGER

BO_ 200 CAMERA_EGO_LANE_LINES: 32 UNKNOWN
 SG_ LEFT_LINE_OFFSET : 43|12@1+ (0.0078125,-16) [-16|15.9921875] "m" LOGGER
 SG_ LEFT_LINE_CODE : 84|3@1+ (1,0) [0|7] "" LOGGER
 SG_ RIGHT_LINE_OFFSET : 158|12@1+ (0.0078125,-16) [-16|15.9921875] "m" LOGGER
 SG_ RIGHT_LINE_CODE : 199|3@1+ (1,0) [0|7] "" LOGGER

BA_DEF_ BO_ "VFrameFormat" ENUM "StandardCAN","ExtendedCAN","reserved","J1939PG","reserved","reserved","reserved","reserved","reserved","reserved","reserved","reserved","reserved","reserved","StandardCAN_FD","ExtendedCAN_FD";
BA_ "VFrameFormat" BO_ 114 14;
CM_ SG_ 114 CRC16_RAW "Capture-verified CRC16: polynomial 0x1021, init 0xFFFF, no reflection or xorout; bytes 2:64 then little-endian data ID 0x0fb3.";
CM_ SG_ 114 OBJECT_ID_RAW "Observed 0 empty, 1 through 63 active. IDs move between wire slots and are reused.";
CM_ SG_ 114 LIFECYCLE_RAW "Observed +3 modulo 4096 per consecutive sweep for continuing IDs. Resets or discontinuities require a new track.";
CM_ SG_ 114 POSITION_X_RAW "Unsigned 12-bit, bits 48-59 (accepted 2026-09-28 on held-out routes; bit 60 belongs to OBJECT_CLASS_RAW). Working decode dRel = 0.05*raw-4.296 m (accepted). The stock dash draws HUD_OBJECTS LONG_DIST from raw/4. Normalized closing and azimuth both imply a sensor range origin about 2.3 m behind the dRel origin.";
CM_ SG_ 114 OBJECT_CLASS_RAW "Object class, bits 60-63. 1 car and 3 truck/large vehicle: accepted against the stock dash HUD_OBJECTS icons on held-out routes (99.6% and 99.2%). 6, 7 and 8 are not motorcycle, pedestrian and bicycle as such: against video within 25 m they name that object on 1 of 11, 3 of 13 and 3 of 12 clear labels, and are most often a car (2026-09-29). The stock dash shows icon 6 for moving two-wheelers, so its motorcycle icon adds a filter on top of class 6. 9-11 unconfirmed. Classes 1 and 3 never share a track with classes 6-11.";
CM_ SG_ 114 POSITION_Y_RAW "Low 13 bits of the 14-bit offset-binary lateral position (bits 64-77), positive left: Y = 0.01*(bits 64-77 - 8192) m (0.01 m/count accepted 2026-09-28; 14-bit extent accepted 2026-09-29 on held-out routes). Within +-40.95 m this equals the signed 13-bit value. 8191 with bit 77 clear encodes -1 and is not an invalid sentinel.";
CM_ SG_ 114 Y_COMPANION_RAW "Three separate fields. Bit 77: top bit of the 14-bit offset-binary lateral position; it is the inverse of bit 76 within +-40.95 m and carries the sign beyond it. Bits 78-79: life state 0 newborn, 1 established, 2 ending (2 on 6-26% of a track last three frames vs 0.1-4% mid-life, ten recordings).";
CM_ SG_ 114 VELOCITY_RAW "Working decode vRel = 0.1*(raw-1539) m/s (accepted). Raw 0 (-153.9 m/s) is a floor saturation seen on newborn far objects, not a sentinel.";
CM_ SG_ 114 LATERAL_VELOCITY_CANDIDATE_RAW "Lateral velocity 0.1*(raw-511) m/s, positive left, relative in the sensor frame (includes the apparent motion of stationary objects from ego yaw). Provisional 2026-09-28: local Y slope and gyro kinematics on held-out recordings, zero 510-511 on stationary scenes; one held-out bracket (0.1004-0.1085) misses 0.1.";
CM_ SG_ 114 NORMALIZED_RATE_CANDIDATE_RAW "Bosch A NORMALIZED_CLOSING counterpart (provisional). 0.001*(raw-40000) 1/s, approximately vRel/(dRel+2.3 m); follows Doppler vRel, not range change. 64999 = invalid, with TTC 0, TTC sigma 0 and normalized-closing sigma 0 in the same frame.";
CM_ SG_ 114 QUALITY_CONTAINER_RAW "Bits 144-153 (upper byte always 0). Bosch A RANGE_SIGMA candidate (provisional): range-noise specific on 8 of 10 recordings, weak (partial rho 0.08-0.25). Strongly range dependent. Units unknown. No validity gate.";
CM_ SG_ 114 REL_VELOCITY_UNCERTAINTY_RAW "Bosch A REL_VELOCITY_UNCERTAINTY counterpart (accepted, raw units): velocity-noise specific and monotonic with empirical vRel noise on ten recordings. Nonlinear in m/s; 1023 may be saturation.";
CM_ SG_ 114 UNCERTAINTY_160_CANDIDATE_RAW "Mostly 1-2; higher on young and laterally offset objects. Weak noise association. Units unknown.";
CM_ SG_ 114 ACQUISITION_186_CANDIDATE_RAW "Starts near 23 on newborn tracks and decays to about 2. Carries little information beyond track age.";
CM_ SG_ 114 UNCERTAINTY_192_CANDIDATE_RAW "Decays with age; mixed velocity and lateral noise association, not specific to one noise. Units unknown.";
CM_ SG_ 114 TTC_RAW "Time to collision (accepted 2026-09-28 on held-out routes), (raw-1024)/128 s: a constant-velocity TTC, equal to -1/normalized closing within 0.06-0.10 s median. Reported only while an acceleration-aware collision prediction expects impact (lagging it by about 1-2 s); otherwise 2046. 0 = invalid (normalized closing 64999). No Bosch A counterpart.";
CM_ SG_ 114 TTC_SIGMA_CANDIDATE_RAW "TTC uncertainty (provisional): raw = TTC^2 * NORMALIZED_CLOSING_SIGMA / 64 within 0.1-2.5% on ten recordings. 127 = saturated or not populated; 0 = invalid. Stays populated on 3-26% of frames where TTC is defaulted (TTC about 8-19 s).";
CM_ SG_ 114 WIDTH_FINE_258_CANDIDATE_RAW "Angular extent measure, about 1/range within a track. No fixed affine relation to the azimuth-edge width. Units unresolved.";
CM_ SG_ 114 NORMALIZED_CLOSING_SIGMA_RAW "Bosch A NORMALIZED_CLOSING_SIGMA counterpart (accepted, raw units): specific to normalized-closing noise and monotonic with it on ten recordings; tied to TTC_SIGMA by a fixed 1/64 ratio. 0 when normalized closing is invalid.";
CM_ SG_ 114 AUX_LATERAL_MOTION_304_CANDIDATE_RAW "Signed 16-bit two-complement. Follows lateral motion; scale unresolved (brackets 0.005-0.12 m/s per count). -1 when normalized closing is invalid.";
CM_ SG_ 114 AUX_LATERAL_DIRECTION_320_CANDIDATE_RAW "Set when AUX_LATERAL_MOTION_304 is nonnegative on 97-99% of observations.";
CM_ SG_ 114 AUX_328_CANDIDATE_RAW "Changes nearly every frame; weak association with lateral and angular noise, not specific to one. 0 when normalized closing is invalid. Meaning unresolved.";
CM_ SG_ 114 AUX2_378_CANDIDATE_RAW "Signed 13-bit. Shares one subrecord with bits 480-487: both hold their defaults together (8190 here, signed -2; bits 480-487 zero) on about two thirds of observations. When populated, values follow the azimuth sign. Meaning unresolved; the earlier 384:7 probe is this field sign extension.";
CM_ SG_ 114 MATURITY_398_CANDIDATE_RAW "Counts down from about 6 to 1 as a track matures. Adds no velocity-error or survival information once track age is known. Upper-bit semantics unresolved.";
CM_ SG_ 114 AZIMUTH_CENTER_RAW "Unsigned, zero at 4096, positive left, 2^-12 rad per count (+-1 rad span; within 0.97-1.03 on nine recordings with 0.01 m lateral). Equals the midpoint of the two edge fields on 97-99.9% of observations.";
CM_ SG_ 114 AZIMUTH_EDGE_A_RAW "Left angular edge; same encoding as AZIMUTH_CENTER. Always at or left of the center. Clips at 8191 (+1 rad).";
CM_ SG_ 114 AZIMUTH_EDGE_B_RAW "Right angular edge; same encoding as AZIMUTH_CENTER. Clips at 0 (-1 rad) for near objects at the field-of-view edge. The edge difference is the Bosch A ANGULAR_WIDTH counterpart: it scales as 1/range within a track (log-log slope -0.91 to -0.99, ten recordings).";
CM_ SG_ 114 MOTION_CLASS_CANDIDATE_RAW "Observed 0, 2, 4. 4: same-direction traffic, and most objects seen only while ego is stopped. 2: oncoming or approaching, and most stationary objects seen while ego moves. 0: unassigned; young tracks, and every object on the 2026-09-10 and 2026-09-16 drives. Not a validated classifier.";
CM_ SG_ 114 ANGULAR_WIDTH_COARSE_CANDIDATE_RAW "Angular extent measure, about 1/range within a track. Not a fixed-scale copy of the edge width (forward vs inverse fits 6-21 vs 14-24 edge counts per unit). Not received power.";
CM_ SG_ 114 ANGULAR_WIDTH_COARSE_COPY_CANDIDATE_RAW "Byte 61 equals byte 59 on 99.7-100% of observations.";
CM_ SG_ 114 FLAG_106_CANDIDATE_RAW "Set on about 40% of newborn frames and 97-99% after 1 s; agrees with Y_COMPANION bit 78 on 96%. Meaning unresolved.";
CM_ SG_ 114 FLAG_107_CANDIDATE_RAW "Set on 0-3% of observations, mostly mature same-direction movers. Meaning unresolved.";
CM_ SG_ 114 ENUM_109_CANDIDATE_RAW "Values 0-4. 1 on most established tracks; 2-4 mostly on same-direction movers near the path with high existence. Not an object class (metric width about 1.7 m for all values) and not a left/right lane code. Meaning unresolved.";
CM_ SG_ 114 ANGULAR_WIDTH_480_RAW "Angular-width measure, raw units (accepted 2026-09-29 on held-out routes): follows the azimuth-edge width (Spearman >= 0.8) and scales as about 1/range within tracks on 57 of 60 routes. 0 while AUX2_378 holds its default.";
CM_ SG_ 114 EXISTENCE_PROBABILITY_RAW "Bosch A OBJECT_EXISTENCE_PROBABILITY counterpart (accepted, raw units). 0-49 only, 49 most common. Best survival predictor within range x age strata on ten recordings (AUC 0.67-0.92); falls over the last second before track death; low on short-lived ghosts. 0 marks a degraded measurement (accepted on held-out routes: range innovation and vRel steps at least 2x worse on 17 of 17). Probability scale unresolved.";
BA_ "VFrameFormat" BO_ 116 14;
CM_ SG_ 116 CRC16_RAW "Capture-verified CRC16: polynomial 0x1021, init 0xFFFF, no reflection or xorout; bytes 2:64 then little-endian data ID 0x0fb4.";
CM_ SG_ 116 OBJECT_ID_RAW "Observed 0 empty, 1 through 63 active. IDs move between wire slots and are reused.";
CM_ SG_ 116 LIFECYCLE_RAW "Observed +3 modulo 4096 per consecutive sweep for continuing IDs. Resets or discontinuities require a new track.";
CM_ SG_ 116 POSITION_X_RAW "Unsigned 12-bit, bits 48-59 (accepted 2026-09-28 on held-out routes; bit 60 belongs to OBJECT_CLASS_RAW). Working decode dRel = 0.05*raw-4.296 m (accepted). The stock dash draws HUD_OBJECTS LONG_DIST from raw/4. Normalized closing and azimuth both imply a sensor range origin about 2.3 m behind the dRel origin.";
CM_ SG_ 116 OBJECT_CLASS_RAW "Object class, bits 60-63. 1 car and 3 truck/large vehicle: accepted against the stock dash HUD_OBJECTS icons on held-out routes (99.6% and 99.2%). 6, 7 and 8 are not motorcycle, pedestrian and bicycle as such: against video within 25 m they name that object on 1 of 11, 3 of 13 and 3 of 12 clear labels, and are most often a car (2026-09-29). The stock dash shows icon 6 for moving two-wheelers, so its motorcycle icon adds a filter on top of class 6. 9-11 unconfirmed. Classes 1 and 3 never share a track with classes 6-11.";
CM_ SG_ 116 POSITION_Y_RAW "Low 13 bits of the 14-bit offset-binary lateral position (bits 64-77), positive left: Y = 0.01*(bits 64-77 - 8192) m (0.01 m/count accepted 2026-09-28; 14-bit extent accepted 2026-09-29 on held-out routes). Within +-40.95 m this equals the signed 13-bit value. 8191 with bit 77 clear encodes -1 and is not an invalid sentinel.";
CM_ SG_ 116 Y_COMPANION_RAW "Three separate fields. Bit 77: top bit of the 14-bit offset-binary lateral position; it is the inverse of bit 76 within +-40.95 m and carries the sign beyond it. Bits 78-79: life state 0 newborn, 1 established, 2 ending (2 on 6-26% of a track last three frames vs 0.1-4% mid-life, ten recordings).";
CM_ SG_ 116 VELOCITY_RAW "Working decode vRel = 0.1*(raw-1539) m/s (accepted). Raw 0 (-153.9 m/s) is a floor saturation seen on newborn far objects, not a sentinel.";
CM_ SG_ 116 LATERAL_VELOCITY_CANDIDATE_RAW "Lateral velocity 0.1*(raw-511) m/s, positive left, relative in the sensor frame (includes the apparent motion of stationary objects from ego yaw). Provisional 2026-09-28: local Y slope and gyro kinematics on held-out recordings, zero 510-511 on stationary scenes; one held-out bracket (0.1004-0.1085) misses 0.1.";
CM_ SG_ 116 NORMALIZED_RATE_CANDIDATE_RAW "Bosch A NORMALIZED_CLOSING counterpart (provisional). 0.001*(raw-40000) 1/s, approximately vRel/(dRel+2.3 m); follows Doppler vRel, not range change. 64999 = invalid, with TTC 0, TTC sigma 0 and normalized-closing sigma 0 in the same frame.";
CM_ SG_ 116 QUALITY_CONTAINER_RAW "Bits 144-153 (upper byte always 0). Bosch A RANGE_SIGMA candidate (provisional): range-noise specific on 8 of 10 recordings, weak (partial rho 0.08-0.25). Strongly range dependent. Units unknown. No validity gate.";
CM_ SG_ 116 REL_VELOCITY_UNCERTAINTY_RAW "Bosch A REL_VELOCITY_UNCERTAINTY counterpart (accepted, raw units): velocity-noise specific and monotonic with empirical vRel noise on ten recordings. Nonlinear in m/s; 1023 may be saturation.";
CM_ SG_ 116 UNCERTAINTY_160_CANDIDATE_RAW "Mostly 1-2; higher on young and laterally offset objects. Weak noise association. Units unknown.";
CM_ SG_ 116 ACQUISITION_186_CANDIDATE_RAW "Starts near 23 on newborn tracks and decays to about 2. Carries little information beyond track age.";
CM_ SG_ 116 UNCERTAINTY_192_CANDIDATE_RAW "Decays with age; mixed velocity and lateral noise association, not specific to one noise. Units unknown.";
CM_ SG_ 116 TTC_RAW "Time to collision (accepted 2026-09-28 on held-out routes), (raw-1024)/128 s: a constant-velocity TTC, equal to -1/normalized closing within 0.06-0.10 s median. Reported only while an acceleration-aware collision prediction expects impact (lagging it by about 1-2 s); otherwise 2046. 0 = invalid (normalized closing 64999). No Bosch A counterpart.";
CM_ SG_ 116 TTC_SIGMA_CANDIDATE_RAW "TTC uncertainty (provisional): raw = TTC^2 * NORMALIZED_CLOSING_SIGMA / 64 within 0.1-2.5% on ten recordings. 127 = saturated or not populated; 0 = invalid. Stays populated on 3-26% of frames where TTC is defaulted (TTC about 8-19 s).";
CM_ SG_ 116 WIDTH_FINE_258_CANDIDATE_RAW "Angular extent measure, about 1/range within a track. No fixed affine relation to the azimuth-edge width. Units unresolved.";
CM_ SG_ 116 NORMALIZED_CLOSING_SIGMA_RAW "Bosch A NORMALIZED_CLOSING_SIGMA counterpart (accepted, raw units): specific to normalized-closing noise and monotonic with it on ten recordings; tied to TTC_SIGMA by a fixed 1/64 ratio. 0 when normalized closing is invalid.";
CM_ SG_ 116 AUX_LATERAL_MOTION_304_CANDIDATE_RAW "Signed 16-bit two-complement. Follows lateral motion; scale unresolved (brackets 0.005-0.12 m/s per count). -1 when normalized closing is invalid.";
CM_ SG_ 116 AUX_LATERAL_DIRECTION_320_CANDIDATE_RAW "Set when AUX_LATERAL_MOTION_304 is nonnegative on 97-99% of observations.";
CM_ SG_ 116 AUX_328_CANDIDATE_RAW "Changes nearly every frame; weak association with lateral and angular noise, not specific to one. 0 when normalized closing is invalid. Meaning unresolved.";
CM_ SG_ 116 AUX2_378_CANDIDATE_RAW "Signed 13-bit. Shares one subrecord with bits 480-487: both hold their defaults together (8190 here, signed -2; bits 480-487 zero) on about two thirds of observations. When populated, values follow the azimuth sign. Meaning unresolved; the earlier 384:7 probe is this field sign extension.";
CM_ SG_ 116 MATURITY_398_CANDIDATE_RAW "Counts down from about 6 to 1 as a track matures. Adds no velocity-error or survival information once track age is known. Upper-bit semantics unresolved.";
CM_ SG_ 116 AZIMUTH_CENTER_RAW "Unsigned, zero at 4096, positive left, 2^-12 rad per count (+-1 rad span; within 0.97-1.03 on nine recordings with 0.01 m lateral). Equals the midpoint of the two edge fields on 97-99.9% of observations.";
CM_ SG_ 116 AZIMUTH_EDGE_A_RAW "Left angular edge; same encoding as AZIMUTH_CENTER. Always at or left of the center. Clips at 8191 (+1 rad).";
CM_ SG_ 116 AZIMUTH_EDGE_B_RAW "Right angular edge; same encoding as AZIMUTH_CENTER. Clips at 0 (-1 rad) for near objects at the field-of-view edge. The edge difference is the Bosch A ANGULAR_WIDTH counterpart: it scales as 1/range within a track (log-log slope -0.91 to -0.99, ten recordings).";
CM_ SG_ 116 MOTION_CLASS_CANDIDATE_RAW "Observed 0, 2, 4. 4: same-direction traffic, and most objects seen only while ego is stopped. 2: oncoming or approaching, and most stationary objects seen while ego moves. 0: unassigned; young tracks, and every object on the 2026-09-10 and 2026-09-16 drives. Not a validated classifier.";
CM_ SG_ 116 ANGULAR_WIDTH_COARSE_CANDIDATE_RAW "Angular extent measure, about 1/range within a track. Not a fixed-scale copy of the edge width (forward vs inverse fits 6-21 vs 14-24 edge counts per unit). Not received power.";
CM_ SG_ 116 ANGULAR_WIDTH_COARSE_COPY_CANDIDATE_RAW "Byte 61 equals byte 59 on 99.7-100% of observations.";
CM_ SG_ 116 FLAG_106_CANDIDATE_RAW "Set on about 40% of newborn frames and 97-99% after 1 s; agrees with Y_COMPANION bit 78 on 96%. Meaning unresolved.";
CM_ SG_ 116 FLAG_107_CANDIDATE_RAW "Set on 0-3% of observations, mostly mature same-direction movers. Meaning unresolved.";
CM_ SG_ 116 ENUM_109_CANDIDATE_RAW "Values 0-4. 1 on most established tracks; 2-4 mostly on same-direction movers near the path with high existence. Not an object class (metric width about 1.7 m for all values) and not a left/right lane code. Meaning unresolved.";
CM_ SG_ 116 ANGULAR_WIDTH_480_RAW "Angular-width measure, raw units (accepted 2026-09-29 on held-out routes): follows the azimuth-edge width (Spearman >= 0.8) and scales as about 1/range within tracks on 57 of 60 routes. 0 while AUX2_378 holds its default.";
CM_ SG_ 116 EXISTENCE_PROBABILITY_RAW "Bosch A OBJECT_EXISTENCE_PROBABILITY counterpart (accepted, raw units). 0-49 only, 49 most common. Best survival predictor within range x age strata on ten recordings (AUC 0.67-0.92); falls over the last second before track death; low on short-lived ghosts. 0 marks a degraded measurement (accepted on held-out routes: range innovation and vRel steps at least 2x worse on 17 of 17). Probability scale unresolved.";
BA_ "VFrameFormat" BO_ 118 14;
CM_ SG_ 118 CRC16_RAW "Capture-verified CRC16: polynomial 0x1021, init 0xFFFF, no reflection or xorout; bytes 2:64 then little-endian data ID 0x0fb5.";
CM_ SG_ 118 OBJECT_ID_RAW "Observed 0 empty, 1 through 63 active. IDs move between wire slots and are reused.";
CM_ SG_ 118 LIFECYCLE_RAW "Observed +3 modulo 4096 per consecutive sweep for continuing IDs. Resets or discontinuities require a new track.";
CM_ SG_ 118 POSITION_X_RAW "Unsigned 12-bit, bits 48-59 (accepted 2026-09-28 on held-out routes; bit 60 belongs to OBJECT_CLASS_RAW). Working decode dRel = 0.05*raw-4.296 m (accepted). The stock dash draws HUD_OBJECTS LONG_DIST from raw/4. Normalized closing and azimuth both imply a sensor range origin about 2.3 m behind the dRel origin.";
CM_ SG_ 118 OBJECT_CLASS_RAW "Object class, bits 60-63. 1 car and 3 truck/large vehicle: accepted against the stock dash HUD_OBJECTS icons on held-out routes (99.6% and 99.2%). 6, 7 and 8 are not motorcycle, pedestrian and bicycle as such: against video within 25 m they name that object on 1 of 11, 3 of 13 and 3 of 12 clear labels, and are most often a car (2026-09-29). The stock dash shows icon 6 for moving two-wheelers, so its motorcycle icon adds a filter on top of class 6. 9-11 unconfirmed. Classes 1 and 3 never share a track with classes 6-11.";
CM_ SG_ 118 POSITION_Y_RAW "Low 13 bits of the 14-bit offset-binary lateral position (bits 64-77), positive left: Y = 0.01*(bits 64-77 - 8192) m (0.01 m/count accepted 2026-09-28; 14-bit extent accepted 2026-09-29 on held-out routes). Within +-40.95 m this equals the signed 13-bit value. 8191 with bit 77 clear encodes -1 and is not an invalid sentinel.";
CM_ SG_ 118 Y_COMPANION_RAW "Three separate fields. Bit 77: top bit of the 14-bit offset-binary lateral position; it is the inverse of bit 76 within +-40.95 m and carries the sign beyond it. Bits 78-79: life state 0 newborn, 1 established, 2 ending (2 on 6-26% of a track last three frames vs 0.1-4% mid-life, ten recordings).";
CM_ SG_ 118 VELOCITY_RAW "Working decode vRel = 0.1*(raw-1539) m/s (accepted). Raw 0 (-153.9 m/s) is a floor saturation seen on newborn far objects, not a sentinel.";
CM_ SG_ 118 LATERAL_VELOCITY_CANDIDATE_RAW "Lateral velocity 0.1*(raw-511) m/s, positive left, relative in the sensor frame (includes the apparent motion of stationary objects from ego yaw). Provisional 2026-09-28: local Y slope and gyro kinematics on held-out recordings, zero 510-511 on stationary scenes; one held-out bracket (0.1004-0.1085) misses 0.1.";
CM_ SG_ 118 NORMALIZED_RATE_CANDIDATE_RAW "Bosch A NORMALIZED_CLOSING counterpart (provisional). 0.001*(raw-40000) 1/s, approximately vRel/(dRel+2.3 m); follows Doppler vRel, not range change. 64999 = invalid, with TTC 0, TTC sigma 0 and normalized-closing sigma 0 in the same frame.";
CM_ SG_ 118 QUALITY_CONTAINER_RAW "Bits 144-153 (upper byte always 0). Bosch A RANGE_SIGMA candidate (provisional): range-noise specific on 8 of 10 recordings, weak (partial rho 0.08-0.25). Strongly range dependent. Units unknown. No validity gate.";
CM_ SG_ 118 REL_VELOCITY_UNCERTAINTY_RAW "Bosch A REL_VELOCITY_UNCERTAINTY counterpart (accepted, raw units): velocity-noise specific and monotonic with empirical vRel noise on ten recordings. Nonlinear in m/s; 1023 may be saturation.";
CM_ SG_ 118 UNCERTAINTY_160_CANDIDATE_RAW "Mostly 1-2; higher on young and laterally offset objects. Weak noise association. Units unknown.";
CM_ SG_ 118 ACQUISITION_186_CANDIDATE_RAW "Starts near 23 on newborn tracks and decays to about 2. Carries little information beyond track age.";
CM_ SG_ 118 UNCERTAINTY_192_CANDIDATE_RAW "Decays with age; mixed velocity and lateral noise association, not specific to one noise. Units unknown.";
CM_ SG_ 118 TTC_RAW "Time to collision (accepted 2026-09-28 on held-out routes), (raw-1024)/128 s: a constant-velocity TTC, equal to -1/normalized closing within 0.06-0.10 s median. Reported only while an acceleration-aware collision prediction expects impact (lagging it by about 1-2 s); otherwise 2046. 0 = invalid (normalized closing 64999). No Bosch A counterpart.";
CM_ SG_ 118 TTC_SIGMA_CANDIDATE_RAW "TTC uncertainty (provisional): raw = TTC^2 * NORMALIZED_CLOSING_SIGMA / 64 within 0.1-2.5% on ten recordings. 127 = saturated or not populated; 0 = invalid. Stays populated on 3-26% of frames where TTC is defaulted (TTC about 8-19 s).";
CM_ SG_ 118 WIDTH_FINE_258_CANDIDATE_RAW "Angular extent measure, about 1/range within a track. No fixed affine relation to the azimuth-edge width. Units unresolved.";
CM_ SG_ 118 NORMALIZED_CLOSING_SIGMA_RAW "Bosch A NORMALIZED_CLOSING_SIGMA counterpart (accepted, raw units): specific to normalized-closing noise and monotonic with it on ten recordings; tied to TTC_SIGMA by a fixed 1/64 ratio. 0 when normalized closing is invalid.";
CM_ SG_ 118 AUX_LATERAL_MOTION_304_CANDIDATE_RAW "Signed 16-bit two-complement. Follows lateral motion; scale unresolved (brackets 0.005-0.12 m/s per count). -1 when normalized closing is invalid.";
CM_ SG_ 118 AUX_LATERAL_DIRECTION_320_CANDIDATE_RAW "Set when AUX_LATERAL_MOTION_304 is nonnegative on 97-99% of observations.";
CM_ SG_ 118 AUX_328_CANDIDATE_RAW "Changes nearly every frame; weak association with lateral and angular noise, not specific to one. 0 when normalized closing is invalid. Meaning unresolved.";
CM_ SG_ 118 AUX2_378_CANDIDATE_RAW "Signed 13-bit. Shares one subrecord with bits 480-487: both hold their defaults together (8190 here, signed -2; bits 480-487 zero) on about two thirds of observations. When populated, values follow the azimuth sign. Meaning unresolved; the earlier 384:7 probe is this field sign extension.";
CM_ SG_ 118 MATURITY_398_CANDIDATE_RAW "Counts down from about 6 to 1 as a track matures. Adds no velocity-error or survival information once track age is known. Upper-bit semantics unresolved.";
CM_ SG_ 118 AZIMUTH_CENTER_RAW "Unsigned, zero at 4096, positive left, 2^-12 rad per count (+-1 rad span; within 0.97-1.03 on nine recordings with 0.01 m lateral). Equals the midpoint of the two edge fields on 97-99.9% of observations.";
CM_ SG_ 118 AZIMUTH_EDGE_A_RAW "Left angular edge; same encoding as AZIMUTH_CENTER. Always at or left of the center. Clips at 8191 (+1 rad).";
CM_ SG_ 118 AZIMUTH_EDGE_B_RAW "Right angular edge; same encoding as AZIMUTH_CENTER. Clips at 0 (-1 rad) for near objects at the field-of-view edge. The edge difference is the Bosch A ANGULAR_WIDTH counterpart: it scales as 1/range within a track (log-log slope -0.91 to -0.99, ten recordings).";
CM_ SG_ 118 MOTION_CLASS_CANDIDATE_RAW "Observed 0, 2, 4. 4: same-direction traffic, and most objects seen only while ego is stopped. 2: oncoming or approaching, and most stationary objects seen while ego moves. 0: unassigned; young tracks, and every object on the 2026-09-10 and 2026-09-16 drives. Not a validated classifier.";
CM_ SG_ 118 ANGULAR_WIDTH_COARSE_CANDIDATE_RAW "Angular extent measure, about 1/range within a track. Not a fixed-scale copy of the edge width (forward vs inverse fits 6-21 vs 14-24 edge counts per unit). Not received power.";
CM_ SG_ 118 ANGULAR_WIDTH_COARSE_COPY_CANDIDATE_RAW "Byte 61 equals byte 59 on 99.7-100% of observations.";
CM_ SG_ 118 FLAG_106_CANDIDATE_RAW "Set on about 40% of newborn frames and 97-99% after 1 s; agrees with Y_COMPANION bit 78 on 96%. Meaning unresolved.";
CM_ SG_ 118 FLAG_107_CANDIDATE_RAW "Set on 0-3% of observations, mostly mature same-direction movers. Meaning unresolved.";
CM_ SG_ 118 ENUM_109_CANDIDATE_RAW "Values 0-4. 1 on most established tracks; 2-4 mostly on same-direction movers near the path with high existence. Not an object class (metric width about 1.7 m for all values) and not a left/right lane code. Meaning unresolved.";
CM_ SG_ 118 ANGULAR_WIDTH_480_RAW "Angular-width measure, raw units (accepted 2026-09-29 on held-out routes): follows the azimuth-edge width (Spearman >= 0.8) and scales as about 1/range within tracks on 57 of 60 routes. 0 while AUX2_378 holds its default.";
CM_ SG_ 118 EXISTENCE_PROBABILITY_RAW "Bosch A OBJECT_EXISTENCE_PROBABILITY counterpart (accepted, raw units). 0-49 only, 49 most common. Best survival predictor within range x age strata on ten recordings (AUC 0.67-0.92); falls over the last second before track death; low on short-lived ghosts. 0 marks a degraded measurement (accepted on held-out routes: range innovation and vRel steps at least 2x worse on 17 of 17). Probability scale unresolved.";
BA_ "VFrameFormat" BO_ 120 14;
CM_ SG_ 120 CRC16_RAW "Capture-verified CRC16: polynomial 0x1021, init 0xFFFF, no reflection or xorout; bytes 2:64 then little-endian data ID 0x0fb6.";
CM_ SG_ 120 OBJECT_ID_RAW "Observed 0 empty, 1 through 63 active. IDs move between wire slots and are reused.";
CM_ SG_ 120 LIFECYCLE_RAW "Observed +3 modulo 4096 per consecutive sweep for continuing IDs. Resets or discontinuities require a new track.";
CM_ SG_ 120 POSITION_X_RAW "Unsigned 12-bit, bits 48-59 (accepted 2026-09-28 on held-out routes; bit 60 belongs to OBJECT_CLASS_RAW). Working decode dRel = 0.05*raw-4.296 m (accepted). The stock dash draws HUD_OBJECTS LONG_DIST from raw/4. Normalized closing and azimuth both imply a sensor range origin about 2.3 m behind the dRel origin.";
CM_ SG_ 120 OBJECT_CLASS_RAW "Object class, bits 60-63. 1 car and 3 truck/large vehicle: accepted against the stock dash HUD_OBJECTS icons on held-out routes (99.6% and 99.2%). 6, 7 and 8 are not motorcycle, pedestrian and bicycle as such: against video within 25 m they name that object on 1 of 11, 3 of 13 and 3 of 12 clear labels, and are most often a car (2026-09-29). The stock dash shows icon 6 for moving two-wheelers, so its motorcycle icon adds a filter on top of class 6. 9-11 unconfirmed. Classes 1 and 3 never share a track with classes 6-11.";
CM_ SG_ 120 POSITION_Y_RAW "Low 13 bits of the 14-bit offset-binary lateral position (bits 64-77), positive left: Y = 0.01*(bits 64-77 - 8192) m (0.01 m/count accepted 2026-09-28; 14-bit extent accepted 2026-09-29 on held-out routes). Within +-40.95 m this equals the signed 13-bit value. 8191 with bit 77 clear encodes -1 and is not an invalid sentinel.";
CM_ SG_ 120 Y_COMPANION_RAW "Three separate fields. Bit 77: top bit of the 14-bit offset-binary lateral position; it is the inverse of bit 76 within +-40.95 m and carries the sign beyond it. Bits 78-79: life state 0 newborn, 1 established, 2 ending (2 on 6-26% of a track last three frames vs 0.1-4% mid-life, ten recordings).";
CM_ SG_ 120 VELOCITY_RAW "Working decode vRel = 0.1*(raw-1539) m/s (accepted). Raw 0 (-153.9 m/s) is a floor saturation seen on newborn far objects, not a sentinel.";
CM_ SG_ 120 LATERAL_VELOCITY_CANDIDATE_RAW "Lateral velocity 0.1*(raw-511) m/s, positive left, relative in the sensor frame (includes the apparent motion of stationary objects from ego yaw). Provisional 2026-09-28: local Y slope and gyro kinematics on held-out recordings, zero 510-511 on stationary scenes; one held-out bracket (0.1004-0.1085) misses 0.1.";
CM_ SG_ 120 NORMALIZED_RATE_CANDIDATE_RAW "Bosch A NORMALIZED_CLOSING counterpart (provisional). 0.001*(raw-40000) 1/s, approximately vRel/(dRel+2.3 m); follows Doppler vRel, not range change. 64999 = invalid, with TTC 0, TTC sigma 0 and normalized-closing sigma 0 in the same frame.";
CM_ SG_ 120 QUALITY_CONTAINER_RAW "Bits 144-153 (upper byte always 0). Bosch A RANGE_SIGMA candidate (provisional): range-noise specific on 8 of 10 recordings, weak (partial rho 0.08-0.25). Strongly range dependent. Units unknown. No validity gate.";
CM_ SG_ 120 REL_VELOCITY_UNCERTAINTY_RAW "Bosch A REL_VELOCITY_UNCERTAINTY counterpart (accepted, raw units): velocity-noise specific and monotonic with empirical vRel noise on ten recordings. Nonlinear in m/s; 1023 may be saturation.";
CM_ SG_ 120 UNCERTAINTY_160_CANDIDATE_RAW "Mostly 1-2; higher on young and laterally offset objects. Weak noise association. Units unknown.";
CM_ SG_ 120 ACQUISITION_186_CANDIDATE_RAW "Starts near 23 on newborn tracks and decays to about 2. Carries little information beyond track age.";
CM_ SG_ 120 UNCERTAINTY_192_CANDIDATE_RAW "Decays with age; mixed velocity and lateral noise association, not specific to one noise. Units unknown.";
CM_ SG_ 120 TTC_RAW "Time to collision (accepted 2026-09-28 on held-out routes), (raw-1024)/128 s: a constant-velocity TTC, equal to -1/normalized closing within 0.06-0.10 s median. Reported only while an acceleration-aware collision prediction expects impact (lagging it by about 1-2 s); otherwise 2046. 0 = invalid (normalized closing 64999). No Bosch A counterpart.";
CM_ SG_ 120 TTC_SIGMA_CANDIDATE_RAW "TTC uncertainty (provisional): raw = TTC^2 * NORMALIZED_CLOSING_SIGMA / 64 within 0.1-2.5% on ten recordings. 127 = saturated or not populated; 0 = invalid. Stays populated on 3-26% of frames where TTC is defaulted (TTC about 8-19 s).";
CM_ SG_ 120 WIDTH_FINE_258_CANDIDATE_RAW "Angular extent measure, about 1/range within a track. No fixed affine relation to the azimuth-edge width. Units unresolved.";
CM_ SG_ 120 NORMALIZED_CLOSING_SIGMA_RAW "Bosch A NORMALIZED_CLOSING_SIGMA counterpart (accepted, raw units): specific to normalized-closing noise and monotonic with it on ten recordings; tied to TTC_SIGMA by a fixed 1/64 ratio. 0 when normalized closing is invalid.";
CM_ SG_ 120 AUX_LATERAL_MOTION_304_CANDIDATE_RAW "Signed 16-bit two-complement. Follows lateral motion; scale unresolved (brackets 0.005-0.12 m/s per count). -1 when normalized closing is invalid.";
CM_ SG_ 120 AUX_LATERAL_DIRECTION_320_CANDIDATE_RAW "Set when AUX_LATERAL_MOTION_304 is nonnegative on 97-99% of observations.";
CM_ SG_ 120 AUX_328_CANDIDATE_RAW "Changes nearly every frame; weak association with lateral and angular noise, not specific to one. 0 when normalized closing is invalid. Meaning unresolved.";
CM_ SG_ 120 AUX2_378_CANDIDATE_RAW "Signed 13-bit. Shares one subrecord with bits 480-487: both hold their defaults together (8190 here, signed -2; bits 480-487 zero) on about two thirds of observations. When populated, values follow the azimuth sign. Meaning unresolved; the earlier 384:7 probe is this field sign extension.";
CM_ SG_ 120 MATURITY_398_CANDIDATE_RAW "Counts down from about 6 to 1 as a track matures. Adds no velocity-error or survival information once track age is known. Upper-bit semantics unresolved.";
CM_ SG_ 120 AZIMUTH_CENTER_RAW "Unsigned, zero at 4096, positive left, 2^-12 rad per count (+-1 rad span; within 0.97-1.03 on nine recordings with 0.01 m lateral). Equals the midpoint of the two edge fields on 97-99.9% of observations.";
CM_ SG_ 120 AZIMUTH_EDGE_A_RAW "Left angular edge; same encoding as AZIMUTH_CENTER. Always at or left of the center. Clips at 8191 (+1 rad).";
CM_ SG_ 120 AZIMUTH_EDGE_B_RAW "Right angular edge; same encoding as AZIMUTH_CENTER. Clips at 0 (-1 rad) for near objects at the field-of-view edge. The edge difference is the Bosch A ANGULAR_WIDTH counterpart: it scales as 1/range within a track (log-log slope -0.91 to -0.99, ten recordings).";
CM_ SG_ 120 MOTION_CLASS_CANDIDATE_RAW "Observed 0, 2, 4. 4: same-direction traffic, and most objects seen only while ego is stopped. 2: oncoming or approaching, and most stationary objects seen while ego moves. 0: unassigned; young tracks, and every object on the 2026-09-10 and 2026-09-16 drives. Not a validated classifier.";
CM_ SG_ 120 ANGULAR_WIDTH_COARSE_CANDIDATE_RAW "Angular extent measure, about 1/range within a track. Not a fixed-scale copy of the edge width (forward vs inverse fits 6-21 vs 14-24 edge counts per unit). Not received power.";
CM_ SG_ 120 ANGULAR_WIDTH_COARSE_COPY_CANDIDATE_RAW "Byte 61 equals byte 59 on 99.7-100% of observations.";
CM_ SG_ 120 FLAG_106_CANDIDATE_RAW "Set on about 40% of newborn frames and 97-99% after 1 s; agrees with Y_COMPANION bit 78 on 96%. Meaning unresolved.";
CM_ SG_ 120 FLAG_107_CANDIDATE_RAW "Set on 0-3% of observations, mostly mature same-direction movers. Meaning unresolved.";
CM_ SG_ 120 ENUM_109_CANDIDATE_RAW "Values 0-4. 1 on most established tracks; 2-4 mostly on same-direction movers near the path with high existence. Not an object class (metric width about 1.7 m for all values) and not a left/right lane code. Meaning unresolved.";
CM_ SG_ 120 ANGULAR_WIDTH_480_RAW "Angular-width measure, raw units (accepted 2026-09-29 on held-out routes): follows the azimuth-edge width (Spearman >= 0.8) and scales as about 1/range within tracks on 57 of 60 routes. 0 while AUX2_378 holds its default.";
CM_ SG_ 120 EXISTENCE_PROBABILITY_RAW "Bosch A OBJECT_EXISTENCE_PROBABILITY counterpart (accepted, raw units). 0-49 only, 49 most common. Best survival predictor within range x age strata on ten recordings (AUC 0.67-0.92); falls over the last second before track death; low on short-lived ghosts. 0 marks a degraded measurement (accepted on held-out routes: range innovation and vRel steps at least 2x worse on 17 of 17). Probability scale unresolved.";
BA_ "VFrameFormat" BO_ 122 14;
CM_ SG_ 122 CRC16_RAW "Capture-verified CRC16: polynomial 0x1021, init 0xFFFF, no reflection or xorout; bytes 2:64 then little-endian data ID 0x0fb7.";
CM_ SG_ 122 OBJECT_ID_RAW "Observed 0 empty, 1 through 63 active. IDs move between wire slots and are reused.";
CM_ SG_ 122 LIFECYCLE_RAW "Observed +3 modulo 4096 per consecutive sweep for continuing IDs. Resets or discontinuities require a new track.";
CM_ SG_ 122 POSITION_X_RAW "Unsigned 12-bit, bits 48-59 (accepted 2026-09-28 on held-out routes; bit 60 belongs to OBJECT_CLASS_RAW). Working decode dRel = 0.05*raw-4.296 m (accepted). The stock dash draws HUD_OBJECTS LONG_DIST from raw/4. Normalized closing and azimuth both imply a sensor range origin about 2.3 m behind the dRel origin.";
CM_ SG_ 122 OBJECT_CLASS_RAW "Object class, bits 60-63. 1 car and 3 truck/large vehicle: accepted against the stock dash HUD_OBJECTS icons on held-out routes (99.6% and 99.2%). 6, 7 and 8 are not motorcycle, pedestrian and bicycle as such: against video within 25 m they name that object on 1 of 11, 3 of 13 and 3 of 12 clear labels, and are most often a car (2026-09-29). The stock dash shows icon 6 for moving two-wheelers, so its motorcycle icon adds a filter on top of class 6. 9-11 unconfirmed. Classes 1 and 3 never share a track with classes 6-11.";
CM_ SG_ 122 POSITION_Y_RAW "Low 13 bits of the 14-bit offset-binary lateral position (bits 64-77), positive left: Y = 0.01*(bits 64-77 - 8192) m (0.01 m/count accepted 2026-09-28; 14-bit extent accepted 2026-09-29 on held-out routes). Within +-40.95 m this equals the signed 13-bit value. 8191 with bit 77 clear encodes -1 and is not an invalid sentinel.";
CM_ SG_ 122 Y_COMPANION_RAW "Three separate fields. Bit 77: top bit of the 14-bit offset-binary lateral position; it is the inverse of bit 76 within +-40.95 m and carries the sign beyond it. Bits 78-79: life state 0 newborn, 1 established, 2 ending (2 on 6-26% of a track last three frames vs 0.1-4% mid-life, ten recordings).";
CM_ SG_ 122 VELOCITY_RAW "Working decode vRel = 0.1*(raw-1539) m/s (accepted). Raw 0 (-153.9 m/s) is a floor saturation seen on newborn far objects, not a sentinel.";
CM_ SG_ 122 LATERAL_VELOCITY_CANDIDATE_RAW "Lateral velocity 0.1*(raw-511) m/s, positive left, relative in the sensor frame (includes the apparent motion of stationary objects from ego yaw). Provisional 2026-09-28: local Y slope and gyro kinematics on held-out recordings, zero 510-511 on stationary scenes; one held-out bracket (0.1004-0.1085) misses 0.1.";
CM_ SG_ 122 NORMALIZED_RATE_CANDIDATE_RAW "Bosch A NORMALIZED_CLOSING counterpart (provisional). 0.001*(raw-40000) 1/s, approximately vRel/(dRel+2.3 m); follows Doppler vRel, not range change. 64999 = invalid, with TTC 0, TTC sigma 0 and normalized-closing sigma 0 in the same frame.";
CM_ SG_ 122 QUALITY_CONTAINER_RAW "Bits 144-153 (upper byte always 0). Bosch A RANGE_SIGMA candidate (provisional): range-noise specific on 8 of 10 recordings, weak (partial rho 0.08-0.25). Strongly range dependent. Units unknown. No validity gate.";
CM_ SG_ 122 REL_VELOCITY_UNCERTAINTY_RAW "Bosch A REL_VELOCITY_UNCERTAINTY counterpart (accepted, raw units): velocity-noise specific and monotonic with empirical vRel noise on ten recordings. Nonlinear in m/s; 1023 may be saturation.";
CM_ SG_ 122 UNCERTAINTY_160_CANDIDATE_RAW "Mostly 1-2; higher on young and laterally offset objects. Weak noise association. Units unknown.";
CM_ SG_ 122 ACQUISITION_186_CANDIDATE_RAW "Starts near 23 on newborn tracks and decays to about 2. Carries little information beyond track age.";
CM_ SG_ 122 UNCERTAINTY_192_CANDIDATE_RAW "Decays with age; mixed velocity and lateral noise association, not specific to one noise. Units unknown.";
CM_ SG_ 122 TTC_RAW "Time to collision (accepted 2026-09-28 on held-out routes), (raw-1024)/128 s: a constant-velocity TTC, equal to -1/normalized closing within 0.06-0.10 s median. Reported only while an acceleration-aware collision prediction expects impact (lagging it by about 1-2 s); otherwise 2046. 0 = invalid (normalized closing 64999). No Bosch A counterpart.";
CM_ SG_ 122 TTC_SIGMA_CANDIDATE_RAW "TTC uncertainty (provisional): raw = TTC^2 * NORMALIZED_CLOSING_SIGMA / 64 within 0.1-2.5% on ten recordings. 127 = saturated or not populated; 0 = invalid. Stays populated on 3-26% of frames where TTC is defaulted (TTC about 8-19 s).";
CM_ SG_ 122 WIDTH_FINE_258_CANDIDATE_RAW "Angular extent measure, about 1/range within a track. No fixed affine relation to the azimuth-edge width. Units unresolved.";
CM_ SG_ 122 NORMALIZED_CLOSING_SIGMA_RAW "Bosch A NORMALIZED_CLOSING_SIGMA counterpart (accepted, raw units): specific to normalized-closing noise and monotonic with it on ten recordings; tied to TTC_SIGMA by a fixed 1/64 ratio. 0 when normalized closing is invalid.";
CM_ SG_ 122 AUX_LATERAL_MOTION_304_CANDIDATE_RAW "Signed 16-bit two-complement. Follows lateral motion; scale unresolved (brackets 0.005-0.12 m/s per count). -1 when normalized closing is invalid.";
CM_ SG_ 122 AUX_LATERAL_DIRECTION_320_CANDIDATE_RAW "Set when AUX_LATERAL_MOTION_304 is nonnegative on 97-99% of observations.";
CM_ SG_ 122 AUX_328_CANDIDATE_RAW "Changes nearly every frame; weak association with lateral and angular noise, not specific to one. 0 when normalized closing is invalid. Meaning unresolved.";
CM_ SG_ 122 AUX2_378_CANDIDATE_RAW "Signed 13-bit. Shares one subrecord with bits 480-487: both hold their defaults together (8190 here, signed -2; bits 480-487 zero) on about two thirds of observations. When populated, values follow the azimuth sign. Meaning unresolved; the earlier 384:7 probe is this field sign extension.";
CM_ SG_ 122 MATURITY_398_CANDIDATE_RAW "Counts down from about 6 to 1 as a track matures. Adds no velocity-error or survival information once track age is known. Upper-bit semantics unresolved.";
CM_ SG_ 122 AZIMUTH_CENTER_RAW "Unsigned, zero at 4096, positive left, 2^-12 rad per count (+-1 rad span; within 0.97-1.03 on nine recordings with 0.01 m lateral). Equals the midpoint of the two edge fields on 97-99.9% of observations.";
CM_ SG_ 122 AZIMUTH_EDGE_A_RAW "Left angular edge; same encoding as AZIMUTH_CENTER. Always at or left of the center. Clips at 8191 (+1 rad).";
CM_ SG_ 122 AZIMUTH_EDGE_B_RAW "Right angular edge; same encoding as AZIMUTH_CENTER. Clips at 0 (-1 rad) for near objects at the field-of-view edge. The edge difference is the Bosch A ANGULAR_WIDTH counterpart: it scales as 1/range within a track (log-log slope -0.91 to -0.99, ten recordings).";
CM_ SG_ 122 MOTION_CLASS_CANDIDATE_RAW "Observed 0, 2, 4. 4: same-direction traffic, and most objects seen only while ego is stopped. 2: oncoming or approaching, and most stationary objects seen while ego moves. 0: unassigned; young tracks, and every object on the 2026-09-10 and 2026-09-16 drives. Not a validated classifier.";
CM_ SG_ 122 ANGULAR_WIDTH_COARSE_CANDIDATE_RAW "Angular extent measure, about 1/range within a track. Not a fixed-scale copy of the edge width (forward vs inverse fits 6-21 vs 14-24 edge counts per unit). Not received power.";
CM_ SG_ 122 ANGULAR_WIDTH_COARSE_COPY_CANDIDATE_RAW "Byte 61 equals byte 59 on 99.7-100% of observations.";
CM_ SG_ 122 FLAG_106_CANDIDATE_RAW "Set on about 40% of newborn frames and 97-99% after 1 s; agrees with Y_COMPANION bit 78 on 96%. Meaning unresolved.";
CM_ SG_ 122 FLAG_107_CANDIDATE_RAW "Set on 0-3% of observations, mostly mature same-direction movers. Meaning unresolved.";
CM_ SG_ 122 ENUM_109_CANDIDATE_RAW "Values 0-4. 1 on most established tracks; 2-4 mostly on same-direction movers near the path with high existence. Not an object class (metric width about 1.7 m for all values) and not a left/right lane code. Meaning unresolved.";
CM_ SG_ 122 ANGULAR_WIDTH_480_RAW "Angular-width measure, raw units (accepted 2026-09-29 on held-out routes): follows the azimuth-edge width (Spearman >= 0.8) and scales as about 1/range within tracks on 57 of 60 routes. 0 while AUX2_378 holds its default.";
CM_ SG_ 122 EXISTENCE_PROBABILITY_RAW "Bosch A OBJECT_EXISTENCE_PROBABILITY counterpart (accepted, raw units). 0-49 only, 49 most common. Best survival predictor within range x age strata on ten recordings (AUC 0.67-0.92); falls over the last second before track death; low on short-lived ghosts. 0 marks a degraded measurement (accepted on held-out routes: range innovation and vRel steps at least 2x worse on 17 of 17). Probability scale unresolved.";
BA_ "VFrameFormat" BO_ 124 14;
CM_ SG_ 124 CRC16_RAW "Capture-verified CRC16: polynomial 0x1021, init 0xFFFF, no reflection or xorout; bytes 2:64 then little-endian data ID 0x0fb8.";
CM_ SG_ 124 OBJECT_ID_RAW "Observed 0 empty, 1 through 63 active. IDs move between wire slots and are reused.";
CM_ SG_ 124 LIFECYCLE_RAW "Observed +3 modulo 4096 per consecutive sweep for continuing IDs. Resets or discontinuities require a new track.";
CM_ SG_ 124 POSITION_X_RAW "Unsigned 12-bit, bits 48-59 (accepted 2026-09-28 on held-out routes; bit 60 belongs to OBJECT_CLASS_RAW). Working decode dRel = 0.05*raw-4.296 m (accepted). The stock dash draws HUD_OBJECTS LONG_DIST from raw/4. Normalized closing and azimuth both imply a sensor range origin about 2.3 m behind the dRel origin.";
CM_ SG_ 124 OBJECT_CLASS_RAW "Object class, bits 60-63. 1 car and 3 truck/large vehicle: accepted against the stock dash HUD_OBJECTS icons on held-out routes (99.6% and 99.2%). 6, 7 and 8 are not motorcycle, pedestrian and bicycle as such: against video within 25 m they name that object on 1 of 11, 3 of 13 and 3 of 12 clear labels, and are most often a car (2026-09-29). The stock dash shows icon 6 for moving two-wheelers, so its motorcycle icon adds a filter on top of class 6. 9-11 unconfirmed. Classes 1 and 3 never share a track with classes 6-11.";
CM_ SG_ 124 POSITION_Y_RAW "Low 13 bits of the 14-bit offset-binary lateral position (bits 64-77), positive left: Y = 0.01*(bits 64-77 - 8192) m (0.01 m/count accepted 2026-09-28; 14-bit extent accepted 2026-09-29 on held-out routes). Within +-40.95 m this equals the signed 13-bit value. 8191 with bit 77 clear encodes -1 and is not an invalid sentinel.";
CM_ SG_ 124 Y_COMPANION_RAW "Three separate fields. Bit 77: top bit of the 14-bit offset-binary lateral position; it is the inverse of bit 76 within +-40.95 m and carries the sign beyond it. Bits 78-79: life state 0 newborn, 1 established, 2 ending (2 on 6-26% of a track last three frames vs 0.1-4% mid-life, ten recordings).";
CM_ SG_ 124 VELOCITY_RAW "Working decode vRel = 0.1*(raw-1539) m/s (accepted). Raw 0 (-153.9 m/s) is a floor saturation seen on newborn far objects, not a sentinel.";
CM_ SG_ 124 LATERAL_VELOCITY_CANDIDATE_RAW "Lateral velocity 0.1*(raw-511) m/s, positive left, relative in the sensor frame (includes the apparent motion of stationary objects from ego yaw). Provisional 2026-09-28: local Y slope and gyro kinematics on held-out recordings, zero 510-511 on stationary scenes; one held-out bracket (0.1004-0.1085) misses 0.1.";
CM_ SG_ 124 NORMALIZED_RATE_CANDIDATE_RAW "Bosch A NORMALIZED_CLOSING counterpart (provisional). 0.001*(raw-40000) 1/s, approximately vRel/(dRel+2.3 m); follows Doppler vRel, not range change. 64999 = invalid, with TTC 0, TTC sigma 0 and normalized-closing sigma 0 in the same frame.";
CM_ SG_ 124 QUALITY_CONTAINER_RAW "Bits 144-153 (upper byte always 0). Bosch A RANGE_SIGMA candidate (provisional): range-noise specific on 8 of 10 recordings, weak (partial rho 0.08-0.25). Strongly range dependent. Units unknown. No validity gate.";
CM_ SG_ 124 REL_VELOCITY_UNCERTAINTY_RAW "Bosch A REL_VELOCITY_UNCERTAINTY counterpart (accepted, raw units): velocity-noise specific and monotonic with empirical vRel noise on ten recordings. Nonlinear in m/s; 1023 may be saturation.";
CM_ SG_ 124 UNCERTAINTY_160_CANDIDATE_RAW "Mostly 1-2; higher on young and laterally offset objects. Weak noise association. Units unknown.";
CM_ SG_ 124 ACQUISITION_186_CANDIDATE_RAW "Starts near 23 on newborn tracks and decays to about 2. Carries little information beyond track age.";
CM_ SG_ 124 UNCERTAINTY_192_CANDIDATE_RAW "Decays with age; mixed velocity and lateral noise association, not specific to one noise. Units unknown.";
CM_ SG_ 124 TTC_RAW "Time to collision (accepted 2026-09-28 on held-out routes), (raw-1024)/128 s: a constant-velocity TTC, equal to -1/normalized closing within 0.06-0.10 s median. Reported only while an acceleration-aware collision prediction expects impact (lagging it by about 1-2 s); otherwise 2046. 0 = invalid (normalized closing 64999). No Bosch A counterpart.";
CM_ SG_ 124 TTC_SIGMA_CANDIDATE_RAW "TTC uncertainty (provisional): raw = TTC^2 * NORMALIZED_CLOSING_SIGMA / 64 within 0.1-2.5% on ten recordings. 127 = saturated or not populated; 0 = invalid. Stays populated on 3-26% of frames where TTC is defaulted (TTC about 8-19 s).";
CM_ SG_ 124 WIDTH_FINE_258_CANDIDATE_RAW "Angular extent measure, about 1/range within a track. No fixed affine relation to the azimuth-edge width. Units unresolved.";
CM_ SG_ 124 NORMALIZED_CLOSING_SIGMA_RAW "Bosch A NORMALIZED_CLOSING_SIGMA counterpart (accepted, raw units): specific to normalized-closing noise and monotonic with it on ten recordings; tied to TTC_SIGMA by a fixed 1/64 ratio. 0 when normalized closing is invalid.";
CM_ SG_ 124 AUX_LATERAL_MOTION_304_CANDIDATE_RAW "Signed 16-bit two-complement. Follows lateral motion; scale unresolved (brackets 0.005-0.12 m/s per count). -1 when normalized closing is invalid.";
CM_ SG_ 124 AUX_LATERAL_DIRECTION_320_CANDIDATE_RAW "Set when AUX_LATERAL_MOTION_304 is nonnegative on 97-99% of observations.";
CM_ SG_ 124 AUX_328_CANDIDATE_RAW "Changes nearly every frame; weak association with lateral and angular noise, not specific to one. 0 when normalized closing is invalid. Meaning unresolved.";
CM_ SG_ 124 AUX2_378_CANDIDATE_RAW "Signed 13-bit. Shares one subrecord with bits 480-487: both hold their defaults together (8190 here, signed -2; bits 480-487 zero) on about two thirds of observations. When populated, values follow the azimuth sign. Meaning unresolved; the earlier 384:7 probe is this field sign extension.";
CM_ SG_ 124 MATURITY_398_CANDIDATE_RAW "Counts down from about 6 to 1 as a track matures. Adds no velocity-error or survival information once track age is known. Upper-bit semantics unresolved.";
CM_ SG_ 124 AZIMUTH_CENTER_RAW "Unsigned, zero at 4096, positive left, 2^-12 rad per count (+-1 rad span; within 0.97-1.03 on nine recordings with 0.01 m lateral). Equals the midpoint of the two edge fields on 97-99.9% of observations.";
CM_ SG_ 124 AZIMUTH_EDGE_A_RAW "Left angular edge; same encoding as AZIMUTH_CENTER. Always at or left of the center. Clips at 8191 (+1 rad).";
CM_ SG_ 124 AZIMUTH_EDGE_B_RAW "Right angular edge; same encoding as AZIMUTH_CENTER. Clips at 0 (-1 rad) for near objects at the field-of-view edge. The edge difference is the Bosch A ANGULAR_WIDTH counterpart: it scales as 1/range within a track (log-log slope -0.91 to -0.99, ten recordings).";
CM_ SG_ 124 MOTION_CLASS_CANDIDATE_RAW "Observed 0, 2, 4. 4: same-direction traffic, and most objects seen only while ego is stopped. 2: oncoming or approaching, and most stationary objects seen while ego moves. 0: unassigned; young tracks, and every object on the 2026-09-10 and 2026-09-16 drives. Not a validated classifier.";
CM_ SG_ 124 ANGULAR_WIDTH_COARSE_CANDIDATE_RAW "Angular extent measure, about 1/range within a track. Not a fixed-scale copy of the edge width (forward vs inverse fits 6-21 vs 14-24 edge counts per unit). Not received power.";
CM_ SG_ 124 ANGULAR_WIDTH_COARSE_COPY_CANDIDATE_RAW "Byte 61 equals byte 59 on 99.7-100% of observations.";
CM_ SG_ 124 FLAG_106_CANDIDATE_RAW "Set on about 40% of newborn frames and 97-99% after 1 s; agrees with Y_COMPANION bit 78 on 96%. Meaning unresolved.";
CM_ SG_ 124 FLAG_107_CANDIDATE_RAW "Set on 0-3% of observations, mostly mature same-direction movers. Meaning unresolved.";
CM_ SG_ 124 ENUM_109_CANDIDATE_RAW "Values 0-4. 1 on most established tracks; 2-4 mostly on same-direction movers near the path with high existence. Not an object class (metric width about 1.7 m for all values) and not a left/right lane code. Meaning unresolved.";
CM_ SG_ 124 ANGULAR_WIDTH_480_RAW "Angular-width measure, raw units (accepted 2026-09-29 on held-out routes): follows the azimuth-edge width (Spearman >= 0.8) and scales as about 1/range within tracks on 57 of 60 routes. 0 while AUX2_378 holds its default.";
CM_ SG_ 124 EXISTENCE_PROBABILITY_RAW "Bosch A OBJECT_EXISTENCE_PROBABILITY counterpart (accepted, raw units). 0-49 only, 49 most common. Best survival predictor within range x age strata on ten recordings (AUC 0.67-0.92); falls over the last second before track death; low on short-lived ghosts. 0 marks a degraded measurement (accepted on held-out routes: range innovation and vRel steps at least 2x worse on 17 of 17). Probability scale unresolved.";
BA_ "VFrameFormat" BO_ 126 14;
CM_ SG_ 126 CRC16_RAW "Capture-verified CRC16: polynomial 0x1021, init 0xFFFF, no reflection or xorout; bytes 2:64 then little-endian data ID 0x0fb9.";
CM_ SG_ 126 OBJECT_ID_RAW "Observed 0 empty, 1 through 63 active. IDs move between wire slots and are reused.";
CM_ SG_ 126 LIFECYCLE_RAW "Observed +3 modulo 4096 per consecutive sweep for continuing IDs. Resets or discontinuities require a new track.";
CM_ SG_ 126 POSITION_X_RAW "Unsigned 12-bit, bits 48-59 (accepted 2026-09-28 on held-out routes; bit 60 belongs to OBJECT_CLASS_RAW). Working decode dRel = 0.05*raw-4.296 m (accepted). The stock dash draws HUD_OBJECTS LONG_DIST from raw/4. Normalized closing and azimuth both imply a sensor range origin about 2.3 m behind the dRel origin.";
CM_ SG_ 126 OBJECT_CLASS_RAW "Object class, bits 60-63. 1 car and 3 truck/large vehicle: accepted against the stock dash HUD_OBJECTS icons on held-out routes (99.6% and 99.2%). 6, 7 and 8 are not motorcycle, pedestrian and bicycle as such: against video within 25 m they name that object on 1 of 11, 3 of 13 and 3 of 12 clear labels, and are most often a car (2026-09-29). The stock dash shows icon 6 for moving two-wheelers, so its motorcycle icon adds a filter on top of class 6. 9-11 unconfirmed. Classes 1 and 3 never share a track with classes 6-11.";
CM_ SG_ 126 POSITION_Y_RAW "Low 13 bits of the 14-bit offset-binary lateral position (bits 64-77), positive left: Y = 0.01*(bits 64-77 - 8192) m (0.01 m/count accepted 2026-09-28; 14-bit extent accepted 2026-09-29 on held-out routes). Within +-40.95 m this equals the signed 13-bit value. 8191 with bit 77 clear encodes -1 and is not an invalid sentinel.";
CM_ SG_ 126 Y_COMPANION_RAW "Three separate fields. Bit 77: top bit of the 14-bit offset-binary lateral position; it is the inverse of bit 76 within +-40.95 m and carries the sign beyond it. Bits 78-79: life state 0 newborn, 1 established, 2 ending (2 on 6-26% of a track last three frames vs 0.1-4% mid-life, ten recordings).";
CM_ SG_ 126 VELOCITY_RAW "Working decode vRel = 0.1*(raw-1539) m/s (accepted). Raw 0 (-153.9 m/s) is a floor saturation seen on newborn far objects, not a sentinel.";
CM_ SG_ 126 LATERAL_VELOCITY_CANDIDATE_RAW "Lateral velocity 0.1*(raw-511) m/s, positive left, relative in the sensor frame (includes the apparent motion of stationary objects from ego yaw). Provisional 2026-09-28: local Y slope and gyro kinematics on held-out recordings, zero 510-511 on stationary scenes; one held-out bracket (0.1004-0.1085) misses 0.1.";
CM_ SG_ 126 NORMALIZED_RATE_CANDIDATE_RAW "Bosch A NORMALIZED_CLOSING counterpart (provisional). 0.001*(raw-40000) 1/s, approximately vRel/(dRel+2.3 m); follows Doppler vRel, not range change. 64999 = invalid, with TTC 0, TTC sigma 0 and normalized-closing sigma 0 in the same frame.";
CM_ SG_ 126 QUALITY_CONTAINER_RAW "Bits 144-153 (upper byte always 0). Bosch A RANGE_SIGMA candidate (provisional): range-noise specific on 8 of 10 recordings, weak (partial rho 0.08-0.25). Strongly range dependent. Units unknown. No validity gate.";
CM_ SG_ 126 REL_VELOCITY_UNCERTAINTY_RAW "Bosch A REL_VELOCITY_UNCERTAINTY counterpart (accepted, raw units): velocity-noise specific and monotonic with empirical vRel noise on ten recordings. Nonlinear in m/s; 1023 may be saturation.";
CM_ SG_ 126 UNCERTAINTY_160_CANDIDATE_RAW "Mostly 1-2; higher on young and laterally offset objects. Weak noise association. Units unknown.";
CM_ SG_ 126 ACQUISITION_186_CANDIDATE_RAW "Starts near 23 on newborn tracks and decays to about 2. Carries little information beyond track age.";
CM_ SG_ 126 UNCERTAINTY_192_CANDIDATE_RAW "Decays with age; mixed velocity and lateral noise association, not specific to one noise. Units unknown.";
CM_ SG_ 126 TTC_RAW "Time to collision (accepted 2026-09-28 on held-out routes), (raw-1024)/128 s: a constant-velocity TTC, equal to -1/normalized closing within 0.06-0.10 s median. Reported only while an acceleration-aware collision prediction expects impact (lagging it by about 1-2 s); otherwise 2046. 0 = invalid (normalized closing 64999). No Bosch A counterpart.";
CM_ SG_ 126 TTC_SIGMA_CANDIDATE_RAW "TTC uncertainty (provisional): raw = TTC^2 * NORMALIZED_CLOSING_SIGMA / 64 within 0.1-2.5% on ten recordings. 127 = saturated or not populated; 0 = invalid. Stays populated on 3-26% of frames where TTC is defaulted (TTC about 8-19 s).";
CM_ SG_ 126 WIDTH_FINE_258_CANDIDATE_RAW "Angular extent measure, about 1/range within a track. No fixed affine relation to the azimuth-edge width. Units unresolved.";
CM_ SG_ 126 NORMALIZED_CLOSING_SIGMA_RAW "Bosch A NORMALIZED_CLOSING_SIGMA counterpart (accepted, raw units): specific to normalized-closing noise and monotonic with it on ten recordings; tied to TTC_SIGMA by a fixed 1/64 ratio. 0 when normalized closing is invalid.";
CM_ SG_ 126 AUX_LATERAL_MOTION_304_CANDIDATE_RAW "Signed 16-bit two-complement. Follows lateral motion; scale unresolved (brackets 0.005-0.12 m/s per count). -1 when normalized closing is invalid.";
CM_ SG_ 126 AUX_LATERAL_DIRECTION_320_CANDIDATE_RAW "Set when AUX_LATERAL_MOTION_304 is nonnegative on 97-99% of observations.";
CM_ SG_ 126 AUX_328_CANDIDATE_RAW "Changes nearly every frame; weak association with lateral and angular noise, not specific to one. 0 when normalized closing is invalid. Meaning unresolved.";
CM_ SG_ 126 AUX2_378_CANDIDATE_RAW "Signed 13-bit. Shares one subrecord with bits 480-487: both hold their defaults together (8190 here, signed -2; bits 480-487 zero) on about two thirds of observations. When populated, values follow the azimuth sign. Meaning unresolved; the earlier 384:7 probe is this field sign extension.";
CM_ SG_ 126 MATURITY_398_CANDIDATE_RAW "Counts down from about 6 to 1 as a track matures. Adds no velocity-error or survival information once track age is known. Upper-bit semantics unresolved.";
CM_ SG_ 126 AZIMUTH_CENTER_RAW "Unsigned, zero at 4096, positive left, 2^-12 rad per count (+-1 rad span; within 0.97-1.03 on nine recordings with 0.01 m lateral). Equals the midpoint of the two edge fields on 97-99.9% of observations.";
CM_ SG_ 126 AZIMUTH_EDGE_A_RAW "Left angular edge; same encoding as AZIMUTH_CENTER. Always at or left of the center. Clips at 8191 (+1 rad).";
CM_ SG_ 126 AZIMUTH_EDGE_B_RAW "Right angular edge; same encoding as AZIMUTH_CENTER. Clips at 0 (-1 rad) for near objects at the field-of-view edge. The edge difference is the Bosch A ANGULAR_WIDTH counterpart: it scales as 1/range within a track (log-log slope -0.91 to -0.99, ten recordings).";
CM_ SG_ 126 MOTION_CLASS_CANDIDATE_RAW "Observed 0, 2, 4. 4: same-direction traffic, and most objects seen only while ego is stopped. 2: oncoming or approaching, and most stationary objects seen while ego moves. 0: unassigned; young tracks, and every object on the 2026-09-10 and 2026-09-16 drives. Not a validated classifier.";
CM_ SG_ 126 ANGULAR_WIDTH_COARSE_CANDIDATE_RAW "Angular extent measure, about 1/range within a track. Not a fixed-scale copy of the edge width (forward vs inverse fits 6-21 vs 14-24 edge counts per unit). Not received power.";
CM_ SG_ 126 ANGULAR_WIDTH_COARSE_COPY_CANDIDATE_RAW "Byte 61 equals byte 59 on 99.7-100% of observations.";
CM_ SG_ 126 FLAG_106_CANDIDATE_RAW "Set on about 40% of newborn frames and 97-99% after 1 s; agrees with Y_COMPANION bit 78 on 96%. Meaning unresolved.";
CM_ SG_ 126 FLAG_107_CANDIDATE_RAW "Set on 0-3% of observations, mostly mature same-direction movers. Meaning unresolved.";
CM_ SG_ 126 ENUM_109_CANDIDATE_RAW "Values 0-4. 1 on most established tracks; 2-4 mostly on same-direction movers near the path with high existence. Not an object class (metric width about 1.7 m for all values) and not a left/right lane code. Meaning unresolved.";
CM_ SG_ 126 ANGULAR_WIDTH_480_RAW "Angular-width measure, raw units (accepted 2026-09-29 on held-out routes): follows the azimuth-edge width (Spearman >= 0.8) and scales as about 1/range within tracks on 57 of 60 routes. 0 while AUX2_378 holds its default.";
CM_ SG_ 126 EXISTENCE_PROBABILITY_RAW "Bosch A OBJECT_EXISTENCE_PROBABILITY counterpart (accepted, raw units). 0-49 only, 49 most common. Best survival predictor within range x age strata on ten recordings (AUC 0.67-0.92); falls over the last second before track death; low on short-lived ghosts. 0 marks a degraded measurement (accepted on held-out routes: range innovation and vRel steps at least 2x worse on 17 of 17). Probability scale unresolved.";
BA_ "VFrameFormat" BO_ 128 14;
CM_ SG_ 128 CRC16_RAW "Capture-verified CRC16: polynomial 0x1021, init 0xFFFF, no reflection or xorout; bytes 2:64 then little-endian data ID 0x0fba.";
CM_ SG_ 128 OBJECT_ID_RAW "Observed 0 empty, 1 through 63 active. IDs move between wire slots and are reused.";
CM_ SG_ 128 LIFECYCLE_RAW "Observed +3 modulo 4096 per consecutive sweep for continuing IDs. Resets or discontinuities require a new track.";
CM_ SG_ 128 POSITION_X_RAW "Unsigned 12-bit, bits 48-59 (accepted 2026-09-28 on held-out routes; bit 60 belongs to OBJECT_CLASS_RAW). Working decode dRel = 0.05*raw-4.296 m (accepted). The stock dash draws HUD_OBJECTS LONG_DIST from raw/4. Normalized closing and azimuth both imply a sensor range origin about 2.3 m behind the dRel origin.";
CM_ SG_ 128 OBJECT_CLASS_RAW "Object class, bits 60-63. 1 car and 3 truck/large vehicle: accepted against the stock dash HUD_OBJECTS icons on held-out routes (99.6% and 99.2%). 6, 7 and 8 are not motorcycle, pedestrian and bicycle as such: against video within 25 m they name that object on 1 of 11, 3 of 13 and 3 of 12 clear labels, and are most often a car (2026-09-29). The stock dash shows icon 6 for moving two-wheelers, so its motorcycle icon adds a filter on top of class 6. 9-11 unconfirmed. Classes 1 and 3 never share a track with classes 6-11.";
CM_ SG_ 128 POSITION_Y_RAW "Low 13 bits of the 14-bit offset-binary lateral position (bits 64-77), positive left: Y = 0.01*(bits 64-77 - 8192) m (0.01 m/count accepted 2026-09-28; 14-bit extent accepted 2026-09-29 on held-out routes). Within +-40.95 m this equals the signed 13-bit value. 8191 with bit 77 clear encodes -1 and is not an invalid sentinel.";
CM_ SG_ 128 Y_COMPANION_RAW "Three separate fields. Bit 77: top bit of the 14-bit offset-binary lateral position; it is the inverse of bit 76 within +-40.95 m and carries the sign beyond it. Bits 78-79: life state 0 newborn, 1 established, 2 ending (2 on 6-26% of a track last three frames vs 0.1-4% mid-life, ten recordings).";
CM_ SG_ 128 VELOCITY_RAW "Working decode vRel = 0.1*(raw-1539) m/s (accepted). Raw 0 (-153.9 m/s) is a floor saturation seen on newborn far objects, not a sentinel.";
CM_ SG_ 128 LATERAL_VELOCITY_CANDIDATE_RAW "Lateral velocity 0.1*(raw-511) m/s, positive left, relative in the sensor frame (includes the apparent motion of stationary objects from ego yaw). Provisional 2026-09-28: local Y slope and gyro kinematics on held-out recordings, zero 510-511 on stationary scenes; one held-out bracket (0.1004-0.1085) misses 0.1.";
CM_ SG_ 128 NORMALIZED_RATE_CANDIDATE_RAW "Bosch A NORMALIZED_CLOSING counterpart (provisional). 0.001*(raw-40000) 1/s, approximately vRel/(dRel+2.3 m); follows Doppler vRel, not range change. 64999 = invalid, with TTC 0, TTC sigma 0 and normalized-closing sigma 0 in the same frame.";
CM_ SG_ 128 QUALITY_CONTAINER_RAW "Bits 144-153 (upper byte always 0). Bosch A RANGE_SIGMA candidate (provisional): range-noise specific on 8 of 10 recordings, weak (partial rho 0.08-0.25). Strongly range dependent. Units unknown. No validity gate.";
CM_ SG_ 128 REL_VELOCITY_UNCERTAINTY_RAW "Bosch A REL_VELOCITY_UNCERTAINTY counterpart (accepted, raw units): velocity-noise specific and monotonic with empirical vRel noise on ten recordings. Nonlinear in m/s; 1023 may be saturation.";
CM_ SG_ 128 UNCERTAINTY_160_CANDIDATE_RAW "Mostly 1-2; higher on young and laterally offset objects. Weak noise association. Units unknown.";
CM_ SG_ 128 ACQUISITION_186_CANDIDATE_RAW "Starts near 23 on newborn tracks and decays to about 2. Carries little information beyond track age.";
CM_ SG_ 128 UNCERTAINTY_192_CANDIDATE_RAW "Decays with age; mixed velocity and lateral noise association, not specific to one noise. Units unknown.";
CM_ SG_ 128 TTC_RAW "Time to collision (accepted 2026-09-28 on held-out routes), (raw-1024)/128 s: a constant-velocity TTC, equal to -1/normalized closing within 0.06-0.10 s median. Reported only while an acceleration-aware collision prediction expects impact (lagging it by about 1-2 s); otherwise 2046. 0 = invalid (normalized closing 64999). No Bosch A counterpart.";
CM_ SG_ 128 TTC_SIGMA_CANDIDATE_RAW "TTC uncertainty (provisional): raw = TTC^2 * NORMALIZED_CLOSING_SIGMA / 64 within 0.1-2.5% on ten recordings. 127 = saturated or not populated; 0 = invalid. Stays populated on 3-26% of frames where TTC is defaulted (TTC about 8-19 s).";
CM_ SG_ 128 WIDTH_FINE_258_CANDIDATE_RAW "Angular extent measure, about 1/range within a track. No fixed affine relation to the azimuth-edge width. Units unresolved.";
CM_ SG_ 128 NORMALIZED_CLOSING_SIGMA_RAW "Bosch A NORMALIZED_CLOSING_SIGMA counterpart (accepted, raw units): specific to normalized-closing noise and monotonic with it on ten recordings; tied to TTC_SIGMA by a fixed 1/64 ratio. 0 when normalized closing is invalid.";
CM_ SG_ 128 AUX_LATERAL_MOTION_304_CANDIDATE_RAW "Signed 16-bit two-complement. Follows lateral motion; scale unresolved (brackets 0.005-0.12 m/s per count). -1 when normalized closing is invalid.";
CM_ SG_ 128 AUX_LATERAL_DIRECTION_320_CANDIDATE_RAW "Set when AUX_LATERAL_MOTION_304 is nonnegative on 97-99% of observations.";
CM_ SG_ 128 AUX_328_CANDIDATE_RAW "Changes nearly every frame; weak association with lateral and angular noise, not specific to one. 0 when normalized closing is invalid. Meaning unresolved.";
CM_ SG_ 128 AUX2_378_CANDIDATE_RAW "Signed 13-bit. Shares one subrecord with bits 480-487: both hold their defaults together (8190 here, signed -2; bits 480-487 zero) on about two thirds of observations. When populated, values follow the azimuth sign. Meaning unresolved; the earlier 384:7 probe is this field sign extension.";
CM_ SG_ 128 MATURITY_398_CANDIDATE_RAW "Counts down from about 6 to 1 as a track matures. Adds no velocity-error or survival information once track age is known. Upper-bit semantics unresolved.";
CM_ SG_ 128 AZIMUTH_CENTER_RAW "Unsigned, zero at 4096, positive left, 2^-12 rad per count (+-1 rad span; within 0.97-1.03 on nine recordings with 0.01 m lateral). Equals the midpoint of the two edge fields on 97-99.9% of observations.";
CM_ SG_ 128 AZIMUTH_EDGE_A_RAW "Left angular edge; same encoding as AZIMUTH_CENTER. Always at or left of the center. Clips at 8191 (+1 rad).";
CM_ SG_ 128 AZIMUTH_EDGE_B_RAW "Right angular edge; same encoding as AZIMUTH_CENTER. Clips at 0 (-1 rad) for near objects at the field-of-view edge. The edge difference is the Bosch A ANGULAR_WIDTH counterpart: it scales as 1/range within a track (log-log slope -0.91 to -0.99, ten recordings).";
CM_ SG_ 128 MOTION_CLASS_CANDIDATE_RAW "Observed 0, 2, 4. 4: same-direction traffic, and most objects seen only while ego is stopped. 2: oncoming or approaching, and most stationary objects seen while ego moves. 0: unassigned; young tracks, and every object on the 2026-09-10 and 2026-09-16 drives. Not a validated classifier.";
CM_ SG_ 128 ANGULAR_WIDTH_COARSE_CANDIDATE_RAW "Angular extent measure, about 1/range within a track. Not a fixed-scale copy of the edge width (forward vs inverse fits 6-21 vs 14-24 edge counts per unit). Not received power.";
CM_ SG_ 128 ANGULAR_WIDTH_COARSE_COPY_CANDIDATE_RAW "Byte 61 equals byte 59 on 99.7-100% of observations.";
CM_ SG_ 128 FLAG_106_CANDIDATE_RAW "Set on about 40% of newborn frames and 97-99% after 1 s; agrees with Y_COMPANION bit 78 on 96%. Meaning unresolved.";
CM_ SG_ 128 FLAG_107_CANDIDATE_RAW "Set on 0-3% of observations, mostly mature same-direction movers. Meaning unresolved.";
CM_ SG_ 128 ENUM_109_CANDIDATE_RAW "Values 0-4. 1 on most established tracks; 2-4 mostly on same-direction movers near the path with high existence. Not an object class (metric width about 1.7 m for all values) and not a left/right lane code. Meaning unresolved.";
CM_ SG_ 128 ANGULAR_WIDTH_480_RAW "Angular-width measure, raw units (accepted 2026-09-29 on held-out routes): follows the azimuth-edge width (Spearman >= 0.8) and scales as about 1/range within tracks on 57 of 60 routes. 0 while AUX2_378 holds its default.";
CM_ SG_ 128 EXISTENCE_PROBABILITY_RAW "Bosch A OBJECT_EXISTENCE_PROBABILITY counterpart (accepted, raw units). 0-49 only, 49 most common. Best survival predictor within range x age strata on ten recordings (AUC 0.67-0.92); falls over the last second before track death; low on short-lived ghosts. 0 marks a degraded measurement (accepted on held-out routes: range innovation and vRel steps at least 2x worse on 17 of 17). Probability scale unresolved.";
BA_ "VFrameFormat" BO_ 1025 14;
CM_ BO_ 1025 "On the private camera-radar bus (bus 1), 50 Hz, sender not identified. Carries ego motion under stock longitudinal control; the fields read 0 under openpilot longitudinal (all 9 alpha routes).";
CM_ SG_ 1025 YAW_RATE "Accepted 2026-09-29: matches the calibrated gyro yaw rate within 0.004 rad/s median with r >= 0.99 on 48 of 50 held-out stock routes. Positive left. Byte 45 bits 6-0 then byte 46 bits 7-3.";
CM_ SG_ 1025 LAT_ACCEL "Accepted 2026-09-29: lateral acceleration, positive left, about 0.02 g per count; matches vEgo x calibrated yaw rate within 0.15 m/s^2 median with r >= 0.95 on 49 of 50 held-out stock routes. Byte 10.";
CM_ SG_ 1025 SPEED_CANDIDATE_RAW "Ego speed, provisional: 0.0683*raw+0.054 m/s against vEgo (median error 0.07 m/s; passes on 59 of 59 held-out stock routes; the held-out rule failed only on alpha routes, where it reads 0). Byte 3 then byte 4 bits 7-6.";
CM_ SG_ 1025 STEER_ANGLE_CANDIDATE_RAW "Steering angle, provisional: raw is positive right; -2.008*raw+0.3 gives carState steeringAngleDeg in deg (positive left), median error about 1 deg; passes on 59 of 59 held-out stock routes.";
CM_ SG_ 1025 ACCEL_CANDIDATE_RAW "Longitudinal acceleration, provisional: -0.1896*raw m/s^2 against carState aEgo, median error 0.08 m/s^2; passes on 59 of 59 held-out stock routes.";
BA_ "VFrameFormat" BO_ 200 14;
CM_ BO_ 200 "The stock camera's lane lines for the ego lane, sent to the radar on the private camera-radar bus (bus 1) at 15 Hz: left line in bits 24-138, right line in bits 139-253. 0xCA (next lines out), 0xCC and 0xCE share the layout; they, and each line's heading, curvature and quality fields, are candidates only.";
CM_ SG_ 200 LEFT_LINE_OFFSET "Accepted 2026-09-29: lateral offset of the left line, (raw-2048)/128 m, positive left; 2048 with no line. On 16 held-out routes 0.8484*offset+0.2399 m matches the model lane line 0.2 s earlier within 0.042 m median, slope 1.010. The 1/128 m scale is physically plausible: left minus right offset at highway speed is 3.52 m median on 10 held-out routes (model 3.39 m), close to 3.6-3.7 m US freeway lanes.";
CM_ SG_ 200 LEFT_LINE_CODE "7 = no line (accepted 2026-09-29 by user decision). Where the model lane probability is below 0.2 it reads 7 on 90.5% of held-out frames, against a frozen 95%; the rest are mostly lines the model doubts, visible on video in 7 of 12 sampled frames. 0-4 when a line is reported (line type, candidate). Raised median curbs can read as lines.";
CM_ SG_ 200 RIGHT_LINE_OFFSET "Accepted 2026-09-29: lateral offset of the right line, (raw-2048)/128 m, positive left; 2048 with no line. On 16 held-out routes 0.8796*offset-0.0968 m matches the model lane line 0.2 s earlier within 0.043 m median, slope 0.995. Scale check: see LEFT_LINE_OFFSET.";
CM_ SG_ 200 RIGHT_LINE_CODE "7 = no line (accepted 2026-09-29 by user decision). Where the model lane probability is below 0.2 it reads 7 on 92.1% of held-out frames, against a frozen 95%. 0-4 when a line is reported (line type, candidate).";
CM_ SG_ 114 DREL "Accepted working decode 0.05*raw-4.296 m from the 12-bit range, aligned to the HUD lead position (not the sensor origin, about 2.3 m further back).";
CM_ SG_ 114 YREL "Accepted working decode 0.01*(raw-8192) m, 14-bit offset binary at bits 64-77, positive left. The earlier signed 13-bit decode wraps at +-40.96 m.";
CM_ SG_ 114 VREL "Accepted working decode 0.1*(raw-1539) m/s. Raw 0 (-153.9 m/s) is a saturation on newborn far objects.";
CM_ SG_ 114 AZIMUTH_CENTER "Accepted: 2^-12 rad per count, zero at raw 4096, positive left.";
CM_ SG_ 114 AZIMUTH_EDGE_A "Accepted: left edge, same encoding as AZIMUTH_CENTER. Clips at +1 rad.";
CM_ SG_ 114 AZIMUTH_EDGE_B "Accepted: right edge, same encoding as AZIMUTH_CENTER. Clips at -1 rad.";
CM_ SG_ 114 TTC "Accepted: (raw-1024)/128 s constant-velocity TTC. Raw 2046 (7.98 s) = not reported, raw 0 = invalid; see TTC_RAW.";
CM_ SG_ 116 DREL "Accepted working decode 0.05*raw-4.296 m from the 12-bit range, aligned to the HUD lead position (not the sensor origin, about 2.3 m further back).";
CM_ SG_ 116 YREL "Accepted working decode 0.01*(raw-8192) m, 14-bit offset binary at bits 64-77, positive left. The earlier signed 13-bit decode wraps at +-40.96 m.";
CM_ SG_ 116 VREL "Accepted working decode 0.1*(raw-1539) m/s. Raw 0 (-153.9 m/s) is a saturation on newborn far objects.";
CM_ SG_ 116 AZIMUTH_CENTER "Accepted: 2^-12 rad per count, zero at raw 4096, positive left.";
CM_ SG_ 116 AZIMUTH_EDGE_A "Accepted: left edge, same encoding as AZIMUTH_CENTER. Clips at +1 rad.";
CM_ SG_ 116 AZIMUTH_EDGE_B "Accepted: right edge, same encoding as AZIMUTH_CENTER. Clips at -1 rad.";
CM_ SG_ 116 TTC "Accepted: (raw-1024)/128 s constant-velocity TTC. Raw 2046 (7.98 s) = not reported, raw 0 = invalid; see TTC_RAW.";
CM_ SG_ 118 DREL "Accepted working decode 0.05*raw-4.296 m from the 12-bit range, aligned to the HUD lead position (not the sensor origin, about 2.3 m further back).";
CM_ SG_ 118 YREL "Accepted working decode 0.01*(raw-8192) m, 14-bit offset binary at bits 64-77, positive left. The earlier signed 13-bit decode wraps at +-40.96 m.";
CM_ SG_ 118 VREL "Accepted working decode 0.1*(raw-1539) m/s. Raw 0 (-153.9 m/s) is a saturation on newborn far objects.";
CM_ SG_ 118 AZIMUTH_CENTER "Accepted: 2^-12 rad per count, zero at raw 4096, positive left.";
CM_ SG_ 118 AZIMUTH_EDGE_A "Accepted: left edge, same encoding as AZIMUTH_CENTER. Clips at +1 rad.";
CM_ SG_ 118 AZIMUTH_EDGE_B "Accepted: right edge, same encoding as AZIMUTH_CENTER. Clips at -1 rad.";
CM_ SG_ 118 TTC "Accepted: (raw-1024)/128 s constant-velocity TTC. Raw 2046 (7.98 s) = not reported, raw 0 = invalid; see TTC_RAW.";
CM_ SG_ 120 DREL "Accepted working decode 0.05*raw-4.296 m from the 12-bit range, aligned to the HUD lead position (not the sensor origin, about 2.3 m further back).";
CM_ SG_ 120 YREL "Accepted working decode 0.01*(raw-8192) m, 14-bit offset binary at bits 64-77, positive left. The earlier signed 13-bit decode wraps at +-40.96 m.";
CM_ SG_ 120 VREL "Accepted working decode 0.1*(raw-1539) m/s. Raw 0 (-153.9 m/s) is a saturation on newborn far objects.";
CM_ SG_ 120 AZIMUTH_CENTER "Accepted: 2^-12 rad per count, zero at raw 4096, positive left.";
CM_ SG_ 120 AZIMUTH_EDGE_A "Accepted: left edge, same encoding as AZIMUTH_CENTER. Clips at +1 rad.";
CM_ SG_ 120 AZIMUTH_EDGE_B "Accepted: right edge, same encoding as AZIMUTH_CENTER. Clips at -1 rad.";
CM_ SG_ 120 TTC "Accepted: (raw-1024)/128 s constant-velocity TTC. Raw 2046 (7.98 s) = not reported, raw 0 = invalid; see TTC_RAW.";
CM_ SG_ 122 DREL "Accepted working decode 0.05*raw-4.296 m from the 12-bit range, aligned to the HUD lead position (not the sensor origin, about 2.3 m further back).";
CM_ SG_ 122 YREL "Accepted working decode 0.01*(raw-8192) m, 14-bit offset binary at bits 64-77, positive left. The earlier signed 13-bit decode wraps at +-40.96 m.";
CM_ SG_ 122 VREL "Accepted working decode 0.1*(raw-1539) m/s. Raw 0 (-153.9 m/s) is a saturation on newborn far objects.";
CM_ SG_ 122 AZIMUTH_CENTER "Accepted: 2^-12 rad per count, zero at raw 4096, positive left.";
CM_ SG_ 122 AZIMUTH_EDGE_A "Accepted: left edge, same encoding as AZIMUTH_CENTER. Clips at +1 rad.";
CM_ SG_ 122 AZIMUTH_EDGE_B "Accepted: right edge, same encoding as AZIMUTH_CENTER. Clips at -1 rad.";
CM_ SG_ 122 TTC "Accepted: (raw-1024)/128 s constant-velocity TTC. Raw 2046 (7.98 s) = not reported, raw 0 = invalid; see TTC_RAW.";
CM_ SG_ 124 DREL "Accepted working decode 0.05*raw-4.296 m from the 12-bit range, aligned to the HUD lead position (not the sensor origin, about 2.3 m further back).";
CM_ SG_ 124 YREL "Accepted working decode 0.01*(raw-8192) m, 14-bit offset binary at bits 64-77, positive left. The earlier signed 13-bit decode wraps at +-40.96 m.";
CM_ SG_ 124 VREL "Accepted working decode 0.1*(raw-1539) m/s. Raw 0 (-153.9 m/s) is a saturation on newborn far objects.";
CM_ SG_ 124 AZIMUTH_CENTER "Accepted: 2^-12 rad per count, zero at raw 4096, positive left.";
CM_ SG_ 124 AZIMUTH_EDGE_A "Accepted: left edge, same encoding as AZIMUTH_CENTER. Clips at +1 rad.";
CM_ SG_ 124 AZIMUTH_EDGE_B "Accepted: right edge, same encoding as AZIMUTH_CENTER. Clips at -1 rad.";
CM_ SG_ 124 TTC "Accepted: (raw-1024)/128 s constant-velocity TTC. Raw 2046 (7.98 s) = not reported, raw 0 = invalid; see TTC_RAW.";
CM_ SG_ 126 DREL "Accepted working decode 0.05*raw-4.296 m from the 12-bit range, aligned to the HUD lead position (not the sensor origin, about 2.3 m further back).";
CM_ SG_ 126 YREL "Accepted working decode 0.01*(raw-8192) m, 14-bit offset binary at bits 64-77, positive left. The earlier signed 13-bit decode wraps at +-40.96 m.";
CM_ SG_ 126 VREL "Accepted working decode 0.1*(raw-1539) m/s. Raw 0 (-153.9 m/s) is a saturation on newborn far objects.";
CM_ SG_ 126 AZIMUTH_CENTER "Accepted: 2^-12 rad per count, zero at raw 4096, positive left.";
CM_ SG_ 126 AZIMUTH_EDGE_A "Accepted: left edge, same encoding as AZIMUTH_CENTER. Clips at +1 rad.";
CM_ SG_ 126 AZIMUTH_EDGE_B "Accepted: right edge, same encoding as AZIMUTH_CENTER. Clips at -1 rad.";
CM_ SG_ 126 TTC "Accepted: (raw-1024)/128 s constant-velocity TTC. Raw 2046 (7.98 s) = not reported, raw 0 = invalid; see TTC_RAW.";
CM_ SG_ 128 DREL "Accepted working decode 0.05*raw-4.296 m from the 12-bit range, aligned to the HUD lead position (not the sensor origin, about 2.3 m further back).";
CM_ SG_ 128 YREL "Accepted working decode 0.01*(raw-8192) m, 14-bit offset binary at bits 64-77, positive left. The earlier signed 13-bit decode wraps at +-40.96 m.";
CM_ SG_ 128 VREL "Accepted working decode 0.1*(raw-1539) m/s. Raw 0 (-153.9 m/s) is a saturation on newborn far objects.";
CM_ SG_ 128 AZIMUTH_CENTER "Accepted: 2^-12 rad per count, zero at raw 4096, positive left.";
CM_ SG_ 128 AZIMUTH_EDGE_A "Accepted: left edge, same encoding as AZIMUTH_CENTER. Clips at +1 rad.";
CM_ SG_ 128 AZIMUTH_EDGE_B "Accepted: right edge, same encoding as AZIMUTH_CENTER. Clips at -1 rad.";
CM_ SG_ 128 TTC "Accepted: (raw-1024)/128 s constant-velocity TTC. Raw 2046 (7.98 s) = not reported, raw 0 = invalid; see TTC_RAW.";
VAL_ 114 OBJECT_CLASS_RAW 3 "TRUCK" 1 "CAR" ;
VAL_ 116 OBJECT_CLASS_RAW 3 "TRUCK" 1 "CAR" ;
VAL_ 118 OBJECT_CLASS_RAW 3 "TRUCK" 1 "CAR" ;
VAL_ 120 OBJECT_CLASS_RAW 3 "TRUCK" 1 "CAR" ;
VAL_ 122 OBJECT_CLASS_RAW 3 "TRUCK" 1 "CAR" ;
VAL_ 124 OBJECT_CLASS_RAW 3 "TRUCK" 1 "CAR" ;
VAL_ 126 OBJECT_CLASS_RAW 3 "TRUCK" 1 "CAR" ;
VAL_ 128 OBJECT_CLASS_RAW 3 "TRUCK" 1 "CAR" ;
VAL_ 200 LEFT_LINE_CODE 7 "NO_LINE" ;
VAL_ 200 RIGHT_LINE_CODE 7 "NO_LINE" ;
