VERSION "Honda Bosch C radar objects; receive-only; generated by bosch-c-research scripts/make_candidate_dbc.py"
NS_ :

BS_:
BU_: UNKNOWN LOGGER

BO_ 114 BOSCH_C_OBJECT_08: 64 UNKNOWN
 SG_ CRC16_RAW : 0|16@1+ (1,0) [0|65535] "" LOGGER
 SG_ FRAME_COUNTER_RAW : 16|8@1+ (1,0) [0|255] "" LOGGER
 SG_ FRAME_PHASE_RAW : 24|4@1+ (1,0) [0|15] "" LOGGER
 SG_ OBJECT_ID_RAW : 32|8@1+ (1,0) [0|255] "" LOGGER
 SG_ POSITION_X_RAW : 48|12@1+ (1,0) [0|4095] "" LOGGER
 SG_ OBJECT_CLASS_RAW : 60|4@1+ (1,0) [0|15] "" LOGGER
 SG_ POSITION_Y_RAW : 64|14@1+ (1,0) [0|16383] "" LOGGER
 SG_ LIFE_STATE_CANDIDATE_RAW : 78|2@1+ (1,0) [0|3] "" LOGGER
 SG_ VELOCITY_RAW : 80|11@1+ (1,0) [0|2047] "" LOGGER
 SG_ LATERAL_VELOCITY_RAW : 96|10@1+ (1,0) [0|1023] "" LOGGER
 SG_ ENUM_106_CANDIDATE_RAW : 106|3@1+ (1,0) [0|7] "" LOGGER
 SG_ ENUM_109_CANDIDATE_RAW : 109|3@1+ (1,0) [0|7] "" LOGGER
 SG_ EXISTENCE_PROBABILITY_RAW : 121|6@1+ (1,0) [0|63] "" LOGGER
 SG_ NORMALIZED_RATE_RAW : 128|16@1+ (1,0) [0|65535] "" LOGGER
 SG_ QUALITY_CONTAINER_RAW : 144|10@1+ (1,0) [0|1023] "" LOGGER
 SG_ UNCERTAINTY_160_CANDIDATE_RAW : 160|10@1+ (1,0) [0|1023] "" LOGGER
 SG_ REL_VELOCITY_UNCERTAINTY_RAW : 176|10@1+ (1,0) [0|1023] "" LOGGER
 SG_ ACQUISITION_186_CANDIDATE_RAW : 186|6@1+ (1,0) [0|63] "" LOGGER
 SG_ UNCERTAINTY_192_CANDIDATE_RAW : 192|9@1+ (1,0) [0|511] "" LOGGER
 SG_ TTC_RAW : 201|11@1+ (1,0) [0|2047] "" LOGGER
 SG_ OBJECT_LENGTH_CANDIDATE_RAW : 217|9@1+ (1,0) [0|511] "" LOGGER
 SG_ FIELD_226_RAW : 226|9@1+ (1,0) [0|511] "" LOGGER
 SG_ TTC_SIGMA_CANDIDATE_RAW : 240|7@1+ (1,0) [0|127] "" LOGGER
 SG_ FIELD_248_RAW : 248|10@1+ (1,0) [0|1023] "" LOGGER
 SG_ WIDTH_FINE_258_CANDIDATE_RAW : 258|8@1+ (1,0) [0|255] "" LOGGER
 SG_ LIFECYCLE_RAW : 271|12@1+ (1,0) [0|4095] "" LOGGER
 SG_ NORMALIZED_CLOSING_SIGMA_RAW : 288|10@1+ (1,0) [0|1023] "" LOGGER
 SG_ AUX_LATERAL_MOTION_304_CANDIDATE_RAW : 304|17@1+ (1,0) [0|131071] "" LOGGER
 SG_ AUX_328_CANDIDATE_RAW : 328|14@1+ (1,0) [0|16383] "" LOGGER
 SG_ FIELD_344_RAW : 344|13@1+ (1,0) [0|8191] "" LOGGER
 SG_ FIELD_360_RAW : 360|8@1+ (1,0) [0|255] "" LOGGER
 SG_ FIELD_368_RAW : 368|10@1+ (1,0) [0|1023] "" LOGGER
 SG_ AUX2_378_CANDIDATE_RAW : 378|13@1+ (1,0) [0|8191] "" LOGGER
 SG_ FIELD_391_RAW : 391|7@1+ (1,0) [0|127] "" LOGGER
 SG_ MATURITY_398_CANDIDATE_RAW : 398|7@1+ (1,0) [0|127] "" LOGGER
 SG_ FIELD_405_RAW : 405|6@1+ (1,0) [0|63] "" LOGGER
 SG_ AZIMUTH_CENTER_RAW : 411|13@1+ (1,0) [0|8191] "" LOGGER
 SG_ AZIMUTH_EDGE_A_RAW : 424|13@1+ (1,0) [0|8191] "" LOGGER
 SG_ FIELD_437_RAW : 437|3@1+ (1,0) [0|7] "" LOGGER
 SG_ AZIMUTH_EDGE_B_RAW : 440|13@1+ (1,0) [0|8191] "" LOGGER
 SG_ MOTION_CLASS_CANDIDATE_RAW : 465|3@1+ (1,0) [0|7] "" LOGGER
 SG_ ANGULAR_WIDTH_COARSE_CANDIDATE_RAW : 472|8@1+ (1,0) [0|255] "" LOGGER
 SG_ ANGULAR_WIDTH_480_RAW : 480|8@1+ (1,0) [0|255] "" LOGGER
 SG_ ANGULAR_WIDTH_COARSE_COPY_CANDIDATE_RAW : 488|8@1+ (1,0) [0|255] "" LOGGER
 SG_ DREL : 48|12@1+ (0.05,-4.296) [-4.296|200.454] "m" LOGGER
 SG_ YREL : 64|14@1+ (0.01,-81.91) [-81.91|81.92] "m" LOGGER
 SG_ VREL : 80|11@1+ (0.1,-154) [-154|50.7] "m/s" LOGGER
 SG_ LATERAL_VELOCITY : 96|10@1+ (0.1,-51.1) [-51.1|51.2] "m/s" LOGGER
 SG_ EXISTENCE_PROBABILITY : 121|6@1+ (2,0) [0|126] "%" LOGGER
 SG_ NORMALIZED_RATE : 128|16@1+ (0.001,-40) [-40|25.535] "1/s" LOGGER
 SG_ AZIMUTH_CENTER : 411|13@1+ (0.00025,-1.02375) [-1.02375|1.024] "" LOGGER
 SG_ AZIMUTH_EDGE_A : 424|13@1+ (0.00025,-1.02375) [-1.02375|1.024] "" LOGGER
 SG_ AZIMUTH_EDGE_B : 440|13@1+ (0.00025,-1.02375) [-1.02375|1.024] "" LOGGER
 SG_ TTC : 201|11@1+ (0.0078125,-8) [-8|7.9921875] "s" LOGGER

BO_ 116 BOSCH_C_OBJECT_09: 64 UNKNOWN
 SG_ CRC16_RAW : 0|16@1+ (1,0) [0|65535] "" LOGGER
 SG_ FRAME_COUNTER_RAW : 16|8@1+ (1,0) [0|255] "" LOGGER
 SG_ FRAME_PHASE_RAW : 24|4@1+ (1,0) [0|15] "" LOGGER
 SG_ OBJECT_ID_RAW : 32|8@1+ (1,0) [0|255] "" LOGGER
 SG_ POSITION_X_RAW : 48|12@1+ (1,0) [0|4095] "" LOGGER
 SG_ OBJECT_CLASS_RAW : 60|4@1+ (1,0) [0|15] "" LOGGER
 SG_ POSITION_Y_RAW : 64|14@1+ (1,0) [0|16383] "" LOGGER
 SG_ LIFE_STATE_CANDIDATE_RAW : 78|2@1+ (1,0) [0|3] "" LOGGER
 SG_ VELOCITY_RAW : 80|11@1+ (1,0) [0|2047] "" LOGGER
 SG_ LATERAL_VELOCITY_RAW : 96|10@1+ (1,0) [0|1023] "" LOGGER
 SG_ ENUM_106_CANDIDATE_RAW : 106|3@1+ (1,0) [0|7] "" LOGGER
 SG_ ENUM_109_CANDIDATE_RAW : 109|3@1+ (1,0) [0|7] "" LOGGER
 SG_ EXISTENCE_PROBABILITY_RAW : 121|6@1+ (1,0) [0|63] "" LOGGER
 SG_ NORMALIZED_RATE_RAW : 128|16@1+ (1,0) [0|65535] "" LOGGER
 SG_ QUALITY_CONTAINER_RAW : 144|10@1+ (1,0) [0|1023] "" LOGGER
 SG_ UNCERTAINTY_160_CANDIDATE_RAW : 160|10@1+ (1,0) [0|1023] "" LOGGER
 SG_ REL_VELOCITY_UNCERTAINTY_RAW : 176|10@1+ (1,0) [0|1023] "" LOGGER
 SG_ ACQUISITION_186_CANDIDATE_RAW : 186|6@1+ (1,0) [0|63] "" LOGGER
 SG_ UNCERTAINTY_192_CANDIDATE_RAW : 192|9@1+ (1,0) [0|511] "" LOGGER
 SG_ TTC_RAW : 201|11@1+ (1,0) [0|2047] "" LOGGER
 SG_ OBJECT_LENGTH_CANDIDATE_RAW : 217|9@1+ (1,0) [0|511] "" LOGGER
 SG_ FIELD_226_RAW : 226|9@1+ (1,0) [0|511] "" LOGGER
 SG_ TTC_SIGMA_CANDIDATE_RAW : 240|7@1+ (1,0) [0|127] "" LOGGER
 SG_ FIELD_248_RAW : 248|10@1+ (1,0) [0|1023] "" LOGGER
 SG_ WIDTH_FINE_258_CANDIDATE_RAW : 258|8@1+ (1,0) [0|255] "" LOGGER
 SG_ LIFECYCLE_RAW : 271|12@1+ (1,0) [0|4095] "" LOGGER
 SG_ NORMALIZED_CLOSING_SIGMA_RAW : 288|10@1+ (1,0) [0|1023] "" LOGGER
 SG_ AUX_LATERAL_MOTION_304_CANDIDATE_RAW : 304|17@1+ (1,0) [0|131071] "" LOGGER
 SG_ AUX_328_CANDIDATE_RAW : 328|14@1+ (1,0) [0|16383] "" LOGGER
 SG_ FIELD_344_RAW : 344|13@1+ (1,0) [0|8191] "" LOGGER
 SG_ FIELD_360_RAW : 360|8@1+ (1,0) [0|255] "" LOGGER
 SG_ FIELD_368_RAW : 368|10@1+ (1,0) [0|1023] "" LOGGER
 SG_ AUX2_378_CANDIDATE_RAW : 378|13@1+ (1,0) [0|8191] "" LOGGER
 SG_ FIELD_391_RAW : 391|7@1+ (1,0) [0|127] "" LOGGER
 SG_ MATURITY_398_CANDIDATE_RAW : 398|7@1+ (1,0) [0|127] "" LOGGER
 SG_ FIELD_405_RAW : 405|6@1+ (1,0) [0|63] "" LOGGER
 SG_ AZIMUTH_CENTER_RAW : 411|13@1+ (1,0) [0|8191] "" LOGGER
 SG_ AZIMUTH_EDGE_A_RAW : 424|13@1+ (1,0) [0|8191] "" LOGGER
 SG_ FIELD_437_RAW : 437|3@1+ (1,0) [0|7] "" LOGGER
 SG_ AZIMUTH_EDGE_B_RAW : 440|13@1+ (1,0) [0|8191] "" LOGGER
 SG_ MOTION_CLASS_CANDIDATE_RAW : 465|3@1+ (1,0) [0|7] "" LOGGER
 SG_ ANGULAR_WIDTH_COARSE_CANDIDATE_RAW : 472|8@1+ (1,0) [0|255] "" LOGGER
 SG_ ANGULAR_WIDTH_480_RAW : 480|8@1+ (1,0) [0|255] "" LOGGER
 SG_ ANGULAR_WIDTH_COARSE_COPY_CANDIDATE_RAW : 488|8@1+ (1,0) [0|255] "" LOGGER
 SG_ DREL : 48|12@1+ (0.05,-4.296) [-4.296|200.454] "m" LOGGER
 SG_ YREL : 64|14@1+ (0.01,-81.91) [-81.91|81.92] "m" LOGGER
 SG_ VREL : 80|11@1+ (0.1,-154) [-154|50.7] "m/s" LOGGER
 SG_ LATERAL_VELOCITY : 96|10@1+ (0.1,-51.1) [-51.1|51.2] "m/s" LOGGER
 SG_ EXISTENCE_PROBABILITY : 121|6@1+ (2,0) [0|126] "%" LOGGER
 SG_ NORMALIZED_RATE : 128|16@1+ (0.001,-40) [-40|25.535] "1/s" LOGGER
 SG_ AZIMUTH_CENTER : 411|13@1+ (0.00025,-1.02375) [-1.02375|1.024] "" LOGGER
 SG_ AZIMUTH_EDGE_A : 424|13@1+ (0.00025,-1.02375) [-1.02375|1.024] "" LOGGER
 SG_ AZIMUTH_EDGE_B : 440|13@1+ (0.00025,-1.02375) [-1.02375|1.024] "" LOGGER
 SG_ TTC : 201|11@1+ (0.0078125,-8) [-8|7.9921875] "s" LOGGER

BO_ 118 BOSCH_C_OBJECT_10: 64 UNKNOWN
 SG_ CRC16_RAW : 0|16@1+ (1,0) [0|65535] "" LOGGER
 SG_ FRAME_COUNTER_RAW : 16|8@1+ (1,0) [0|255] "" LOGGER
 SG_ FRAME_PHASE_RAW : 24|4@1+ (1,0) [0|15] "" LOGGER
 SG_ OBJECT_ID_RAW : 32|8@1+ (1,0) [0|255] "" LOGGER
 SG_ POSITION_X_RAW : 48|12@1+ (1,0) [0|4095] "" LOGGER
 SG_ OBJECT_CLASS_RAW : 60|4@1+ (1,0) [0|15] "" LOGGER
 SG_ POSITION_Y_RAW : 64|14@1+ (1,0) [0|16383] "" LOGGER
 SG_ LIFE_STATE_CANDIDATE_RAW : 78|2@1+ (1,0) [0|3] "" LOGGER
 SG_ VELOCITY_RAW : 80|11@1+ (1,0) [0|2047] "" LOGGER
 SG_ LATERAL_VELOCITY_RAW : 96|10@1+ (1,0) [0|1023] "" LOGGER
 SG_ ENUM_106_CANDIDATE_RAW : 106|3@1+ (1,0) [0|7] "" LOGGER
 SG_ ENUM_109_CANDIDATE_RAW : 109|3@1+ (1,0) [0|7] "" LOGGER
 SG_ EXISTENCE_PROBABILITY_RAW : 121|6@1+ (1,0) [0|63] "" LOGGER
 SG_ NORMALIZED_RATE_RAW : 128|16@1+ (1,0) [0|65535] "" LOGGER
 SG_ QUALITY_CONTAINER_RAW : 144|10@1+ (1,0) [0|1023] "" LOGGER
 SG_ UNCERTAINTY_160_CANDIDATE_RAW : 160|10@1+ (1,0) [0|1023] "" LOGGER
 SG_ REL_VELOCITY_UNCERTAINTY_RAW : 176|10@1+ (1,0) [0|1023] "" LOGGER
 SG_ ACQUISITION_186_CANDIDATE_RAW : 186|6@1+ (1,0) [0|63] "" LOGGER
 SG_ UNCERTAINTY_192_CANDIDATE_RAW : 192|9@1+ (1,0) [0|511] "" LOGGER
 SG_ TTC_RAW : 201|11@1+ (1,0) [0|2047] "" LOGGER
 SG_ OBJECT_LENGTH_CANDIDATE_RAW : 217|9@1+ (1,0) [0|511] "" LOGGER
 SG_ FIELD_226_RAW : 226|9@1+ (1,0) [0|511] "" LOGGER
 SG_ TTC_SIGMA_CANDIDATE_RAW : 240|7@1+ (1,0) [0|127] "" LOGGER
 SG_ FIELD_248_RAW : 248|10@1+ (1,0) [0|1023] "" LOGGER
 SG_ WIDTH_FINE_258_CANDIDATE_RAW : 258|8@1+ (1,0) [0|255] "" LOGGER
 SG_ LIFECYCLE_RAW : 271|12@1+ (1,0) [0|4095] "" LOGGER
 SG_ NORMALIZED_CLOSING_SIGMA_RAW : 288|10@1+ (1,0) [0|1023] "" LOGGER
 SG_ AUX_LATERAL_MOTION_304_CANDIDATE_RAW : 304|17@1+ (1,0) [0|131071] "" LOGGER
 SG_ AUX_328_CANDIDATE_RAW : 328|14@1+ (1,0) [0|16383] "" LOGGER
 SG_ FIELD_344_RAW : 344|13@1+ (1,0) [0|8191] "" LOGGER
 SG_ FIELD_360_RAW : 360|8@1+ (1,0) [0|255] "" LOGGER
 SG_ FIELD_368_RAW : 368|10@1+ (1,0) [0|1023] "" LOGGER
 SG_ AUX2_378_CANDIDATE_RAW : 378|13@1+ (1,0) [0|8191] "" LOGGER
 SG_ FIELD_391_RAW : 391|7@1+ (1,0) [0|127] "" LOGGER
 SG_ MATURITY_398_CANDIDATE_RAW : 398|7@1+ (1,0) [0|127] "" LOGGER
 SG_ FIELD_405_RAW : 405|6@1+ (1,0) [0|63] "" LOGGER
 SG_ AZIMUTH_CENTER_RAW : 411|13@1+ (1,0) [0|8191] "" LOGGER
 SG_ AZIMUTH_EDGE_A_RAW : 424|13@1+ (1,0) [0|8191] "" LOGGER
 SG_ FIELD_437_RAW : 437|3@1+ (1,0) [0|7] "" LOGGER
 SG_ AZIMUTH_EDGE_B_RAW : 440|13@1+ (1,0) [0|8191] "" LOGGER
 SG_ MOTION_CLASS_CANDIDATE_RAW : 465|3@1+ (1,0) [0|7] "" LOGGER
 SG_ ANGULAR_WIDTH_COARSE_CANDIDATE_RAW : 472|8@1+ (1,0) [0|255] "" LOGGER
 SG_ ANGULAR_WIDTH_480_RAW : 480|8@1+ (1,0) [0|255] "" LOGGER
 SG_ ANGULAR_WIDTH_COARSE_COPY_CANDIDATE_RAW : 488|8@1+ (1,0) [0|255] "" LOGGER
 SG_ DREL : 48|12@1+ (0.05,-4.296) [-4.296|200.454] "m" LOGGER
 SG_ YREL : 64|14@1+ (0.01,-81.91) [-81.91|81.92] "m" LOGGER
 SG_ VREL : 80|11@1+ (0.1,-154) [-154|50.7] "m/s" LOGGER
 SG_ LATERAL_VELOCITY : 96|10@1+ (0.1,-51.1) [-51.1|51.2] "m/s" LOGGER
 SG_ EXISTENCE_PROBABILITY : 121|6@1+ (2,0) [0|126] "%" LOGGER
 SG_ NORMALIZED_RATE : 128|16@1+ (0.001,-40) [-40|25.535] "1/s" LOGGER
 SG_ AZIMUTH_CENTER : 411|13@1+ (0.00025,-1.02375) [-1.02375|1.024] "" LOGGER
 SG_ AZIMUTH_EDGE_A : 424|13@1+ (0.00025,-1.02375) [-1.02375|1.024] "" LOGGER
 SG_ AZIMUTH_EDGE_B : 440|13@1+ (0.00025,-1.02375) [-1.02375|1.024] "" LOGGER
 SG_ TTC : 201|11@1+ (0.0078125,-8) [-8|7.9921875] "s" LOGGER

BO_ 120 BOSCH_C_OBJECT_11: 64 UNKNOWN
 SG_ CRC16_RAW : 0|16@1+ (1,0) [0|65535] "" LOGGER
 SG_ FRAME_COUNTER_RAW : 16|8@1+ (1,0) [0|255] "" LOGGER
 SG_ FRAME_PHASE_RAW : 24|4@1+ (1,0) [0|15] "" LOGGER
 SG_ OBJECT_ID_RAW : 32|8@1+ (1,0) [0|255] "" LOGGER
 SG_ POSITION_X_RAW : 48|12@1+ (1,0) [0|4095] "" LOGGER
 SG_ OBJECT_CLASS_RAW : 60|4@1+ (1,0) [0|15] "" LOGGER
 SG_ POSITION_Y_RAW : 64|14@1+ (1,0) [0|16383] "" LOGGER
 SG_ LIFE_STATE_CANDIDATE_RAW : 78|2@1+ (1,0) [0|3] "" LOGGER
 SG_ VELOCITY_RAW : 80|11@1+ (1,0) [0|2047] "" LOGGER
 SG_ LATERAL_VELOCITY_RAW : 96|10@1+ (1,0) [0|1023] "" LOGGER
 SG_ ENUM_106_CANDIDATE_RAW : 106|3@1+ (1,0) [0|7] "" LOGGER
 SG_ ENUM_109_CANDIDATE_RAW : 109|3@1+ (1,0) [0|7] "" LOGGER
 SG_ EXISTENCE_PROBABILITY_RAW : 121|6@1+ (1,0) [0|63] "" LOGGER
 SG_ NORMALIZED_RATE_RAW : 128|16@1+ (1,0) [0|65535] "" LOGGER
 SG_ QUALITY_CONTAINER_RAW : 144|10@1+ (1,0) [0|1023] "" LOGGER
 SG_ UNCERTAINTY_160_CANDIDATE_RAW : 160|10@1+ (1,0) [0|1023] "" LOGGER
 SG_ REL_VELOCITY_UNCERTAINTY_RAW : 176|10@1+ (1,0) [0|1023] "" LOGGER
 SG_ ACQUISITION_186_CANDIDATE_RAW : 186|6@1+ (1,0) [0|63] "" LOGGER
 SG_ UNCERTAINTY_192_CANDIDATE_RAW : 192|9@1+ (1,0) [0|511] "" LOGGER
 SG_ TTC_RAW : 201|11@1+ (1,0) [0|2047] "" LOGGER
 SG_ OBJECT_LENGTH_CANDIDATE_RAW : 217|9@1+ (1,0) [0|511] "" LOGGER
 SG_ FIELD_226_RAW : 226|9@1+ (1,0) [0|511] "" LOGGER
 SG_ TTC_SIGMA_CANDIDATE_RAW : 240|7@1+ (1,0) [0|127] "" LOGGER
 SG_ FIELD_248_RAW : 248|10@1+ (1,0) [0|1023] "" LOGGER
 SG_ WIDTH_FINE_258_CANDIDATE_RAW : 258|8@1+ (1,0) [0|255] "" LOGGER
 SG_ LIFECYCLE_RAW : 271|12@1+ (1,0) [0|4095] "" LOGGER
 SG_ NORMALIZED_CLOSING_SIGMA_RAW : 288|10@1+ (1,0) [0|1023] "" LOGGER
 SG_ AUX_LATERAL_MOTION_304_CANDIDATE_RAW : 304|17@1+ (1,0) [0|131071] "" LOGGER
 SG_ AUX_328_CANDIDATE_RAW : 328|14@1+ (1,0) [0|16383] "" LOGGER
 SG_ FIELD_344_RAW : 344|13@1+ (1,0) [0|8191] "" LOGGER
 SG_ FIELD_360_RAW : 360|8@1+ (1,0) [0|255] "" LOGGER
 SG_ FIELD_368_RAW : 368|10@1+ (1,0) [0|1023] "" LOGGER
 SG_ AUX2_378_CANDIDATE_RAW : 378|13@1+ (1,0) [0|8191] "" LOGGER
 SG_ FIELD_391_RAW : 391|7@1+ (1,0) [0|127] "" LOGGER
 SG_ MATURITY_398_CANDIDATE_RAW : 398|7@1+ (1,0) [0|127] "" LOGGER
 SG_ FIELD_405_RAW : 405|6@1+ (1,0) [0|63] "" LOGGER
 SG_ AZIMUTH_CENTER_RAW : 411|13@1+ (1,0) [0|8191] "" LOGGER
 SG_ AZIMUTH_EDGE_A_RAW : 424|13@1+ (1,0) [0|8191] "" LOGGER
 SG_ FIELD_437_RAW : 437|3@1+ (1,0) [0|7] "" LOGGER
 SG_ AZIMUTH_EDGE_B_RAW : 440|13@1+ (1,0) [0|8191] "" LOGGER
 SG_ MOTION_CLASS_CANDIDATE_RAW : 465|3@1+ (1,0) [0|7] "" LOGGER
 SG_ ANGULAR_WIDTH_COARSE_CANDIDATE_RAW : 472|8@1+ (1,0) [0|255] "" LOGGER
 SG_ ANGULAR_WIDTH_480_RAW : 480|8@1+ (1,0) [0|255] "" LOGGER
 SG_ ANGULAR_WIDTH_COARSE_COPY_CANDIDATE_RAW : 488|8@1+ (1,0) [0|255] "" LOGGER
 SG_ DREL : 48|12@1+ (0.05,-4.296) [-4.296|200.454] "m" LOGGER
 SG_ YREL : 64|14@1+ (0.01,-81.91) [-81.91|81.92] "m" LOGGER
 SG_ VREL : 80|11@1+ (0.1,-154) [-154|50.7] "m/s" LOGGER
 SG_ LATERAL_VELOCITY : 96|10@1+ (0.1,-51.1) [-51.1|51.2] "m/s" LOGGER
 SG_ EXISTENCE_PROBABILITY : 121|6@1+ (2,0) [0|126] "%" LOGGER
 SG_ NORMALIZED_RATE : 128|16@1+ (0.001,-40) [-40|25.535] "1/s" LOGGER
 SG_ AZIMUTH_CENTER : 411|13@1+ (0.00025,-1.02375) [-1.02375|1.024] "" LOGGER
 SG_ AZIMUTH_EDGE_A : 424|13@1+ (0.00025,-1.02375) [-1.02375|1.024] "" LOGGER
 SG_ AZIMUTH_EDGE_B : 440|13@1+ (0.00025,-1.02375) [-1.02375|1.024] "" LOGGER
 SG_ TTC : 201|11@1+ (0.0078125,-8) [-8|7.9921875] "s" LOGGER

BO_ 122 BOSCH_C_OBJECT_12: 64 UNKNOWN
 SG_ CRC16_RAW : 0|16@1+ (1,0) [0|65535] "" LOGGER
 SG_ FRAME_COUNTER_RAW : 16|8@1+ (1,0) [0|255] "" LOGGER
 SG_ FRAME_PHASE_RAW : 24|4@1+ (1,0) [0|15] "" LOGGER
 SG_ OBJECT_ID_RAW : 32|8@1+ (1,0) [0|255] "" LOGGER
 SG_ POSITION_X_RAW : 48|12@1+ (1,0) [0|4095] "" LOGGER
 SG_ OBJECT_CLASS_RAW : 60|4@1+ (1,0) [0|15] "" LOGGER
 SG_ POSITION_Y_RAW : 64|14@1+ (1,0) [0|16383] "" LOGGER
 SG_ LIFE_STATE_CANDIDATE_RAW : 78|2@1+ (1,0) [0|3] "" LOGGER
 SG_ VELOCITY_RAW : 80|11@1+ (1,0) [0|2047] "" LOGGER
 SG_ LATERAL_VELOCITY_RAW : 96|10@1+ (1,0) [0|1023] "" LOGGER
 SG_ ENUM_106_CANDIDATE_RAW : 106|3@1+ (1,0) [0|7] "" LOGGER
 SG_ ENUM_109_CANDIDATE_RAW : 109|3@1+ (1,0) [0|7] "" LOGGER
 SG_ EXISTENCE_PROBABILITY_RAW : 121|6@1+ (1,0) [0|63] "" LOGGER
 SG_ NORMALIZED_RATE_RAW : 128|16@1+ (1,0) [0|65535] "" LOGGER
 SG_ QUALITY_CONTAINER_RAW : 144|10@1+ (1,0) [0|1023] "" LOGGER
 SG_ UNCERTAINTY_160_CANDIDATE_RAW : 160|10@1+ (1,0) [0|1023] "" LOGGER
 SG_ REL_VELOCITY_UNCERTAINTY_RAW : 176|10@1+ (1,0) [0|1023] "" LOGGER
 SG_ ACQUISITION_186_CANDIDATE_RAW : 186|6@1+ (1,0) [0|63] "" LOGGER
 SG_ UNCERTAINTY_192_CANDIDATE_RAW : 192|9@1+ (1,0) [0|511] "" LOGGER
 SG_ TTC_RAW : 201|11@1+ (1,0) [0|2047] "" LOGGER
 SG_ OBJECT_LENGTH_CANDIDATE_RAW : 217|9@1+ (1,0) [0|511] "" LOGGER
 SG_ FIELD_226_RAW : 226|9@1+ (1,0) [0|511] "" LOGGER
 SG_ TTC_SIGMA_CANDIDATE_RAW : 240|7@1+ (1,0) [0|127] "" LOGGER
 SG_ FIELD_248_RAW : 248|10@1+ (1,0) [0|1023] "" LOGGER
 SG_ WIDTH_FINE_258_CANDIDATE_RAW : 258|8@1+ (1,0) [0|255] "" LOGGER
 SG_ LIFECYCLE_RAW : 271|12@1+ (1,0) [0|4095] "" LOGGER
 SG_ NORMALIZED_CLOSING_SIGMA_RAW : 288|10@1+ (1,0) [0|1023] "" LOGGER
 SG_ AUX_LATERAL_MOTION_304_CANDIDATE_RAW : 304|17@1+ (1,0) [0|131071] "" LOGGER
 SG_ AUX_328_CANDIDATE_RAW : 328|14@1+ (1,0) [0|16383] "" LOGGER
 SG_ FIELD_344_RAW : 344|13@1+ (1,0) [0|8191] "" LOGGER
 SG_ FIELD_360_RAW : 360|8@1+ (1,0) [0|255] "" LOGGER
 SG_ FIELD_368_RAW : 368|10@1+ (1,0) [0|1023] "" LOGGER
 SG_ AUX2_378_CANDIDATE_RAW : 378|13@1+ (1,0) [0|8191] "" LOGGER
 SG_ FIELD_391_RAW : 391|7@1+ (1,0) [0|127] "" LOGGER
 SG_ MATURITY_398_CANDIDATE_RAW : 398|7@1+ (1,0) [0|127] "" LOGGER
 SG_ FIELD_405_RAW : 405|6@1+ (1,0) [0|63] "" LOGGER
 SG_ AZIMUTH_CENTER_RAW : 411|13@1+ (1,0) [0|8191] "" LOGGER
 SG_ AZIMUTH_EDGE_A_RAW : 424|13@1+ (1,0) [0|8191] "" LOGGER
 SG_ FIELD_437_RAW : 437|3@1+ (1,0) [0|7] "" LOGGER
 SG_ AZIMUTH_EDGE_B_RAW : 440|13@1+ (1,0) [0|8191] "" LOGGER
 SG_ MOTION_CLASS_CANDIDATE_RAW : 465|3@1+ (1,0) [0|7] "" LOGGER
 SG_ ANGULAR_WIDTH_COARSE_CANDIDATE_RAW : 472|8@1+ (1,0) [0|255] "" LOGGER
 SG_ ANGULAR_WIDTH_480_RAW : 480|8@1+ (1,0) [0|255] "" LOGGER
 SG_ ANGULAR_WIDTH_COARSE_COPY_CANDIDATE_RAW : 488|8@1+ (1,0) [0|255] "" LOGGER
 SG_ DREL : 48|12@1+ (0.05,-4.296) [-4.296|200.454] "m" LOGGER
 SG_ YREL : 64|14@1+ (0.01,-81.91) [-81.91|81.92] "m" LOGGER
 SG_ VREL : 80|11@1+ (0.1,-154) [-154|50.7] "m/s" LOGGER
 SG_ LATERAL_VELOCITY : 96|10@1+ (0.1,-51.1) [-51.1|51.2] "m/s" LOGGER
 SG_ EXISTENCE_PROBABILITY : 121|6@1+ (2,0) [0|126] "%" LOGGER
 SG_ NORMALIZED_RATE : 128|16@1+ (0.001,-40) [-40|25.535] "1/s" LOGGER
 SG_ AZIMUTH_CENTER : 411|13@1+ (0.00025,-1.02375) [-1.02375|1.024] "" LOGGER
 SG_ AZIMUTH_EDGE_A : 424|13@1+ (0.00025,-1.02375) [-1.02375|1.024] "" LOGGER
 SG_ AZIMUTH_EDGE_B : 440|13@1+ (0.00025,-1.02375) [-1.02375|1.024] "" LOGGER
 SG_ TTC : 201|11@1+ (0.0078125,-8) [-8|7.9921875] "s" LOGGER

BO_ 124 BOSCH_C_OBJECT_13: 64 UNKNOWN
 SG_ CRC16_RAW : 0|16@1+ (1,0) [0|65535] "" LOGGER
 SG_ FRAME_COUNTER_RAW : 16|8@1+ (1,0) [0|255] "" LOGGER
 SG_ FRAME_PHASE_RAW : 24|4@1+ (1,0) [0|15] "" LOGGER
 SG_ OBJECT_ID_RAW : 32|8@1+ (1,0) [0|255] "" LOGGER
 SG_ POSITION_X_RAW : 48|12@1+ (1,0) [0|4095] "" LOGGER
 SG_ OBJECT_CLASS_RAW : 60|4@1+ (1,0) [0|15] "" LOGGER
 SG_ POSITION_Y_RAW : 64|14@1+ (1,0) [0|16383] "" LOGGER
 SG_ LIFE_STATE_CANDIDATE_RAW : 78|2@1+ (1,0) [0|3] "" LOGGER
 SG_ VELOCITY_RAW : 80|11@1+ (1,0) [0|2047] "" LOGGER
 SG_ LATERAL_VELOCITY_RAW : 96|10@1+ (1,0) [0|1023] "" LOGGER
 SG_ ENUM_106_CANDIDATE_RAW : 106|3@1+ (1,0) [0|7] "" LOGGER
 SG_ ENUM_109_CANDIDATE_RAW : 109|3@1+ (1,0) [0|7] "" LOGGER
 SG_ EXISTENCE_PROBABILITY_RAW : 121|6@1+ (1,0) [0|63] "" LOGGER
 SG_ NORMALIZED_RATE_RAW : 128|16@1+ (1,0) [0|65535] "" LOGGER
 SG_ QUALITY_CONTAINER_RAW : 144|10@1+ (1,0) [0|1023] "" LOGGER
 SG_ UNCERTAINTY_160_CANDIDATE_RAW : 160|10@1+ (1,0) [0|1023] "" LOGGER
 SG_ REL_VELOCITY_UNCERTAINTY_RAW : 176|10@1+ (1,0) [0|1023] "" LOGGER
 SG_ ACQUISITION_186_CANDIDATE_RAW : 186|6@1+ (1,0) [0|63] "" LOGGER
 SG_ UNCERTAINTY_192_CANDIDATE_RAW : 192|9@1+ (1,0) [0|511] "" LOGGER
 SG_ TTC_RAW : 201|11@1+ (1,0) [0|2047] "" LOGGER
 SG_ OBJECT_LENGTH_CANDIDATE_RAW : 217|9@1+ (1,0) [0|511] "" LOGGER
 SG_ FIELD_226_RAW : 226|9@1+ (1,0) [0|511] "" LOGGER
 SG_ TTC_SIGMA_CANDIDATE_RAW : 240|7@1+ (1,0) [0|127] "" LOGGER
 SG_ FIELD_248_RAW : 248|10@1+ (1,0) [0|1023] "" LOGGER
 SG_ WIDTH_FINE_258_CANDIDATE_RAW : 258|8@1+ (1,0) [0|255] "" LOGGER
 SG_ LIFECYCLE_RAW : 271|12@1+ (1,0) [0|4095] "" LOGGER
 SG_ NORMALIZED_CLOSING_SIGMA_RAW : 288|10@1+ (1,0) [0|1023] "" LOGGER
 SG_ AUX_LATERAL_MOTION_304_CANDIDATE_RAW : 304|17@1+ (1,0) [0|131071] "" LOGGER
 SG_ AUX_328_CANDIDATE_RAW : 328|14@1+ (1,0) [0|16383] "" LOGGER
 SG_ FIELD_344_RAW : 344|13@1+ (1,0) [0|8191] "" LOGGER
 SG_ FIELD_360_RAW : 360|8@1+ (1,0) [0|255] "" LOGGER
 SG_ FIELD_368_RAW : 368|10@1+ (1,0) [0|1023] "" LOGGER
 SG_ AUX2_378_CANDIDATE_RAW : 378|13@1+ (1,0) [0|8191] "" LOGGER
 SG_ FIELD_391_RAW : 391|7@1+ (1,0) [0|127] "" LOGGER
 SG_ MATURITY_398_CANDIDATE_RAW : 398|7@1+ (1,0) [0|127] "" LOGGER
 SG_ FIELD_405_RAW : 405|6@1+ (1,0) [0|63] "" LOGGER
 SG_ AZIMUTH_CENTER_RAW : 411|13@1+ (1,0) [0|8191] "" LOGGER
 SG_ AZIMUTH_EDGE_A_RAW : 424|13@1+ (1,0) [0|8191] "" LOGGER
 SG_ FIELD_437_RAW : 437|3@1+ (1,0) [0|7] "" LOGGER
 SG_ AZIMUTH_EDGE_B_RAW : 440|13@1+ (1,0) [0|8191] "" LOGGER
 SG_ MOTION_CLASS_CANDIDATE_RAW : 465|3@1+ (1,0) [0|7] "" LOGGER
 SG_ ANGULAR_WIDTH_COARSE_CANDIDATE_RAW : 472|8@1+ (1,0) [0|255] "" LOGGER
 SG_ ANGULAR_WIDTH_480_RAW : 480|8@1+ (1,0) [0|255] "" LOGGER
 SG_ ANGULAR_WIDTH_COARSE_COPY_CANDIDATE_RAW : 488|8@1+ (1,0) [0|255] "" LOGGER
 SG_ DREL : 48|12@1+ (0.05,-4.296) [-4.296|200.454] "m" LOGGER
 SG_ YREL : 64|14@1+ (0.01,-81.91) [-81.91|81.92] "m" LOGGER
 SG_ VREL : 80|11@1+ (0.1,-154) [-154|50.7] "m/s" LOGGER
 SG_ LATERAL_VELOCITY : 96|10@1+ (0.1,-51.1) [-51.1|51.2] "m/s" LOGGER
 SG_ EXISTENCE_PROBABILITY : 121|6@1+ (2,0) [0|126] "%" LOGGER
 SG_ NORMALIZED_RATE : 128|16@1+ (0.001,-40) [-40|25.535] "1/s" LOGGER
 SG_ AZIMUTH_CENTER : 411|13@1+ (0.00025,-1.02375) [-1.02375|1.024] "" LOGGER
 SG_ AZIMUTH_EDGE_A : 424|13@1+ (0.00025,-1.02375) [-1.02375|1.024] "" LOGGER
 SG_ AZIMUTH_EDGE_B : 440|13@1+ (0.00025,-1.02375) [-1.02375|1.024] "" LOGGER
 SG_ TTC : 201|11@1+ (0.0078125,-8) [-8|7.9921875] "s" LOGGER

BO_ 126 BOSCH_C_OBJECT_14: 64 UNKNOWN
 SG_ CRC16_RAW : 0|16@1+ (1,0) [0|65535] "" LOGGER
 SG_ FRAME_COUNTER_RAW : 16|8@1+ (1,0) [0|255] "" LOGGER
 SG_ FRAME_PHASE_RAW : 24|4@1+ (1,0) [0|15] "" LOGGER
 SG_ OBJECT_ID_RAW : 32|8@1+ (1,0) [0|255] "" LOGGER
 SG_ POSITION_X_RAW : 48|12@1+ (1,0) [0|4095] "" LOGGER
 SG_ OBJECT_CLASS_RAW : 60|4@1+ (1,0) [0|15] "" LOGGER
 SG_ POSITION_Y_RAW : 64|14@1+ (1,0) [0|16383] "" LOGGER
 SG_ LIFE_STATE_CANDIDATE_RAW : 78|2@1+ (1,0) [0|3] "" LOGGER
 SG_ VELOCITY_RAW : 80|11@1+ (1,0) [0|2047] "" LOGGER
 SG_ LATERAL_VELOCITY_RAW : 96|10@1+ (1,0) [0|1023] "" LOGGER
 SG_ ENUM_106_CANDIDATE_RAW : 106|3@1+ (1,0) [0|7] "" LOGGER
 SG_ ENUM_109_CANDIDATE_RAW : 109|3@1+ (1,0) [0|7] "" LOGGER
 SG_ EXISTENCE_PROBABILITY_RAW : 121|6@1+ (1,0) [0|63] "" LOGGER
 SG_ NORMALIZED_RATE_RAW : 128|16@1+ (1,0) [0|65535] "" LOGGER
 SG_ QUALITY_CONTAINER_RAW : 144|10@1+ (1,0) [0|1023] "" LOGGER
 SG_ UNCERTAINTY_160_CANDIDATE_RAW : 160|10@1+ (1,0) [0|1023] "" LOGGER
 SG_ REL_VELOCITY_UNCERTAINTY_RAW : 176|10@1+ (1,0) [0|1023] "" LOGGER
 SG_ ACQUISITION_186_CANDIDATE_RAW : 186|6@1+ (1,0) [0|63] "" LOGGER
 SG_ UNCERTAINTY_192_CANDIDATE_RAW : 192|9@1+ (1,0) [0|511] "" LOGGER
 SG_ TTC_RAW : 201|11@1+ (1,0) [0|2047] "" LOGGER
 SG_ OBJECT_LENGTH_CANDIDATE_RAW : 217|9@1+ (1,0) [0|511] "" LOGGER
 SG_ FIELD_226_RAW : 226|9@1+ (1,0) [0|511] "" LOGGER
 SG_ TTC_SIGMA_CANDIDATE_RAW : 240|7@1+ (1,0) [0|127] "" LOGGER
 SG_ FIELD_248_RAW : 248|10@1+ (1,0) [0|1023] "" LOGGER
 SG_ WIDTH_FINE_258_CANDIDATE_RAW : 258|8@1+ (1,0) [0|255] "" LOGGER
 SG_ LIFECYCLE_RAW : 271|12@1+ (1,0) [0|4095] "" LOGGER
 SG_ NORMALIZED_CLOSING_SIGMA_RAW : 288|10@1+ (1,0) [0|1023] "" LOGGER
 SG_ AUX_LATERAL_MOTION_304_CANDIDATE_RAW : 304|17@1+ (1,0) [0|131071] "" LOGGER
 SG_ AUX_328_CANDIDATE_RAW : 328|14@1+ (1,0) [0|16383] "" LOGGER
 SG_ FIELD_344_RAW : 344|13@1+ (1,0) [0|8191] "" LOGGER
 SG_ FIELD_360_RAW : 360|8@1+ (1,0) [0|255] "" LOGGER
 SG_ FIELD_368_RAW : 368|10@1+ (1,0) [0|1023] "" LOGGER
 SG_ AUX2_378_CANDIDATE_RAW : 378|13@1+ (1,0) [0|8191] "" LOGGER
 SG_ FIELD_391_RAW : 391|7@1+ (1,0) [0|127] "" LOGGER
 SG_ MATURITY_398_CANDIDATE_RAW : 398|7@1+ (1,0) [0|127] "" LOGGER
 SG_ FIELD_405_RAW : 405|6@1+ (1,0) [0|63] "" LOGGER
 SG_ AZIMUTH_CENTER_RAW : 411|13@1+ (1,0) [0|8191] "" LOGGER
 SG_ AZIMUTH_EDGE_A_RAW : 424|13@1+ (1,0) [0|8191] "" LOGGER
 SG_ FIELD_437_RAW : 437|3@1+ (1,0) [0|7] "" LOGGER
 SG_ AZIMUTH_EDGE_B_RAW : 440|13@1+ (1,0) [0|8191] "" LOGGER
 SG_ MOTION_CLASS_CANDIDATE_RAW : 465|3@1+ (1,0) [0|7] "" LOGGER
 SG_ ANGULAR_WIDTH_COARSE_CANDIDATE_RAW : 472|8@1+ (1,0) [0|255] "" LOGGER
 SG_ ANGULAR_WIDTH_480_RAW : 480|8@1+ (1,0) [0|255] "" LOGGER
 SG_ ANGULAR_WIDTH_COARSE_COPY_CANDIDATE_RAW : 488|8@1+ (1,0) [0|255] "" LOGGER
 SG_ DREL : 48|12@1+ (0.05,-4.296) [-4.296|200.454] "m" LOGGER
 SG_ YREL : 64|14@1+ (0.01,-81.91) [-81.91|81.92] "m" LOGGER
 SG_ VREL : 80|11@1+ (0.1,-154) [-154|50.7] "m/s" LOGGER
 SG_ LATERAL_VELOCITY : 96|10@1+ (0.1,-51.1) [-51.1|51.2] "m/s" LOGGER
 SG_ EXISTENCE_PROBABILITY : 121|6@1+ (2,0) [0|126] "%" LOGGER
 SG_ NORMALIZED_RATE : 128|16@1+ (0.001,-40) [-40|25.535] "1/s" LOGGER
 SG_ AZIMUTH_CENTER : 411|13@1+ (0.00025,-1.02375) [-1.02375|1.024] "" LOGGER
 SG_ AZIMUTH_EDGE_A : 424|13@1+ (0.00025,-1.02375) [-1.02375|1.024] "" LOGGER
 SG_ AZIMUTH_EDGE_B : 440|13@1+ (0.00025,-1.02375) [-1.02375|1.024] "" LOGGER
 SG_ TTC : 201|11@1+ (0.0078125,-8) [-8|7.9921875] "s" LOGGER

BO_ 128 BOSCH_C_OBJECT_15: 64 UNKNOWN
 SG_ CRC16_RAW : 0|16@1+ (1,0) [0|65535] "" LOGGER
 SG_ FRAME_COUNTER_RAW : 16|8@1+ (1,0) [0|255] "" LOGGER
 SG_ FRAME_PHASE_RAW : 24|4@1+ (1,0) [0|15] "" LOGGER
 SG_ OBJECT_ID_RAW : 32|8@1+ (1,0) [0|255] "" LOGGER
 SG_ POSITION_X_RAW : 48|12@1+ (1,0) [0|4095] "" LOGGER
 SG_ OBJECT_CLASS_RAW : 60|4@1+ (1,0) [0|15] "" LOGGER
 SG_ POSITION_Y_RAW : 64|14@1+ (1,0) [0|16383] "" LOGGER
 SG_ LIFE_STATE_CANDIDATE_RAW : 78|2@1+ (1,0) [0|3] "" LOGGER
 SG_ VELOCITY_RAW : 80|11@1+ (1,0) [0|2047] "" LOGGER
 SG_ LATERAL_VELOCITY_RAW : 96|10@1+ (1,0) [0|1023] "" LOGGER
 SG_ ENUM_106_CANDIDATE_RAW : 106|3@1+ (1,0) [0|7] "" LOGGER
 SG_ ENUM_109_CANDIDATE_RAW : 109|3@1+ (1,0) [0|7] "" LOGGER
 SG_ EXISTENCE_PROBABILITY_RAW : 121|6@1+ (1,0) [0|63] "" LOGGER
 SG_ NORMALIZED_RATE_RAW : 128|16@1+ (1,0) [0|65535] "" LOGGER
 SG_ QUALITY_CONTAINER_RAW : 144|10@1+ (1,0) [0|1023] "" LOGGER
 SG_ UNCERTAINTY_160_CANDIDATE_RAW : 160|10@1+ (1,0) [0|1023] "" LOGGER
 SG_ REL_VELOCITY_UNCERTAINTY_RAW : 176|10@1+ (1,0) [0|1023] "" LOGGER
 SG_ ACQUISITION_186_CANDIDATE_RAW : 186|6@1+ (1,0) [0|63] "" LOGGER
 SG_ UNCERTAINTY_192_CANDIDATE_RAW : 192|9@1+ (1,0) [0|511] "" LOGGER
 SG_ TTC_RAW : 201|11@1+ (1,0) [0|2047] "" LOGGER
 SG_ OBJECT_LENGTH_CANDIDATE_RAW : 217|9@1+ (1,0) [0|511] "" LOGGER
 SG_ FIELD_226_RAW : 226|9@1+ (1,0) [0|511] "" LOGGER
 SG_ TTC_SIGMA_CANDIDATE_RAW : 240|7@1+ (1,0) [0|127] "" LOGGER
 SG_ FIELD_248_RAW : 248|10@1+ (1,0) [0|1023] "" LOGGER
 SG_ WIDTH_FINE_258_CANDIDATE_RAW : 258|8@1+ (1,0) [0|255] "" LOGGER
 SG_ LIFECYCLE_RAW : 271|12@1+ (1,0) [0|4095] "" LOGGER
 SG_ NORMALIZED_CLOSING_SIGMA_RAW : 288|10@1+ (1,0) [0|1023] "" LOGGER
 SG_ AUX_LATERAL_MOTION_304_CANDIDATE_RAW : 304|17@1+ (1,0) [0|131071] "" LOGGER
 SG_ AUX_328_CANDIDATE_RAW : 328|14@1+ (1,0) [0|16383] "" LOGGER
 SG_ FIELD_344_RAW : 344|13@1+ (1,0) [0|8191] "" LOGGER
 SG_ FIELD_360_RAW : 360|8@1+ (1,0) [0|255] "" LOGGER
 SG_ FIELD_368_RAW : 368|10@1+ (1,0) [0|1023] "" LOGGER
 SG_ AUX2_378_CANDIDATE_RAW : 378|13@1+ (1,0) [0|8191] "" LOGGER
 SG_ FIELD_391_RAW : 391|7@1+ (1,0) [0|127] "" LOGGER
 SG_ MATURITY_398_CANDIDATE_RAW : 398|7@1+ (1,0) [0|127] "" LOGGER
 SG_ FIELD_405_RAW : 405|6@1+ (1,0) [0|63] "" LOGGER
 SG_ AZIMUTH_CENTER_RAW : 411|13@1+ (1,0) [0|8191] "" LOGGER
 SG_ AZIMUTH_EDGE_A_RAW : 424|13@1+ (1,0) [0|8191] "" LOGGER
 SG_ FIELD_437_RAW : 437|3@1+ (1,0) [0|7] "" LOGGER
 SG_ AZIMUTH_EDGE_B_RAW : 440|13@1+ (1,0) [0|8191] "" LOGGER
 SG_ MOTION_CLASS_CANDIDATE_RAW : 465|3@1+ (1,0) [0|7] "" LOGGER
 SG_ ANGULAR_WIDTH_COARSE_CANDIDATE_RAW : 472|8@1+ (1,0) [0|255] "" LOGGER
 SG_ ANGULAR_WIDTH_480_RAW : 480|8@1+ (1,0) [0|255] "" LOGGER
 SG_ ANGULAR_WIDTH_COARSE_COPY_CANDIDATE_RAW : 488|8@1+ (1,0) [0|255] "" LOGGER
 SG_ DREL : 48|12@1+ (0.05,-4.296) [-4.296|200.454] "m" LOGGER
 SG_ YREL : 64|14@1+ (0.01,-81.91) [-81.91|81.92] "m" LOGGER
 SG_ VREL : 80|11@1+ (0.1,-154) [-154|50.7] "m/s" LOGGER
 SG_ LATERAL_VELOCITY : 96|10@1+ (0.1,-51.1) [-51.1|51.2] "m/s" LOGGER
 SG_ EXISTENCE_PROBABILITY : 121|6@1+ (2,0) [0|126] "%" LOGGER
 SG_ NORMALIZED_RATE : 128|16@1+ (0.001,-40) [-40|25.535] "1/s" LOGGER
 SG_ AZIMUTH_CENTER : 411|13@1+ (0.00025,-1.02375) [-1.02375|1.024] "" LOGGER
 SG_ AZIMUTH_EDGE_A : 424|13@1+ (0.00025,-1.02375) [-1.02375|1.024] "" LOGGER
 SG_ AZIMUTH_EDGE_B : 440|13@1+ (0.00025,-1.02375) [-1.02375|1.024] "" LOGGER
 SG_ TTC : 201|11@1+ (0.0078125,-8) [-8|7.9921875] "s" LOGGER

BO_ 1025 BOSCH_C_EGO_MOTION: 64 UNKNOWN
 SG_ YAW_RATE : 366|12@0- (0.0005257,0) [-1.0766336|1.0761079] "rad/s" LOGGER
 SG_ LAT_ACCEL : 80|8@1- (0.198,0) [-25.344|25.146] "m/s^2" LOGGER
 SG_ SPEED_CANDIDATE_RAW : 31|10@0+ (1,0) [0|1023] "" LOGGER
 SG_ STEER_ANGLE_CANDIDATE_RAW : 103|9@1- (1,0) [-256|255] "" LOGGER
 SG_ ACCEL_CANDIDATE_RAW : 88|8@1- (1,0) [-128|127] "" LOGGER

BO_ 200 CAMERA_EGO_LANE_LINES: 32 UNKNOWN
 SG_ CRC16_RAW : 0|16@1+ (1,0) [0|65535] "" LOGGER
 SG_ COUNTER_RAW : 16|8@1+ (1,0) [0|255] "" LOGGER
 SG_ LEFT_LINE_OFFSET : 43|12@1+ (0.0078125,-16) [-16|15.9921875] "m" LOGGER
 SG_ LEFT_LINE_CODE : 84|3@1+ (1,0) [0|7] "" LOGGER
 SG_ LEFT_LINE_COUNTER_RAW : 24|4@1+ (1,0) [0|15] "" LOGGER
 SG_ LEFT_LINE_RANGE_CANDIDATE_RAW : 28|9@1+ (1,0) [0|511] "" LOGGER
 SG_ LEFT_LINE_QUALITY_CANDIDATE_RAW : 37|6@1+ (1,0) [0|63] "" LOGGER
 SG_ LEFT_LINE_HEADING_CANDIDATE_RAW : 55|12@1+ (1,0) [0|4095] "" LOGGER
 SG_ LEFT_LINE_67_RAW : 67|8@1+ (1,0) [0|255] "" LOGGER
 SG_ LEFT_LINE_75_RAW : 75|9@1+ (1,0) [0|511] "" LOGGER
 SG_ LEFT_LINE_CURVATURE_CANDIDATE_RAW : 87|15@1+ (1,0) [0|32767] "" LOGGER
 SG_ LEFT_LINE_CURVATURE_RATE_CANDIDATE_RAW : 102|15@1+ (1,0) [0|32767] "" LOGGER
 SG_ LEFT_LINE_117_RAW : 117|5@1+ (1,0) [0|31] "" LOGGER
 SG_ LEFT_LINE_122_RAW : 122|8@1+ (1,0) [0|255] "" LOGGER
 SG_ LEFT_LINE_130_RAW : 130|9@1+ (1,0) [0|511] "" LOGGER
 SG_ RIGHT_LINE_OFFSET : 158|12@1+ (0.0078125,-16) [-16|15.9921875] "m" LOGGER
 SG_ RIGHT_LINE_CODE : 199|3@1+ (1,0) [0|7] "" LOGGER
 SG_ RIGHT_LINE_COUNTER_RAW : 139|4@1+ (1,0) [0|15] "" LOGGER
 SG_ RIGHT_LINE_RANGE_CANDIDATE_RAW : 143|9@1+ (1,0) [0|511] "" LOGGER
 SG_ RIGHT_LINE_QUALITY_CANDIDATE_RAW : 152|6@1+ (1,0) [0|63] "" LOGGER
 SG_ RIGHT_LINE_HEADING_CANDIDATE_RAW : 170|12@1+ (1,0) [0|4095] "" LOGGER
 SG_ RIGHT_LINE_182_RAW : 182|8@1+ (1,0) [0|255] "" LOGGER
 SG_ RIGHT_LINE_190_RAW : 190|9@1+ (1,0) [0|511] "" LOGGER
 SG_ RIGHT_LINE_CURVATURE_CANDIDATE_RAW : 202|15@1+ (1,0) [0|32767] "" LOGGER
 SG_ RIGHT_LINE_CURVATURE_RATE_CANDIDATE_RAW : 217|15@1+ (1,0) [0|32767] "" LOGGER
 SG_ RIGHT_LINE_232_RAW : 232|5@1+ (1,0) [0|31] "" LOGGER
 SG_ RIGHT_LINE_237_RAW : 237|8@1+ (1,0) [0|255] "" LOGGER
 SG_ RIGHT_LINE_245_RAW : 245|9@1+ (1,0) [0|511] "" LOGGER

BA_DEF_ BO_ "VFrameFormat" ENUM "StandardCAN","ExtendedCAN","reserved","J1939PG","reserved","reserved","reserved","reserved","reserved","reserved","reserved","reserved","reserved","reserved","StandardCAN_FD","ExtendedCAN_FD";
BA_ "VFrameFormat" BO_ 114 14;
CM_ SG_ 114 CRC16_RAW "Capture-verified CRC16: polynomial 0x1021, init 0xFFFF, no reflection or xorout; bytes 2:64 then little-endian data ID 0x0fb3. The radar firmware's E2E receive configuration holds data IDs 0x0FAB-0x0FBA.";
CM_ SG_ 114 OBJECT_ID_RAW "Bits 32-39 (radar firmware; 40-47 are unused and never set). Observed 0 empty, 1 through 63 active. IDs move between wire slots and are reused.";
CM_ SG_ 114 LIFECYCLE_RAW "Observed +3 modulo 4096 per consecutive sweep for continuing IDs. Resets or discontinuities require a new track. Not read by the radar firmware.";
CM_ SG_ 114 FRAME_PHASE_RAW "Radar firmware: raw, valid below 16.";
CM_ SG_ 114 POSITION_X_RAW "Radar firmware: 0.05*raw m, valid below 4096, no offset (in the sender's frame). Unsigned 12-bit, bits 48-59; bit 60 belongs to OBJECT_CLASS_RAW. Working decode dRel = 0.05*raw-4.296 m (accepted): the -4.296 m is our measured offset to the bumper reference, not part of the encoding. The stock dash draws HUD_OBJECTS LONG_DIST from raw/4. Normalized closing and azimuth both imply a sensor range origin about 2.3 m behind the dRel origin, which fits the windshield camera that sends this bank.";
CM_ SG_ 114 OBJECT_CLASS_RAW "Object class, bits 60-63. Radar firmware: raw, valid below 16; it names no values. 1 car and 3 truck/large vehicle: accepted against the stock dash HUD_OBJECTS icons on held-out routes (99.6% and 99.2%). 6, 7 and 8 are not motorcycle, pedestrian and bicycle as such: against video within 25 m they name that object on 1 of 11, 3 of 13 and 3 of 12 clear labels, and are most often a car (2026-09-29). The stock dash shows icon 6 for moving two-wheelers, so its motorcycle icon adds a filter on top of class 6. 9-11 unconfirmed. Classes 1 and 3 never share a track with classes 6-11.";
CM_ SG_ 114 POSITION_Y_RAW "Lateral position, 14-bit offset binary, positive left. Radar firmware: 0.01*raw-81.91 m, zero at 8191 (also its initial value), valid below 16384. Until 2026-10-02 production used zero 8192 (1 cm right). The 0.01 m scale and 14-bit extent were accepted on held-out routes before the firmware confirmed them. A 13-bit read wraps past +-40.95 m.";
CM_ SG_ 114 LIFE_STATE_CANDIDATE_RAW "Radar firmware: a separate 2-bit field, raw, valid below 4. Life state 0 newborn, 1 established, 2 ending (2 on 6-26% of a track last three frames vs 0.1-4% mid-life, ten recordings). Shares: 0 9.6%, 1 88.1%, 2 2.3%; 3 never seen.";
CM_ SG_ 114 VELOCITY_RAW "Relative velocity. Radar firmware: 0.1*raw-154.0 m/s, zero at 1540 (also its initial value), valid below 2048; the MY22 firmware (A070) reads it the same way. Production used zero 1539 (+0.1 m/s) until 2026-10-02. Stationary objects read about -0.3 m/s against vEgo with 1539 and -0.4 m/s with 1540, which points at the wheel-speed reference rather than the encoding. Raw 0 (-154 m/s) is a floor saturation on newborn far objects, not a sentinel.";
CM_ SG_ 114 LATERAL_VELOCITY_RAW "Lateral velocity, positive left, relative in the sensor frame (includes the apparent motion of stationary objects from ego yaw). Radar firmware: 0.1*raw-51.1 m/s, zero at 511 (also its initial value), valid below 1024. Accepted 2026-10-02: the research decode 0.1*(raw-511) was provisional only because one held-out scale bracket (0.1004-0.1085) missed 0.1; the firmware settles the scale.";
CM_ SG_ 114 ENUM_106_CANDIDATE_RAW "Radar firmware: one 3-bit field, raw, valid below 5 (formerly read as flags at bits 106 and 107). Shares: 0 14.6%, 1 83.8%, 2 1.0%, 3 0.7%, 4 under 0.1%. Bit 106 (odd values) is set on about 40% of newborn frames and 97-99% after 1 s and agrees with LIFE_STATE 1 on 96%; bit 107 (values 2-3) is mostly on mature same-direction movers. Meaning unresolved.";
CM_ SG_ 114 ENUM_109_CANDIDATE_RAW "Not read by the radar firmware. Values 0-4. 1 on most established tracks; 2-4 mostly on same-direction movers near the path with high existence. Not an object class (metric width about 1.7 m for all values) and not a left/right lane code. Meaning unresolved.";
CM_ SG_ 114 EXISTENCE_PROBABILITY_RAW "Bosch A OBJECT_EXISTENCE_PROBABILITY counterpart (accepted). Radar firmware: 2*raw percent, valid below 51 (100%); observed 0-49, 49 most common. Best survival predictor within range x age strata on ten recordings (AUC 0.67-0.92); falls over the last second before track death; low on short-lived ghosts. 0 marks a degraded measurement (accepted on held-out routes: range innovation and vRel steps at least 2x worse on 17 of 17).";
CM_ SG_ 114 NORMALIZED_RATE_RAW "Bosch A NORMALIZED_CLOSING counterpart. Radar firmware: 0.001*raw-40 (1/s), valid below 65001. Accepted 2026-10-02: the research decode 0.001*(raw-40000) 1/s matches the firmware exactly; approximately vRel/(dRel+2.3 m) and follows Doppler vRel, not range change. 64999 marks invalid in the data (TTC 0, TTC sigma 0 and normalized-closing sigma 0 in the same frame), though the firmware getter accepts it.";
CM_ SG_ 114 QUALITY_CONTAINER_RAW "Bits 144-153 (radar firmware; 154-159 are unused and never set). Radar firmware: 0.05*raw, valid below 1024; the 0.05 step equals the range resolution. Bosch A RANGE_SIGMA candidate (provisional): range-noise specific on 8 of 10 recordings, weak (partial rho 0.08-0.25). Strongly range dependent. Unit unnamed.";
CM_ SG_ 114 REL_VELOCITY_UNCERTAINTY_RAW "Bosch A REL_VELOCITY_UNCERTAINTY counterpart (accepted, raw units): velocity-noise specific and monotonic with empirical vRel noise on ten recordings. Radar firmware: 0.1*raw, valid below 1024, unit unnamed. Nonlinear against our measured vRel noise (the adapter maps it empirically).";
CM_ SG_ 114 UNCERTAINTY_160_CANDIDATE_RAW "Radar firmware: 10 bits, 0.02*raw, valid below 1024. Mostly 1-2; higher on young and laterally offset objects. Weak noise association. Unit unnamed.";
CM_ SG_ 114 ACQUISITION_186_CANDIDATE_RAW "Radar firmware: 6 bits, 0.01*raw, valid below 64. Starts near 23 on newborn tracks and decays to about 2. Carries little information beyond track age.";
CM_ SG_ 114 UNCERTAINTY_192_CANDIDATE_RAW "Radar firmware: 9 bits, 0.1*raw, valid below 512. Decays with age; mixed velocity and lateral noise association, not specific to one noise. Unit unnamed.";
CM_ SG_ 114 TTC_RAW "Time to collision (accepted 2026-09-28 on held-out routes), (raw-1024)/128 s: a constant-velocity TTC, equal to -1/normalized closing within 0.06-0.10 s median. Reported only while an acceleration-aware collision prediction expects impact (lagging it by about 1-2 s); otherwise 2046. 0 = invalid (normalized closing 64999). Not read by the radar firmware, so the scale rests on captures. No Bosch A counterpart.";
CM_ SG_ 114 OBJECT_LENGTH_CANDIDATE_RAW "Object length, provisional (docs/object-length-217.md). Radar firmware: 0.05*raw m, valid below 512. Median 4.25 m for class 1 and 8.7-8.9 m for class 3; 0 for classes 6-8 on 92%; stable within a track (per-track std 0.09 m). A coarse estimate near a per-class default: a 4.8 m Mustang read 4.25 m. Held-out round 2026-10-02: L1, L3, L4 pass, L2 fails (class 3 is under 1.6x class 1 on 8 of 39 routes, where class 3 reads 3.6-6.6 m). X does not refer to the object center: no length term is needed in dRel.";
CM_ SG_ 114 FIELD_226_RAW "Radar firmware: 0.01*raw-1.57, valid below 316 (+-1.57, so likely an angle in rad); initial value 157 (0). Near 0 on moving objects (p5-p95 about +-0.15), spread over +-1.5 on stationary ones. Not the heading from motion: r -0.19 to +0.07 with the sign varying by route (docs/object-length-217.md). Meaning unknown.";
CM_ SG_ 114 TTC_SIGMA_CANDIDATE_RAW "TTC uncertainty (provisional): raw = TTC^2 * NORMALIZED_CLOSING_SIGMA / 64 within 0.1-2.5% on ten recordings. 127 = saturated or not populated; 0 = invalid. Stays populated on 3-26% of frames where TTC is defaulted (TTC about 8-19 s). Not read by the radar firmware.";
CM_ SG_ 114 FIELD_248_RAW "Not read by the radar firmware. Median raw 172. Meaning unknown.";
CM_ SG_ 114 WIDTH_FINE_258_CANDIDATE_RAW "Radar firmware: 8 bits, 0.0002*raw, no range check; stored next to AZIMUTH_CENTER, like the 0.0002 widths stored next to each edge. Values above 63 on 1.7% of frames. Angular extent measure, about 1/range within a track.";
CM_ SG_ 114 NORMALIZED_CLOSING_SIGMA_RAW "Bosch A NORMALIZED_CLOSING_SIGMA counterpart (accepted): specific to normalized-closing noise and monotonic with it on ten recordings; tied to TTC_SIGMA by a fixed 1/64 ratio. 0 when normalized closing is invalid. Radar firmware: 10 bits, 0.001*raw, valid below 1024, the same step as NORMALIZED_RATE. Values above 511 on 0.6% of frames, which the earlier 9-bit read truncated.";
CM_ SG_ 114 AUX_LATERAL_MOTION_304_CANDIDATE_RAW "Radar firmware: one 17-bit offset-binary field, raw*80/2^17-40, valid below 131072 (formerly read as signed 16 bits at 304 plus a direction bit at 320). Bit 320 is its sign: set on 49.7% of frames, which is why it agreed with the 16-bit value being nonnegative. Its scale (0.00061 per count) is far below the earlier 0.005-0.12 m/s bracket, so it is probably not a lateral speed in m/s; with the firmware decode it does not follow the azimuth rate, dY/dt, lateral velocity or its rate either (r < 0.08; docs/object-length-217.md). About 0 when normalized closing is invalid.";
CM_ SG_ 114 AUX_328_CANDIDATE_RAW "Radar firmware: 14 bits, 0.00002*raw, valid below 12501 (0-0.25). Changes nearly every frame; weak association with lateral and angular noise, not specific to one. 0 when normalized closing is invalid. Meaning unresolved.";
CM_ SG_ 114 FIELD_344_RAW "Radar firmware: 0.002*raw-10, valid below 8001 (+-10). Raw 5000 (0) on 68% of frames. Not acceleration: on lead-like objects its 90th-percentile magnitude is 0.04-0.12 against 0.55-1.83 m/s^2 of lead acceleration, r <= 0.2 (docs/object-length-217.md). Meaning unknown.";
CM_ SG_ 114 FIELD_360_RAW "Not read by the A230 radar firmware; the MY22 firmware (A070) defines 362:6 here instead. Median raw 48. Meaning unknown.";
CM_ SG_ 114 FIELD_368_RAW "Radar firmware: 0.0025*raw, valid below 1024. Raw 1 on 64% of frames. Meaning unknown.";
CM_ SG_ 114 AUX2_378_CANDIDATE_RAW "Radar firmware: same encoding as the azimuth fields, 0.00025*raw-1.02375, valid below 8192 (initial value 4095), and the radar passes it through atan like the edges: a tangent. Not signed 13-bit: with this decode its sign matches the azimuth on 98-99% of populated frames (routes 171, 17b, 19d), against 1-2% for a signed read. Shares one subrecord with ANGULAR_WIDTH_480: both hold their defaults together (8190 here; bits 480-487 zero) on about two thirds of observations. The MY22 firmware has no getter for it.";
CM_ SG_ 114 FIELD_391_RAW "Radar firmware: 0.05*raw, valid below 128. Scales with class: median 0.7 for class 1, 1.5 for class 3, 0 for classes 6-8; constant with age and range. Weakly related to how much OBJECT_LENGTH varies within a track (Spearman 0.19). Meaning unknown.";
CM_ SG_ 114 MATURITY_398_CANDIDATE_RAW "Radar firmware: one 7-bit field; not read. Values above 15 on 9.2% of frames. Counts down from about 6 to 1 as a track matures. Adds no velocity-error or survival information once track age is known.";
CM_ SG_ 114 FIELD_405_RAW "Not read by the radar firmware. Raw 49 on 82% of frames. Meaning unknown.";
CM_ SG_ 114 AZIMUTH_CENTER_RAW "Radar firmware: 0.00025*raw-1.02375 (zero at 4095), valid below 8192; unlike the edges, the radar does not pass it through atan here. Positive left. Equals the midpoint of the two edge fields on 97-99.9% of observations, so it is the same quantity as the edges: a tangent. The earlier 2^-12 rad per count, zero 4096, was 2.4% small.";
CM_ SG_ 114 AZIMUTH_EDGE_A_RAW "Left angular edge; same encoding as AZIMUTH_CENTER. The radar firmware passes it through atan, so it is the tangent of the angle: tan +-1.024 is about +-45.7 deg. Always at or left of the center. Clips at 8191.";
CM_ SG_ 114 FIELD_437_RAW "Radar firmware: raw, valid below 5. Shares: 1 55.5%, 2 9.3%, 3 35.0%, 4 0.3%. Meaning unknown.";
CM_ SG_ 114 AZIMUTH_EDGE_B_RAW "Right angular edge; same encoding as AZIMUTH_CENTER, passed through atan by the radar firmware (a tangent). Clips at 0 for near objects at the field-of-view edge. The edge difference is the Bosch A ANGULAR_WIDTH counterpart: it scales as 1/range within a track (log-log slope -0.91 to -0.99, ten recordings).";
CM_ SG_ 114 MOTION_CLASS_CANDIDATE_RAW "Radar firmware: bits 465-467, raw, valid below 5 (bit 464 is unused and never set). Values 0 78.6%, 1 4.0%, 2 17.4% (read as 0, 2, 4 before 2026-10-02). 2: same-direction traffic, and most objects seen only while ego is stopped. 1: oncoming or approaching, and most stationary objects seen while ego moves. 0: unassigned; young tracks, and every object on the 2026-09-10 and 2026-09-16 drives. Not a validated classifier.";
CM_ SG_ 114 ANGULAR_WIDTH_COARSE_CANDIDATE_RAW "Radar firmware: 0.0002*raw, no range check; stored next to AZIMUTH_EDGE_A. Angular extent measure, about 1/range within a track. Not a fixed-scale copy of the edge width (forward vs inverse fits 6-21 vs 14-24 edge counts per unit). Not received power.";
CM_ SG_ 114 ANGULAR_WIDTH_480_RAW "Angular-width measure (accepted 2026-09-29 on held-out routes): follows the azimuth-edge width (Spearman >= 0.8) and scales as about 1/range within tracks on 57 of 60 routes. Radar firmware: 0.0002*raw, no range check; stored next to AUX2_378. 0 while AUX2_378 holds its default.";
CM_ SG_ 114 ANGULAR_WIDTH_COARSE_COPY_CANDIDATE_RAW "Radar firmware: 0.0002*raw, no range check; stored next to AZIMUTH_EDGE_B. Byte 61 equals byte 59 on 99.7-100% of observations.";
BA_ "VFrameFormat" BO_ 116 14;
CM_ SG_ 116 CRC16_RAW "Capture-verified CRC16: polynomial 0x1021, init 0xFFFF, no reflection or xorout; bytes 2:64 then little-endian data ID 0x0fb4. The radar firmware's E2E receive configuration holds data IDs 0x0FAB-0x0FBA.";
CM_ SG_ 116 OBJECT_ID_RAW "Bits 32-39 (radar firmware; 40-47 are unused and never set). Observed 0 empty, 1 through 63 active. IDs move between wire slots and are reused.";
CM_ SG_ 116 LIFECYCLE_RAW "Observed +3 modulo 4096 per consecutive sweep for continuing IDs. Resets or discontinuities require a new track. Not read by the radar firmware.";
CM_ SG_ 116 FRAME_PHASE_RAW "Radar firmware: raw, valid below 16.";
CM_ SG_ 116 POSITION_X_RAW "Radar firmware: 0.05*raw m, valid below 4096, no offset (in the sender's frame). Unsigned 12-bit, bits 48-59; bit 60 belongs to OBJECT_CLASS_RAW. Working decode dRel = 0.05*raw-4.296 m (accepted): the -4.296 m is our measured offset to the bumper reference, not part of the encoding. The stock dash draws HUD_OBJECTS LONG_DIST from raw/4. Normalized closing and azimuth both imply a sensor range origin about 2.3 m behind the dRel origin, which fits the windshield camera that sends this bank.";
CM_ SG_ 116 OBJECT_CLASS_RAW "Object class, bits 60-63. Radar firmware: raw, valid below 16; it names no values. 1 car and 3 truck/large vehicle: accepted against the stock dash HUD_OBJECTS icons on held-out routes (99.6% and 99.2%). 6, 7 and 8 are not motorcycle, pedestrian and bicycle as such: against video within 25 m they name that object on 1 of 11, 3 of 13 and 3 of 12 clear labels, and are most often a car (2026-09-29). The stock dash shows icon 6 for moving two-wheelers, so its motorcycle icon adds a filter on top of class 6. 9-11 unconfirmed. Classes 1 and 3 never share a track with classes 6-11.";
CM_ SG_ 116 POSITION_Y_RAW "Lateral position, 14-bit offset binary, positive left. Radar firmware: 0.01*raw-81.91 m, zero at 8191 (also its initial value), valid below 16384. Until 2026-10-02 production used zero 8192 (1 cm right). The 0.01 m scale and 14-bit extent were accepted on held-out routes before the firmware confirmed them. A 13-bit read wraps past +-40.95 m.";
CM_ SG_ 116 LIFE_STATE_CANDIDATE_RAW "Radar firmware: a separate 2-bit field, raw, valid below 4. Life state 0 newborn, 1 established, 2 ending (2 on 6-26% of a track last three frames vs 0.1-4% mid-life, ten recordings). Shares: 0 9.6%, 1 88.1%, 2 2.3%; 3 never seen.";
CM_ SG_ 116 VELOCITY_RAW "Relative velocity. Radar firmware: 0.1*raw-154.0 m/s, zero at 1540 (also its initial value), valid below 2048; the MY22 firmware (A070) reads it the same way. Production used zero 1539 (+0.1 m/s) until 2026-10-02. Stationary objects read about -0.3 m/s against vEgo with 1539 and -0.4 m/s with 1540, which points at the wheel-speed reference rather than the encoding. Raw 0 (-154 m/s) is a floor saturation on newborn far objects, not a sentinel.";
CM_ SG_ 116 LATERAL_VELOCITY_RAW "Lateral velocity, positive left, relative in the sensor frame (includes the apparent motion of stationary objects from ego yaw). Radar firmware: 0.1*raw-51.1 m/s, zero at 511 (also its initial value), valid below 1024. Accepted 2026-10-02: the research decode 0.1*(raw-511) was provisional only because one held-out scale bracket (0.1004-0.1085) missed 0.1; the firmware settles the scale.";
CM_ SG_ 116 ENUM_106_CANDIDATE_RAW "Radar firmware: one 3-bit field, raw, valid below 5 (formerly read as flags at bits 106 and 107). Shares: 0 14.6%, 1 83.8%, 2 1.0%, 3 0.7%, 4 under 0.1%. Bit 106 (odd values) is set on about 40% of newborn frames and 97-99% after 1 s and agrees with LIFE_STATE 1 on 96%; bit 107 (values 2-3) is mostly on mature same-direction movers. Meaning unresolved.";
CM_ SG_ 116 ENUM_109_CANDIDATE_RAW "Not read by the radar firmware. Values 0-4. 1 on most established tracks; 2-4 mostly on same-direction movers near the path with high existence. Not an object class (metric width about 1.7 m for all values) and not a left/right lane code. Meaning unresolved.";
CM_ SG_ 116 EXISTENCE_PROBABILITY_RAW "Bosch A OBJECT_EXISTENCE_PROBABILITY counterpart (accepted). Radar firmware: 2*raw percent, valid below 51 (100%); observed 0-49, 49 most common. Best survival predictor within range x age strata on ten recordings (AUC 0.67-0.92); falls over the last second before track death; low on short-lived ghosts. 0 marks a degraded measurement (accepted on held-out routes: range innovation and vRel steps at least 2x worse on 17 of 17).";
CM_ SG_ 116 NORMALIZED_RATE_RAW "Bosch A NORMALIZED_CLOSING counterpart. Radar firmware: 0.001*raw-40 (1/s), valid below 65001. Accepted 2026-10-02: the research decode 0.001*(raw-40000) 1/s matches the firmware exactly; approximately vRel/(dRel+2.3 m) and follows Doppler vRel, not range change. 64999 marks invalid in the data (TTC 0, TTC sigma 0 and normalized-closing sigma 0 in the same frame), though the firmware getter accepts it.";
CM_ SG_ 116 QUALITY_CONTAINER_RAW "Bits 144-153 (radar firmware; 154-159 are unused and never set). Radar firmware: 0.05*raw, valid below 1024; the 0.05 step equals the range resolution. Bosch A RANGE_SIGMA candidate (provisional): range-noise specific on 8 of 10 recordings, weak (partial rho 0.08-0.25). Strongly range dependent. Unit unnamed.";
CM_ SG_ 116 REL_VELOCITY_UNCERTAINTY_RAW "Bosch A REL_VELOCITY_UNCERTAINTY counterpart (accepted, raw units): velocity-noise specific and monotonic with empirical vRel noise on ten recordings. Radar firmware: 0.1*raw, valid below 1024, unit unnamed. Nonlinear against our measured vRel noise (the adapter maps it empirically).";
CM_ SG_ 116 UNCERTAINTY_160_CANDIDATE_RAW "Radar firmware: 10 bits, 0.02*raw, valid below 1024. Mostly 1-2; higher on young and laterally offset objects. Weak noise association. Unit unnamed.";
CM_ SG_ 116 ACQUISITION_186_CANDIDATE_RAW "Radar firmware: 6 bits, 0.01*raw, valid below 64. Starts near 23 on newborn tracks and decays to about 2. Carries little information beyond track age.";
CM_ SG_ 116 UNCERTAINTY_192_CANDIDATE_RAW "Radar firmware: 9 bits, 0.1*raw, valid below 512. Decays with age; mixed velocity and lateral noise association, not specific to one noise. Unit unnamed.";
CM_ SG_ 116 TTC_RAW "Time to collision (accepted 2026-09-28 on held-out routes), (raw-1024)/128 s: a constant-velocity TTC, equal to -1/normalized closing within 0.06-0.10 s median. Reported only while an acceleration-aware collision prediction expects impact (lagging it by about 1-2 s); otherwise 2046. 0 = invalid (normalized closing 64999). Not read by the radar firmware, so the scale rests on captures. No Bosch A counterpart.";
CM_ SG_ 116 OBJECT_LENGTH_CANDIDATE_RAW "Object length, provisional (docs/object-length-217.md). Radar firmware: 0.05*raw m, valid below 512. Median 4.25 m for class 1 and 8.7-8.9 m for class 3; 0 for classes 6-8 on 92%; stable within a track (per-track std 0.09 m). A coarse estimate near a per-class default: a 4.8 m Mustang read 4.25 m. Held-out round 2026-10-02: L1, L3, L4 pass, L2 fails (class 3 is under 1.6x class 1 on 8 of 39 routes, where class 3 reads 3.6-6.6 m). X does not refer to the object center: no length term is needed in dRel.";
CM_ SG_ 116 FIELD_226_RAW "Radar firmware: 0.01*raw-1.57, valid below 316 (+-1.57, so likely an angle in rad); initial value 157 (0). Near 0 on moving objects (p5-p95 about +-0.15), spread over +-1.5 on stationary ones. Not the heading from motion: r -0.19 to +0.07 with the sign varying by route (docs/object-length-217.md). Meaning unknown.";
CM_ SG_ 116 TTC_SIGMA_CANDIDATE_RAW "TTC uncertainty (provisional): raw = TTC^2 * NORMALIZED_CLOSING_SIGMA / 64 within 0.1-2.5% on ten recordings. 127 = saturated or not populated; 0 = invalid. Stays populated on 3-26% of frames where TTC is defaulted (TTC about 8-19 s). Not read by the radar firmware.";
CM_ SG_ 116 FIELD_248_RAW "Not read by the radar firmware. Median raw 172. Meaning unknown.";
CM_ SG_ 116 WIDTH_FINE_258_CANDIDATE_RAW "Radar firmware: 8 bits, 0.0002*raw, no range check; stored next to AZIMUTH_CENTER, like the 0.0002 widths stored next to each edge. Values above 63 on 1.7% of frames. Angular extent measure, about 1/range within a track.";
CM_ SG_ 116 NORMALIZED_CLOSING_SIGMA_RAW "Bosch A NORMALIZED_CLOSING_SIGMA counterpart (accepted): specific to normalized-closing noise and monotonic with it on ten recordings; tied to TTC_SIGMA by a fixed 1/64 ratio. 0 when normalized closing is invalid. Radar firmware: 10 bits, 0.001*raw, valid below 1024, the same step as NORMALIZED_RATE. Values above 511 on 0.6% of frames, which the earlier 9-bit read truncated.";
CM_ SG_ 116 AUX_LATERAL_MOTION_304_CANDIDATE_RAW "Radar firmware: one 17-bit offset-binary field, raw*80/2^17-40, valid below 131072 (formerly read as signed 16 bits at 304 plus a direction bit at 320). Bit 320 is its sign: set on 49.7% of frames, which is why it agreed with the 16-bit value being nonnegative. Its scale (0.00061 per count) is far below the earlier 0.005-0.12 m/s bracket, so it is probably not a lateral speed in m/s; with the firmware decode it does not follow the azimuth rate, dY/dt, lateral velocity or its rate either (r < 0.08; docs/object-length-217.md). About 0 when normalized closing is invalid.";
CM_ SG_ 116 AUX_328_CANDIDATE_RAW "Radar firmware: 14 bits, 0.00002*raw, valid below 12501 (0-0.25). Changes nearly every frame; weak association with lateral and angular noise, not specific to one. 0 when normalized closing is invalid. Meaning unresolved.";
CM_ SG_ 116 FIELD_344_RAW "Radar firmware: 0.002*raw-10, valid below 8001 (+-10). Raw 5000 (0) on 68% of frames. Not acceleration: on lead-like objects its 90th-percentile magnitude is 0.04-0.12 against 0.55-1.83 m/s^2 of lead acceleration, r <= 0.2 (docs/object-length-217.md). Meaning unknown.";
CM_ SG_ 116 FIELD_360_RAW "Not read by the A230 radar firmware; the MY22 firmware (A070) defines 362:6 here instead. Median raw 48. Meaning unknown.";
CM_ SG_ 116 FIELD_368_RAW "Radar firmware: 0.0025*raw, valid below 1024. Raw 1 on 64% of frames. Meaning unknown.";
CM_ SG_ 116 AUX2_378_CANDIDATE_RAW "Radar firmware: same encoding as the azimuth fields, 0.00025*raw-1.02375, valid below 8192 (initial value 4095), and the radar passes it through atan like the edges: a tangent. Not signed 13-bit: with this decode its sign matches the azimuth on 98-99% of populated frames (routes 171, 17b, 19d), against 1-2% for a signed read. Shares one subrecord with ANGULAR_WIDTH_480: both hold their defaults together (8190 here; bits 480-487 zero) on about two thirds of observations. The MY22 firmware has no getter for it.";
CM_ SG_ 116 FIELD_391_RAW "Radar firmware: 0.05*raw, valid below 128. Scales with class: median 0.7 for class 1, 1.5 for class 3, 0 for classes 6-8; constant with age and range. Weakly related to how much OBJECT_LENGTH varies within a track (Spearman 0.19). Meaning unknown.";
CM_ SG_ 116 MATURITY_398_CANDIDATE_RAW "Radar firmware: one 7-bit field; not read. Values above 15 on 9.2% of frames. Counts down from about 6 to 1 as a track matures. Adds no velocity-error or survival information once track age is known.";
CM_ SG_ 116 FIELD_405_RAW "Not read by the radar firmware. Raw 49 on 82% of frames. Meaning unknown.";
CM_ SG_ 116 AZIMUTH_CENTER_RAW "Radar firmware: 0.00025*raw-1.02375 (zero at 4095), valid below 8192; unlike the edges, the radar does not pass it through atan here. Positive left. Equals the midpoint of the two edge fields on 97-99.9% of observations, so it is the same quantity as the edges: a tangent. The earlier 2^-12 rad per count, zero 4096, was 2.4% small.";
CM_ SG_ 116 AZIMUTH_EDGE_A_RAW "Left angular edge; same encoding as AZIMUTH_CENTER. The radar firmware passes it through atan, so it is the tangent of the angle: tan +-1.024 is about +-45.7 deg. Always at or left of the center. Clips at 8191.";
CM_ SG_ 116 FIELD_437_RAW "Radar firmware: raw, valid below 5. Shares: 1 55.5%, 2 9.3%, 3 35.0%, 4 0.3%. Meaning unknown.";
CM_ SG_ 116 AZIMUTH_EDGE_B_RAW "Right angular edge; same encoding as AZIMUTH_CENTER, passed through atan by the radar firmware (a tangent). Clips at 0 for near objects at the field-of-view edge. The edge difference is the Bosch A ANGULAR_WIDTH counterpart: it scales as 1/range within a track (log-log slope -0.91 to -0.99, ten recordings).";
CM_ SG_ 116 MOTION_CLASS_CANDIDATE_RAW "Radar firmware: bits 465-467, raw, valid below 5 (bit 464 is unused and never set). Values 0 78.6%, 1 4.0%, 2 17.4% (read as 0, 2, 4 before 2026-10-02). 2: same-direction traffic, and most objects seen only while ego is stopped. 1: oncoming or approaching, and most stationary objects seen while ego moves. 0: unassigned; young tracks, and every object on the 2026-09-10 and 2026-09-16 drives. Not a validated classifier.";
CM_ SG_ 116 ANGULAR_WIDTH_COARSE_CANDIDATE_RAW "Radar firmware: 0.0002*raw, no range check; stored next to AZIMUTH_EDGE_A. Angular extent measure, about 1/range within a track. Not a fixed-scale copy of the edge width (forward vs inverse fits 6-21 vs 14-24 edge counts per unit). Not received power.";
CM_ SG_ 116 ANGULAR_WIDTH_480_RAW "Angular-width measure (accepted 2026-09-29 on held-out routes): follows the azimuth-edge width (Spearman >= 0.8) and scales as about 1/range within tracks on 57 of 60 routes. Radar firmware: 0.0002*raw, no range check; stored next to AUX2_378. 0 while AUX2_378 holds its default.";
CM_ SG_ 116 ANGULAR_WIDTH_COARSE_COPY_CANDIDATE_RAW "Radar firmware: 0.0002*raw, no range check; stored next to AZIMUTH_EDGE_B. Byte 61 equals byte 59 on 99.7-100% of observations.";
BA_ "VFrameFormat" BO_ 118 14;
CM_ SG_ 118 CRC16_RAW "Capture-verified CRC16: polynomial 0x1021, init 0xFFFF, no reflection or xorout; bytes 2:64 then little-endian data ID 0x0fb5. The radar firmware's E2E receive configuration holds data IDs 0x0FAB-0x0FBA.";
CM_ SG_ 118 OBJECT_ID_RAW "Bits 32-39 (radar firmware; 40-47 are unused and never set). Observed 0 empty, 1 through 63 active. IDs move between wire slots and are reused.";
CM_ SG_ 118 LIFECYCLE_RAW "Observed +3 modulo 4096 per consecutive sweep for continuing IDs. Resets or discontinuities require a new track. Not read by the radar firmware.";
CM_ SG_ 118 FRAME_PHASE_RAW "Radar firmware: raw, valid below 16.";
CM_ SG_ 118 POSITION_X_RAW "Radar firmware: 0.05*raw m, valid below 4096, no offset (in the sender's frame). Unsigned 12-bit, bits 48-59; bit 60 belongs to OBJECT_CLASS_RAW. Working decode dRel = 0.05*raw-4.296 m (accepted): the -4.296 m is our measured offset to the bumper reference, not part of the encoding. The stock dash draws HUD_OBJECTS LONG_DIST from raw/4. Normalized closing and azimuth both imply a sensor range origin about 2.3 m behind the dRel origin, which fits the windshield camera that sends this bank.";
CM_ SG_ 118 OBJECT_CLASS_RAW "Object class, bits 60-63. Radar firmware: raw, valid below 16; it names no values. 1 car and 3 truck/large vehicle: accepted against the stock dash HUD_OBJECTS icons on held-out routes (99.6% and 99.2%). 6, 7 and 8 are not motorcycle, pedestrian and bicycle as such: against video within 25 m they name that object on 1 of 11, 3 of 13 and 3 of 12 clear labels, and are most often a car (2026-09-29). The stock dash shows icon 6 for moving two-wheelers, so its motorcycle icon adds a filter on top of class 6. 9-11 unconfirmed. Classes 1 and 3 never share a track with classes 6-11.";
CM_ SG_ 118 POSITION_Y_RAW "Lateral position, 14-bit offset binary, positive left. Radar firmware: 0.01*raw-81.91 m, zero at 8191 (also its initial value), valid below 16384. Until 2026-10-02 production used zero 8192 (1 cm right). The 0.01 m scale and 14-bit extent were accepted on held-out routes before the firmware confirmed them. A 13-bit read wraps past +-40.95 m.";
CM_ SG_ 118 LIFE_STATE_CANDIDATE_RAW "Radar firmware: a separate 2-bit field, raw, valid below 4. Life state 0 newborn, 1 established, 2 ending (2 on 6-26% of a track last three frames vs 0.1-4% mid-life, ten recordings). Shares: 0 9.6%, 1 88.1%, 2 2.3%; 3 never seen.";
CM_ SG_ 118 VELOCITY_RAW "Relative velocity. Radar firmware: 0.1*raw-154.0 m/s, zero at 1540 (also its initial value), valid below 2048; the MY22 firmware (A070) reads it the same way. Production used zero 1539 (+0.1 m/s) until 2026-10-02. Stationary objects read about -0.3 m/s against vEgo with 1539 and -0.4 m/s with 1540, which points at the wheel-speed reference rather than the encoding. Raw 0 (-154 m/s) is a floor saturation on newborn far objects, not a sentinel.";
CM_ SG_ 118 LATERAL_VELOCITY_RAW "Lateral velocity, positive left, relative in the sensor frame (includes the apparent motion of stationary objects from ego yaw). Radar firmware: 0.1*raw-51.1 m/s, zero at 511 (also its initial value), valid below 1024. Accepted 2026-10-02: the research decode 0.1*(raw-511) was provisional only because one held-out scale bracket (0.1004-0.1085) missed 0.1; the firmware settles the scale.";
CM_ SG_ 118 ENUM_106_CANDIDATE_RAW "Radar firmware: one 3-bit field, raw, valid below 5 (formerly read as flags at bits 106 and 107). Shares: 0 14.6%, 1 83.8%, 2 1.0%, 3 0.7%, 4 under 0.1%. Bit 106 (odd values) is set on about 40% of newborn frames and 97-99% after 1 s and agrees with LIFE_STATE 1 on 96%; bit 107 (values 2-3) is mostly on mature same-direction movers. Meaning unresolved.";
CM_ SG_ 118 ENUM_109_CANDIDATE_RAW "Not read by the radar firmware. Values 0-4. 1 on most established tracks; 2-4 mostly on same-direction movers near the path with high existence. Not an object class (metric width about 1.7 m for all values) and not a left/right lane code. Meaning unresolved.";
CM_ SG_ 118 EXISTENCE_PROBABILITY_RAW "Bosch A OBJECT_EXISTENCE_PROBABILITY counterpart (accepted). Radar firmware: 2*raw percent, valid below 51 (100%); observed 0-49, 49 most common. Best survival predictor within range x age strata on ten recordings (AUC 0.67-0.92); falls over the last second before track death; low on short-lived ghosts. 0 marks a degraded measurement (accepted on held-out routes: range innovation and vRel steps at least 2x worse on 17 of 17).";
CM_ SG_ 118 NORMALIZED_RATE_RAW "Bosch A NORMALIZED_CLOSING counterpart. Radar firmware: 0.001*raw-40 (1/s), valid below 65001. Accepted 2026-10-02: the research decode 0.001*(raw-40000) 1/s matches the firmware exactly; approximately vRel/(dRel+2.3 m) and follows Doppler vRel, not range change. 64999 marks invalid in the data (TTC 0, TTC sigma 0 and normalized-closing sigma 0 in the same frame), though the firmware getter accepts it.";
CM_ SG_ 118 QUALITY_CONTAINER_RAW "Bits 144-153 (radar firmware; 154-159 are unused and never set). Radar firmware: 0.05*raw, valid below 1024; the 0.05 step equals the range resolution. Bosch A RANGE_SIGMA candidate (provisional): range-noise specific on 8 of 10 recordings, weak (partial rho 0.08-0.25). Strongly range dependent. Unit unnamed.";
CM_ SG_ 118 REL_VELOCITY_UNCERTAINTY_RAW "Bosch A REL_VELOCITY_UNCERTAINTY counterpart (accepted, raw units): velocity-noise specific and monotonic with empirical vRel noise on ten recordings. Radar firmware: 0.1*raw, valid below 1024, unit unnamed. Nonlinear against our measured vRel noise (the adapter maps it empirically).";
CM_ SG_ 118 UNCERTAINTY_160_CANDIDATE_RAW "Radar firmware: 10 bits, 0.02*raw, valid below 1024. Mostly 1-2; higher on young and laterally offset objects. Weak noise association. Unit unnamed.";
CM_ SG_ 118 ACQUISITION_186_CANDIDATE_RAW "Radar firmware: 6 bits, 0.01*raw, valid below 64. Starts near 23 on newborn tracks and decays to about 2. Carries little information beyond track age.";
CM_ SG_ 118 UNCERTAINTY_192_CANDIDATE_RAW "Radar firmware: 9 bits, 0.1*raw, valid below 512. Decays with age; mixed velocity and lateral noise association, not specific to one noise. Unit unnamed.";
CM_ SG_ 118 TTC_RAW "Time to collision (accepted 2026-09-28 on held-out routes), (raw-1024)/128 s: a constant-velocity TTC, equal to -1/normalized closing within 0.06-0.10 s median. Reported only while an acceleration-aware collision prediction expects impact (lagging it by about 1-2 s); otherwise 2046. 0 = invalid (normalized closing 64999). Not read by the radar firmware, so the scale rests on captures. No Bosch A counterpart.";
CM_ SG_ 118 OBJECT_LENGTH_CANDIDATE_RAW "Object length, provisional (docs/object-length-217.md). Radar firmware: 0.05*raw m, valid below 512. Median 4.25 m for class 1 and 8.7-8.9 m for class 3; 0 for classes 6-8 on 92%; stable within a track (per-track std 0.09 m). A coarse estimate near a per-class default: a 4.8 m Mustang read 4.25 m. Held-out round 2026-10-02: L1, L3, L4 pass, L2 fails (class 3 is under 1.6x class 1 on 8 of 39 routes, where class 3 reads 3.6-6.6 m). X does not refer to the object center: no length term is needed in dRel.";
CM_ SG_ 118 FIELD_226_RAW "Radar firmware: 0.01*raw-1.57, valid below 316 (+-1.57, so likely an angle in rad); initial value 157 (0). Near 0 on moving objects (p5-p95 about +-0.15), spread over +-1.5 on stationary ones. Not the heading from motion: r -0.19 to +0.07 with the sign varying by route (docs/object-length-217.md). Meaning unknown.";
CM_ SG_ 118 TTC_SIGMA_CANDIDATE_RAW "TTC uncertainty (provisional): raw = TTC^2 * NORMALIZED_CLOSING_SIGMA / 64 within 0.1-2.5% on ten recordings. 127 = saturated or not populated; 0 = invalid. Stays populated on 3-26% of frames where TTC is defaulted (TTC about 8-19 s). Not read by the radar firmware.";
CM_ SG_ 118 FIELD_248_RAW "Not read by the radar firmware. Median raw 172. Meaning unknown.";
CM_ SG_ 118 WIDTH_FINE_258_CANDIDATE_RAW "Radar firmware: 8 bits, 0.0002*raw, no range check; stored next to AZIMUTH_CENTER, like the 0.0002 widths stored next to each edge. Values above 63 on 1.7% of frames. Angular extent measure, about 1/range within a track.";
CM_ SG_ 118 NORMALIZED_CLOSING_SIGMA_RAW "Bosch A NORMALIZED_CLOSING_SIGMA counterpart (accepted): specific to normalized-closing noise and monotonic with it on ten recordings; tied to TTC_SIGMA by a fixed 1/64 ratio. 0 when normalized closing is invalid. Radar firmware: 10 bits, 0.001*raw, valid below 1024, the same step as NORMALIZED_RATE. Values above 511 on 0.6% of frames, which the earlier 9-bit read truncated.";
CM_ SG_ 118 AUX_LATERAL_MOTION_304_CANDIDATE_RAW "Radar firmware: one 17-bit offset-binary field, raw*80/2^17-40, valid below 131072 (formerly read as signed 16 bits at 304 plus a direction bit at 320). Bit 320 is its sign: set on 49.7% of frames, which is why it agreed with the 16-bit value being nonnegative. Its scale (0.00061 per count) is far below the earlier 0.005-0.12 m/s bracket, so it is probably not a lateral speed in m/s; with the firmware decode it does not follow the azimuth rate, dY/dt, lateral velocity or its rate either (r < 0.08; docs/object-length-217.md). About 0 when normalized closing is invalid.";
CM_ SG_ 118 AUX_328_CANDIDATE_RAW "Radar firmware: 14 bits, 0.00002*raw, valid below 12501 (0-0.25). Changes nearly every frame; weak association with lateral and angular noise, not specific to one. 0 when normalized closing is invalid. Meaning unresolved.";
CM_ SG_ 118 FIELD_344_RAW "Radar firmware: 0.002*raw-10, valid below 8001 (+-10). Raw 5000 (0) on 68% of frames. Not acceleration: on lead-like objects its 90th-percentile magnitude is 0.04-0.12 against 0.55-1.83 m/s^2 of lead acceleration, r <= 0.2 (docs/object-length-217.md). Meaning unknown.";
CM_ SG_ 118 FIELD_360_RAW "Not read by the A230 radar firmware; the MY22 firmware (A070) defines 362:6 here instead. Median raw 48. Meaning unknown.";
CM_ SG_ 118 FIELD_368_RAW "Radar firmware: 0.0025*raw, valid below 1024. Raw 1 on 64% of frames. Meaning unknown.";
CM_ SG_ 118 AUX2_378_CANDIDATE_RAW "Radar firmware: same encoding as the azimuth fields, 0.00025*raw-1.02375, valid below 8192 (initial value 4095), and the radar passes it through atan like the edges: a tangent. Not signed 13-bit: with this decode its sign matches the azimuth on 98-99% of populated frames (routes 171, 17b, 19d), against 1-2% for a signed read. Shares one subrecord with ANGULAR_WIDTH_480: both hold their defaults together (8190 here; bits 480-487 zero) on about two thirds of observations. The MY22 firmware has no getter for it.";
CM_ SG_ 118 FIELD_391_RAW "Radar firmware: 0.05*raw, valid below 128. Scales with class: median 0.7 for class 1, 1.5 for class 3, 0 for classes 6-8; constant with age and range. Weakly related to how much OBJECT_LENGTH varies within a track (Spearman 0.19). Meaning unknown.";
CM_ SG_ 118 MATURITY_398_CANDIDATE_RAW "Radar firmware: one 7-bit field; not read. Values above 15 on 9.2% of frames. Counts down from about 6 to 1 as a track matures. Adds no velocity-error or survival information once track age is known.";
CM_ SG_ 118 FIELD_405_RAW "Not read by the radar firmware. Raw 49 on 82% of frames. Meaning unknown.";
CM_ SG_ 118 AZIMUTH_CENTER_RAW "Radar firmware: 0.00025*raw-1.02375 (zero at 4095), valid below 8192; unlike the edges, the radar does not pass it through atan here. Positive left. Equals the midpoint of the two edge fields on 97-99.9% of observations, so it is the same quantity as the edges: a tangent. The earlier 2^-12 rad per count, zero 4096, was 2.4% small.";
CM_ SG_ 118 AZIMUTH_EDGE_A_RAW "Left angular edge; same encoding as AZIMUTH_CENTER. The radar firmware passes it through atan, so it is the tangent of the angle: tan +-1.024 is about +-45.7 deg. Always at or left of the center. Clips at 8191.";
CM_ SG_ 118 FIELD_437_RAW "Radar firmware: raw, valid below 5. Shares: 1 55.5%, 2 9.3%, 3 35.0%, 4 0.3%. Meaning unknown.";
CM_ SG_ 118 AZIMUTH_EDGE_B_RAW "Right angular edge; same encoding as AZIMUTH_CENTER, passed through atan by the radar firmware (a tangent). Clips at 0 for near objects at the field-of-view edge. The edge difference is the Bosch A ANGULAR_WIDTH counterpart: it scales as 1/range within a track (log-log slope -0.91 to -0.99, ten recordings).";
CM_ SG_ 118 MOTION_CLASS_CANDIDATE_RAW "Radar firmware: bits 465-467, raw, valid below 5 (bit 464 is unused and never set). Values 0 78.6%, 1 4.0%, 2 17.4% (read as 0, 2, 4 before 2026-10-02). 2: same-direction traffic, and most objects seen only while ego is stopped. 1: oncoming or approaching, and most stationary objects seen while ego moves. 0: unassigned; young tracks, and every object on the 2026-09-10 and 2026-09-16 drives. Not a validated classifier.";
CM_ SG_ 118 ANGULAR_WIDTH_COARSE_CANDIDATE_RAW "Radar firmware: 0.0002*raw, no range check; stored next to AZIMUTH_EDGE_A. Angular extent measure, about 1/range within a track. Not a fixed-scale copy of the edge width (forward vs inverse fits 6-21 vs 14-24 edge counts per unit). Not received power.";
CM_ SG_ 118 ANGULAR_WIDTH_480_RAW "Angular-width measure (accepted 2026-09-29 on held-out routes): follows the azimuth-edge width (Spearman >= 0.8) and scales as about 1/range within tracks on 57 of 60 routes. Radar firmware: 0.0002*raw, no range check; stored next to AUX2_378. 0 while AUX2_378 holds its default.";
CM_ SG_ 118 ANGULAR_WIDTH_COARSE_COPY_CANDIDATE_RAW "Radar firmware: 0.0002*raw, no range check; stored next to AZIMUTH_EDGE_B. Byte 61 equals byte 59 on 99.7-100% of observations.";
BA_ "VFrameFormat" BO_ 120 14;
CM_ SG_ 120 CRC16_RAW "Capture-verified CRC16: polynomial 0x1021, init 0xFFFF, no reflection or xorout; bytes 2:64 then little-endian data ID 0x0fb6. The radar firmware's E2E receive configuration holds data IDs 0x0FAB-0x0FBA.";
CM_ SG_ 120 OBJECT_ID_RAW "Bits 32-39 (radar firmware; 40-47 are unused and never set). Observed 0 empty, 1 through 63 active. IDs move between wire slots and are reused.";
CM_ SG_ 120 LIFECYCLE_RAW "Observed +3 modulo 4096 per consecutive sweep for continuing IDs. Resets or discontinuities require a new track. Not read by the radar firmware.";
CM_ SG_ 120 FRAME_PHASE_RAW "Radar firmware: raw, valid below 16.";
CM_ SG_ 120 POSITION_X_RAW "Radar firmware: 0.05*raw m, valid below 4096, no offset (in the sender's frame). Unsigned 12-bit, bits 48-59; bit 60 belongs to OBJECT_CLASS_RAW. Working decode dRel = 0.05*raw-4.296 m (accepted): the -4.296 m is our measured offset to the bumper reference, not part of the encoding. The stock dash draws HUD_OBJECTS LONG_DIST from raw/4. Normalized closing and azimuth both imply a sensor range origin about 2.3 m behind the dRel origin, which fits the windshield camera that sends this bank.";
CM_ SG_ 120 OBJECT_CLASS_RAW "Object class, bits 60-63. Radar firmware: raw, valid below 16; it names no values. 1 car and 3 truck/large vehicle: accepted against the stock dash HUD_OBJECTS icons on held-out routes (99.6% and 99.2%). 6, 7 and 8 are not motorcycle, pedestrian and bicycle as such: against video within 25 m they name that object on 1 of 11, 3 of 13 and 3 of 12 clear labels, and are most often a car (2026-09-29). The stock dash shows icon 6 for moving two-wheelers, so its motorcycle icon adds a filter on top of class 6. 9-11 unconfirmed. Classes 1 and 3 never share a track with classes 6-11.";
CM_ SG_ 120 POSITION_Y_RAW "Lateral position, 14-bit offset binary, positive left. Radar firmware: 0.01*raw-81.91 m, zero at 8191 (also its initial value), valid below 16384. Until 2026-10-02 production used zero 8192 (1 cm right). The 0.01 m scale and 14-bit extent were accepted on held-out routes before the firmware confirmed them. A 13-bit read wraps past +-40.95 m.";
CM_ SG_ 120 LIFE_STATE_CANDIDATE_RAW "Radar firmware: a separate 2-bit field, raw, valid below 4. Life state 0 newborn, 1 established, 2 ending (2 on 6-26% of a track last three frames vs 0.1-4% mid-life, ten recordings). Shares: 0 9.6%, 1 88.1%, 2 2.3%; 3 never seen.";
CM_ SG_ 120 VELOCITY_RAW "Relative velocity. Radar firmware: 0.1*raw-154.0 m/s, zero at 1540 (also its initial value), valid below 2048; the MY22 firmware (A070) reads it the same way. Production used zero 1539 (+0.1 m/s) until 2026-10-02. Stationary objects read about -0.3 m/s against vEgo with 1539 and -0.4 m/s with 1540, which points at the wheel-speed reference rather than the encoding. Raw 0 (-154 m/s) is a floor saturation on newborn far objects, not a sentinel.";
CM_ SG_ 120 LATERAL_VELOCITY_RAW "Lateral velocity, positive left, relative in the sensor frame (includes the apparent motion of stationary objects from ego yaw). Radar firmware: 0.1*raw-51.1 m/s, zero at 511 (also its initial value), valid below 1024. Accepted 2026-10-02: the research decode 0.1*(raw-511) was provisional only because one held-out scale bracket (0.1004-0.1085) missed 0.1; the firmware settles the scale.";
CM_ SG_ 120 ENUM_106_CANDIDATE_RAW "Radar firmware: one 3-bit field, raw, valid below 5 (formerly read as flags at bits 106 and 107). Shares: 0 14.6%, 1 83.8%, 2 1.0%, 3 0.7%, 4 under 0.1%. Bit 106 (odd values) is set on about 40% of newborn frames and 97-99% after 1 s and agrees with LIFE_STATE 1 on 96%; bit 107 (values 2-3) is mostly on mature same-direction movers. Meaning unresolved.";
CM_ SG_ 120 ENUM_109_CANDIDATE_RAW "Not read by the radar firmware. Values 0-4. 1 on most established tracks; 2-4 mostly on same-direction movers near the path with high existence. Not an object class (metric width about 1.7 m for all values) and not a left/right lane code. Meaning unresolved.";
CM_ SG_ 120 EXISTENCE_PROBABILITY_RAW "Bosch A OBJECT_EXISTENCE_PROBABILITY counterpart (accepted). Radar firmware: 2*raw percent, valid below 51 (100%); observed 0-49, 49 most common. Best survival predictor within range x age strata on ten recordings (AUC 0.67-0.92); falls over the last second before track death; low on short-lived ghosts. 0 marks a degraded measurement (accepted on held-out routes: range innovation and vRel steps at least 2x worse on 17 of 17).";
CM_ SG_ 120 NORMALIZED_RATE_RAW "Bosch A NORMALIZED_CLOSING counterpart. Radar firmware: 0.001*raw-40 (1/s), valid below 65001. Accepted 2026-10-02: the research decode 0.001*(raw-40000) 1/s matches the firmware exactly; approximately vRel/(dRel+2.3 m) and follows Doppler vRel, not range change. 64999 marks invalid in the data (TTC 0, TTC sigma 0 and normalized-closing sigma 0 in the same frame), though the firmware getter accepts it.";
CM_ SG_ 120 QUALITY_CONTAINER_RAW "Bits 144-153 (radar firmware; 154-159 are unused and never set). Radar firmware: 0.05*raw, valid below 1024; the 0.05 step equals the range resolution. Bosch A RANGE_SIGMA candidate (provisional): range-noise specific on 8 of 10 recordings, weak (partial rho 0.08-0.25). Strongly range dependent. Unit unnamed.";
CM_ SG_ 120 REL_VELOCITY_UNCERTAINTY_RAW "Bosch A REL_VELOCITY_UNCERTAINTY counterpart (accepted, raw units): velocity-noise specific and monotonic with empirical vRel noise on ten recordings. Radar firmware: 0.1*raw, valid below 1024, unit unnamed. Nonlinear against our measured vRel noise (the adapter maps it empirically).";
CM_ SG_ 120 UNCERTAINTY_160_CANDIDATE_RAW "Radar firmware: 10 bits, 0.02*raw, valid below 1024. Mostly 1-2; higher on young and laterally offset objects. Weak noise association. Unit unnamed.";
CM_ SG_ 120 ACQUISITION_186_CANDIDATE_RAW "Radar firmware: 6 bits, 0.01*raw, valid below 64. Starts near 23 on newborn tracks and decays to about 2. Carries little information beyond track age.";
CM_ SG_ 120 UNCERTAINTY_192_CANDIDATE_RAW "Radar firmware: 9 bits, 0.1*raw, valid below 512. Decays with age; mixed velocity and lateral noise association, not specific to one noise. Unit unnamed.";
CM_ SG_ 120 TTC_RAW "Time to collision (accepted 2026-09-28 on held-out routes), (raw-1024)/128 s: a constant-velocity TTC, equal to -1/normalized closing within 0.06-0.10 s median. Reported only while an acceleration-aware collision prediction expects impact (lagging it by about 1-2 s); otherwise 2046. 0 = invalid (normalized closing 64999). Not read by the radar firmware, so the scale rests on captures. No Bosch A counterpart.";
CM_ SG_ 120 OBJECT_LENGTH_CANDIDATE_RAW "Object length, provisional (docs/object-length-217.md). Radar firmware: 0.05*raw m, valid below 512. Median 4.25 m for class 1 and 8.7-8.9 m for class 3; 0 for classes 6-8 on 92%; stable within a track (per-track std 0.09 m). A coarse estimate near a per-class default: a 4.8 m Mustang read 4.25 m. Held-out round 2026-10-02: L1, L3, L4 pass, L2 fails (class 3 is under 1.6x class 1 on 8 of 39 routes, where class 3 reads 3.6-6.6 m). X does not refer to the object center: no length term is needed in dRel.";
CM_ SG_ 120 FIELD_226_RAW "Radar firmware: 0.01*raw-1.57, valid below 316 (+-1.57, so likely an angle in rad); initial value 157 (0). Near 0 on moving objects (p5-p95 about +-0.15), spread over +-1.5 on stationary ones. Not the heading from motion: r -0.19 to +0.07 with the sign varying by route (docs/object-length-217.md). Meaning unknown.";
CM_ SG_ 120 TTC_SIGMA_CANDIDATE_RAW "TTC uncertainty (provisional): raw = TTC^2 * NORMALIZED_CLOSING_SIGMA / 64 within 0.1-2.5% on ten recordings. 127 = saturated or not populated; 0 = invalid. Stays populated on 3-26% of frames where TTC is defaulted (TTC about 8-19 s). Not read by the radar firmware.";
CM_ SG_ 120 FIELD_248_RAW "Not read by the radar firmware. Median raw 172. Meaning unknown.";
CM_ SG_ 120 WIDTH_FINE_258_CANDIDATE_RAW "Radar firmware: 8 bits, 0.0002*raw, no range check; stored next to AZIMUTH_CENTER, like the 0.0002 widths stored next to each edge. Values above 63 on 1.7% of frames. Angular extent measure, about 1/range within a track.";
CM_ SG_ 120 NORMALIZED_CLOSING_SIGMA_RAW "Bosch A NORMALIZED_CLOSING_SIGMA counterpart (accepted): specific to normalized-closing noise and monotonic with it on ten recordings; tied to TTC_SIGMA by a fixed 1/64 ratio. 0 when normalized closing is invalid. Radar firmware: 10 bits, 0.001*raw, valid below 1024, the same step as NORMALIZED_RATE. Values above 511 on 0.6% of frames, which the earlier 9-bit read truncated.";
CM_ SG_ 120 AUX_LATERAL_MOTION_304_CANDIDATE_RAW "Radar firmware: one 17-bit offset-binary field, raw*80/2^17-40, valid below 131072 (formerly read as signed 16 bits at 304 plus a direction bit at 320). Bit 320 is its sign: set on 49.7% of frames, which is why it agreed with the 16-bit value being nonnegative. Its scale (0.00061 per count) is far below the earlier 0.005-0.12 m/s bracket, so it is probably not a lateral speed in m/s; with the firmware decode it does not follow the azimuth rate, dY/dt, lateral velocity or its rate either (r < 0.08; docs/object-length-217.md). About 0 when normalized closing is invalid.";
CM_ SG_ 120 AUX_328_CANDIDATE_RAW "Radar firmware: 14 bits, 0.00002*raw, valid below 12501 (0-0.25). Changes nearly every frame; weak association with lateral and angular noise, not specific to one. 0 when normalized closing is invalid. Meaning unresolved.";
CM_ SG_ 120 FIELD_344_RAW "Radar firmware: 0.002*raw-10, valid below 8001 (+-10). Raw 5000 (0) on 68% of frames. Not acceleration: on lead-like objects its 90th-percentile magnitude is 0.04-0.12 against 0.55-1.83 m/s^2 of lead acceleration, r <= 0.2 (docs/object-length-217.md). Meaning unknown.";
CM_ SG_ 120 FIELD_360_RAW "Not read by the A230 radar firmware; the MY22 firmware (A070) defines 362:6 here instead. Median raw 48. Meaning unknown.";
CM_ SG_ 120 FIELD_368_RAW "Radar firmware: 0.0025*raw, valid below 1024. Raw 1 on 64% of frames. Meaning unknown.";
CM_ SG_ 120 AUX2_378_CANDIDATE_RAW "Radar firmware: same encoding as the azimuth fields, 0.00025*raw-1.02375, valid below 8192 (initial value 4095), and the radar passes it through atan like the edges: a tangent. Not signed 13-bit: with this decode its sign matches the azimuth on 98-99% of populated frames (routes 171, 17b, 19d), against 1-2% for a signed read. Shares one subrecord with ANGULAR_WIDTH_480: both hold their defaults together (8190 here; bits 480-487 zero) on about two thirds of observations. The MY22 firmware has no getter for it.";
CM_ SG_ 120 FIELD_391_RAW "Radar firmware: 0.05*raw, valid below 128. Scales with class: median 0.7 for class 1, 1.5 for class 3, 0 for classes 6-8; constant with age and range. Weakly related to how much OBJECT_LENGTH varies within a track (Spearman 0.19). Meaning unknown.";
CM_ SG_ 120 MATURITY_398_CANDIDATE_RAW "Radar firmware: one 7-bit field; not read. Values above 15 on 9.2% of frames. Counts down from about 6 to 1 as a track matures. Adds no velocity-error or survival information once track age is known.";
CM_ SG_ 120 FIELD_405_RAW "Not read by the radar firmware. Raw 49 on 82% of frames. Meaning unknown.";
CM_ SG_ 120 AZIMUTH_CENTER_RAW "Radar firmware: 0.00025*raw-1.02375 (zero at 4095), valid below 8192; unlike the edges, the radar does not pass it through atan here. Positive left. Equals the midpoint of the two edge fields on 97-99.9% of observations, so it is the same quantity as the edges: a tangent. The earlier 2^-12 rad per count, zero 4096, was 2.4% small.";
CM_ SG_ 120 AZIMUTH_EDGE_A_RAW "Left angular edge; same encoding as AZIMUTH_CENTER. The radar firmware passes it through atan, so it is the tangent of the angle: tan +-1.024 is about +-45.7 deg. Always at or left of the center. Clips at 8191.";
CM_ SG_ 120 FIELD_437_RAW "Radar firmware: raw, valid below 5. Shares: 1 55.5%, 2 9.3%, 3 35.0%, 4 0.3%. Meaning unknown.";
CM_ SG_ 120 AZIMUTH_EDGE_B_RAW "Right angular edge; same encoding as AZIMUTH_CENTER, passed through atan by the radar firmware (a tangent). Clips at 0 for near objects at the field-of-view edge. The edge difference is the Bosch A ANGULAR_WIDTH counterpart: it scales as 1/range within a track (log-log slope -0.91 to -0.99, ten recordings).";
CM_ SG_ 120 MOTION_CLASS_CANDIDATE_RAW "Radar firmware: bits 465-467, raw, valid below 5 (bit 464 is unused and never set). Values 0 78.6%, 1 4.0%, 2 17.4% (read as 0, 2, 4 before 2026-10-02). 2: same-direction traffic, and most objects seen only while ego is stopped. 1: oncoming or approaching, and most stationary objects seen while ego moves. 0: unassigned; young tracks, and every object on the 2026-09-10 and 2026-09-16 drives. Not a validated classifier.";
CM_ SG_ 120 ANGULAR_WIDTH_COARSE_CANDIDATE_RAW "Radar firmware: 0.0002*raw, no range check; stored next to AZIMUTH_EDGE_A. Angular extent measure, about 1/range within a track. Not a fixed-scale copy of the edge width (forward vs inverse fits 6-21 vs 14-24 edge counts per unit). Not received power.";
CM_ SG_ 120 ANGULAR_WIDTH_480_RAW "Angular-width measure (accepted 2026-09-29 on held-out routes): follows the azimuth-edge width (Spearman >= 0.8) and scales as about 1/range within tracks on 57 of 60 routes. Radar firmware: 0.0002*raw, no range check; stored next to AUX2_378. 0 while AUX2_378 holds its default.";
CM_ SG_ 120 ANGULAR_WIDTH_COARSE_COPY_CANDIDATE_RAW "Radar firmware: 0.0002*raw, no range check; stored next to AZIMUTH_EDGE_B. Byte 61 equals byte 59 on 99.7-100% of observations.";
BA_ "VFrameFormat" BO_ 122 14;
CM_ SG_ 122 CRC16_RAW "Capture-verified CRC16: polynomial 0x1021, init 0xFFFF, no reflection or xorout; bytes 2:64 then little-endian data ID 0x0fb7. The radar firmware's E2E receive configuration holds data IDs 0x0FAB-0x0FBA.";
CM_ SG_ 122 OBJECT_ID_RAW "Bits 32-39 (radar firmware; 40-47 are unused and never set). Observed 0 empty, 1 through 63 active. IDs move between wire slots and are reused.";
CM_ SG_ 122 LIFECYCLE_RAW "Observed +3 modulo 4096 per consecutive sweep for continuing IDs. Resets or discontinuities require a new track. Not read by the radar firmware.";
CM_ SG_ 122 FRAME_PHASE_RAW "Radar firmware: raw, valid below 16.";
CM_ SG_ 122 POSITION_X_RAW "Radar firmware: 0.05*raw m, valid below 4096, no offset (in the sender's frame). Unsigned 12-bit, bits 48-59; bit 60 belongs to OBJECT_CLASS_RAW. Working decode dRel = 0.05*raw-4.296 m (accepted): the -4.296 m is our measured offset to the bumper reference, not part of the encoding. The stock dash draws HUD_OBJECTS LONG_DIST from raw/4. Normalized closing and azimuth both imply a sensor range origin about 2.3 m behind the dRel origin, which fits the windshield camera that sends this bank.";
CM_ SG_ 122 OBJECT_CLASS_RAW "Object class, bits 60-63. Radar firmware: raw, valid below 16; it names no values. 1 car and 3 truck/large vehicle: accepted against the stock dash HUD_OBJECTS icons on held-out routes (99.6% and 99.2%). 6, 7 and 8 are not motorcycle, pedestrian and bicycle as such: against video within 25 m they name that object on 1 of 11, 3 of 13 and 3 of 12 clear labels, and are most often a car (2026-09-29). The stock dash shows icon 6 for moving two-wheelers, so its motorcycle icon adds a filter on top of class 6. 9-11 unconfirmed. Classes 1 and 3 never share a track with classes 6-11.";
CM_ SG_ 122 POSITION_Y_RAW "Lateral position, 14-bit offset binary, positive left. Radar firmware: 0.01*raw-81.91 m, zero at 8191 (also its initial value), valid below 16384. Until 2026-10-02 production used zero 8192 (1 cm right). The 0.01 m scale and 14-bit extent were accepted on held-out routes before the firmware confirmed them. A 13-bit read wraps past +-40.95 m.";
CM_ SG_ 122 LIFE_STATE_CANDIDATE_RAW "Radar firmware: a separate 2-bit field, raw, valid below 4. Life state 0 newborn, 1 established, 2 ending (2 on 6-26% of a track last three frames vs 0.1-4% mid-life, ten recordings). Shares: 0 9.6%, 1 88.1%, 2 2.3%; 3 never seen.";
CM_ SG_ 122 VELOCITY_RAW "Relative velocity. Radar firmware: 0.1*raw-154.0 m/s, zero at 1540 (also its initial value), valid below 2048; the MY22 firmware (A070) reads it the same way. Production used zero 1539 (+0.1 m/s) until 2026-10-02. Stationary objects read about -0.3 m/s against vEgo with 1539 and -0.4 m/s with 1540, which points at the wheel-speed reference rather than the encoding. Raw 0 (-154 m/s) is a floor saturation on newborn far objects, not a sentinel.";
CM_ SG_ 122 LATERAL_VELOCITY_RAW "Lateral velocity, positive left, relative in the sensor frame (includes the apparent motion of stationary objects from ego yaw). Radar firmware: 0.1*raw-51.1 m/s, zero at 511 (also its initial value), valid below 1024. Accepted 2026-10-02: the research decode 0.1*(raw-511) was provisional only because one held-out scale bracket (0.1004-0.1085) missed 0.1; the firmware settles the scale.";
CM_ SG_ 122 ENUM_106_CANDIDATE_RAW "Radar firmware: one 3-bit field, raw, valid below 5 (formerly read as flags at bits 106 and 107). Shares: 0 14.6%, 1 83.8%, 2 1.0%, 3 0.7%, 4 under 0.1%. Bit 106 (odd values) is set on about 40% of newborn frames and 97-99% after 1 s and agrees with LIFE_STATE 1 on 96%; bit 107 (values 2-3) is mostly on mature same-direction movers. Meaning unresolved.";
CM_ SG_ 122 ENUM_109_CANDIDATE_RAW "Not read by the radar firmware. Values 0-4. 1 on most established tracks; 2-4 mostly on same-direction movers near the path with high existence. Not an object class (metric width about 1.7 m for all values) and not a left/right lane code. Meaning unresolved.";
CM_ SG_ 122 EXISTENCE_PROBABILITY_RAW "Bosch A OBJECT_EXISTENCE_PROBABILITY counterpart (accepted). Radar firmware: 2*raw percent, valid below 51 (100%); observed 0-49, 49 most common. Best survival predictor within range x age strata on ten recordings (AUC 0.67-0.92); falls over the last second before track death; low on short-lived ghosts. 0 marks a degraded measurement (accepted on held-out routes: range innovation and vRel steps at least 2x worse on 17 of 17).";
CM_ SG_ 122 NORMALIZED_RATE_RAW "Bosch A NORMALIZED_CLOSING counterpart. Radar firmware: 0.001*raw-40 (1/s), valid below 65001. Accepted 2026-10-02: the research decode 0.001*(raw-40000) 1/s matches the firmware exactly; approximately vRel/(dRel+2.3 m) and follows Doppler vRel, not range change. 64999 marks invalid in the data (TTC 0, TTC sigma 0 and normalized-closing sigma 0 in the same frame), though the firmware getter accepts it.";
CM_ SG_ 122 QUALITY_CONTAINER_RAW "Bits 144-153 (radar firmware; 154-159 are unused and never set). Radar firmware: 0.05*raw, valid below 1024; the 0.05 step equals the range resolution. Bosch A RANGE_SIGMA candidate (provisional): range-noise specific on 8 of 10 recordings, weak (partial rho 0.08-0.25). Strongly range dependent. Unit unnamed.";
CM_ SG_ 122 REL_VELOCITY_UNCERTAINTY_RAW "Bosch A REL_VELOCITY_UNCERTAINTY counterpart (accepted, raw units): velocity-noise specific and monotonic with empirical vRel noise on ten recordings. Radar firmware: 0.1*raw, valid below 1024, unit unnamed. Nonlinear against our measured vRel noise (the adapter maps it empirically).";
CM_ SG_ 122 UNCERTAINTY_160_CANDIDATE_RAW "Radar firmware: 10 bits, 0.02*raw, valid below 1024. Mostly 1-2; higher on young and laterally offset objects. Weak noise association. Unit unnamed.";
CM_ SG_ 122 ACQUISITION_186_CANDIDATE_RAW "Radar firmware: 6 bits, 0.01*raw, valid below 64. Starts near 23 on newborn tracks and decays to about 2. Carries little information beyond track age.";
CM_ SG_ 122 UNCERTAINTY_192_CANDIDATE_RAW "Radar firmware: 9 bits, 0.1*raw, valid below 512. Decays with age; mixed velocity and lateral noise association, not specific to one noise. Unit unnamed.";
CM_ SG_ 122 TTC_RAW "Time to collision (accepted 2026-09-28 on held-out routes), (raw-1024)/128 s: a constant-velocity TTC, equal to -1/normalized closing within 0.06-0.10 s median. Reported only while an acceleration-aware collision prediction expects impact (lagging it by about 1-2 s); otherwise 2046. 0 = invalid (normalized closing 64999). Not read by the radar firmware, so the scale rests on captures. No Bosch A counterpart.";
CM_ SG_ 122 OBJECT_LENGTH_CANDIDATE_RAW "Object length, provisional (docs/object-length-217.md). Radar firmware: 0.05*raw m, valid below 512. Median 4.25 m for class 1 and 8.7-8.9 m for class 3; 0 for classes 6-8 on 92%; stable within a track (per-track std 0.09 m). A coarse estimate near a per-class default: a 4.8 m Mustang read 4.25 m. Held-out round 2026-10-02: L1, L3, L4 pass, L2 fails (class 3 is under 1.6x class 1 on 8 of 39 routes, where class 3 reads 3.6-6.6 m). X does not refer to the object center: no length term is needed in dRel.";
CM_ SG_ 122 FIELD_226_RAW "Radar firmware: 0.01*raw-1.57, valid below 316 (+-1.57, so likely an angle in rad); initial value 157 (0). Near 0 on moving objects (p5-p95 about +-0.15), spread over +-1.5 on stationary ones. Not the heading from motion: r -0.19 to +0.07 with the sign varying by route (docs/object-length-217.md). Meaning unknown.";
CM_ SG_ 122 TTC_SIGMA_CANDIDATE_RAW "TTC uncertainty (provisional): raw = TTC^2 * NORMALIZED_CLOSING_SIGMA / 64 within 0.1-2.5% on ten recordings. 127 = saturated or not populated; 0 = invalid. Stays populated on 3-26% of frames where TTC is defaulted (TTC about 8-19 s). Not read by the radar firmware.";
CM_ SG_ 122 FIELD_248_RAW "Not read by the radar firmware. Median raw 172. Meaning unknown.";
CM_ SG_ 122 WIDTH_FINE_258_CANDIDATE_RAW "Radar firmware: 8 bits, 0.0002*raw, no range check; stored next to AZIMUTH_CENTER, like the 0.0002 widths stored next to each edge. Values above 63 on 1.7% of frames. Angular extent measure, about 1/range within a track.";
CM_ SG_ 122 NORMALIZED_CLOSING_SIGMA_RAW "Bosch A NORMALIZED_CLOSING_SIGMA counterpart (accepted): specific to normalized-closing noise and monotonic with it on ten recordings; tied to TTC_SIGMA by a fixed 1/64 ratio. 0 when normalized closing is invalid. Radar firmware: 10 bits, 0.001*raw, valid below 1024, the same step as NORMALIZED_RATE. Values above 511 on 0.6% of frames, which the earlier 9-bit read truncated.";
CM_ SG_ 122 AUX_LATERAL_MOTION_304_CANDIDATE_RAW "Radar firmware: one 17-bit offset-binary field, raw*80/2^17-40, valid below 131072 (formerly read as signed 16 bits at 304 plus a direction bit at 320). Bit 320 is its sign: set on 49.7% of frames, which is why it agreed with the 16-bit value being nonnegative. Its scale (0.00061 per count) is far below the earlier 0.005-0.12 m/s bracket, so it is probably not a lateral speed in m/s; with the firmware decode it does not follow the azimuth rate, dY/dt, lateral velocity or its rate either (r < 0.08; docs/object-length-217.md). About 0 when normalized closing is invalid.";
CM_ SG_ 122 AUX_328_CANDIDATE_RAW "Radar firmware: 14 bits, 0.00002*raw, valid below 12501 (0-0.25). Changes nearly every frame; weak association with lateral and angular noise, not specific to one. 0 when normalized closing is invalid. Meaning unresolved.";
CM_ SG_ 122 FIELD_344_RAW "Radar firmware: 0.002*raw-10, valid below 8001 (+-10). Raw 5000 (0) on 68% of frames. Not acceleration: on lead-like objects its 90th-percentile magnitude is 0.04-0.12 against 0.55-1.83 m/s^2 of lead acceleration, r <= 0.2 (docs/object-length-217.md). Meaning unknown.";
CM_ SG_ 122 FIELD_360_RAW "Not read by the A230 radar firmware; the MY22 firmware (A070) defines 362:6 here instead. Median raw 48. Meaning unknown.";
CM_ SG_ 122 FIELD_368_RAW "Radar firmware: 0.0025*raw, valid below 1024. Raw 1 on 64% of frames. Meaning unknown.";
CM_ SG_ 122 AUX2_378_CANDIDATE_RAW "Radar firmware: same encoding as the azimuth fields, 0.00025*raw-1.02375, valid below 8192 (initial value 4095), and the radar passes it through atan like the edges: a tangent. Not signed 13-bit: with this decode its sign matches the azimuth on 98-99% of populated frames (routes 171, 17b, 19d), against 1-2% for a signed read. Shares one subrecord with ANGULAR_WIDTH_480: both hold their defaults together (8190 here; bits 480-487 zero) on about two thirds of observations. The MY22 firmware has no getter for it.";
CM_ SG_ 122 FIELD_391_RAW "Radar firmware: 0.05*raw, valid below 128. Scales with class: median 0.7 for class 1, 1.5 for class 3, 0 for classes 6-8; constant with age and range. Weakly related to how much OBJECT_LENGTH varies within a track (Spearman 0.19). Meaning unknown.";
CM_ SG_ 122 MATURITY_398_CANDIDATE_RAW "Radar firmware: one 7-bit field; not read. Values above 15 on 9.2% of frames. Counts down from about 6 to 1 as a track matures. Adds no velocity-error or survival information once track age is known.";
CM_ SG_ 122 FIELD_405_RAW "Not read by the radar firmware. Raw 49 on 82% of frames. Meaning unknown.";
CM_ SG_ 122 AZIMUTH_CENTER_RAW "Radar firmware: 0.00025*raw-1.02375 (zero at 4095), valid below 8192; unlike the edges, the radar does not pass it through atan here. Positive left. Equals the midpoint of the two edge fields on 97-99.9% of observations, so it is the same quantity as the edges: a tangent. The earlier 2^-12 rad per count, zero 4096, was 2.4% small.";
CM_ SG_ 122 AZIMUTH_EDGE_A_RAW "Left angular edge; same encoding as AZIMUTH_CENTER. The radar firmware passes it through atan, so it is the tangent of the angle: tan +-1.024 is about +-45.7 deg. Always at or left of the center. Clips at 8191.";
CM_ SG_ 122 FIELD_437_RAW "Radar firmware: raw, valid below 5. Shares: 1 55.5%, 2 9.3%, 3 35.0%, 4 0.3%. Meaning unknown.";
CM_ SG_ 122 AZIMUTH_EDGE_B_RAW "Right angular edge; same encoding as AZIMUTH_CENTER, passed through atan by the radar firmware (a tangent). Clips at 0 for near objects at the field-of-view edge. The edge difference is the Bosch A ANGULAR_WIDTH counterpart: it scales as 1/range within a track (log-log slope -0.91 to -0.99, ten recordings).";
CM_ SG_ 122 MOTION_CLASS_CANDIDATE_RAW "Radar firmware: bits 465-467, raw, valid below 5 (bit 464 is unused and never set). Values 0 78.6%, 1 4.0%, 2 17.4% (read as 0, 2, 4 before 2026-10-02). 2: same-direction traffic, and most objects seen only while ego is stopped. 1: oncoming or approaching, and most stationary objects seen while ego moves. 0: unassigned; young tracks, and every object on the 2026-09-10 and 2026-09-16 drives. Not a validated classifier.";
CM_ SG_ 122 ANGULAR_WIDTH_COARSE_CANDIDATE_RAW "Radar firmware: 0.0002*raw, no range check; stored next to AZIMUTH_EDGE_A. Angular extent measure, about 1/range within a track. Not a fixed-scale copy of the edge width (forward vs inverse fits 6-21 vs 14-24 edge counts per unit). Not received power.";
CM_ SG_ 122 ANGULAR_WIDTH_480_RAW "Angular-width measure (accepted 2026-09-29 on held-out routes): follows the azimuth-edge width (Spearman >= 0.8) and scales as about 1/range within tracks on 57 of 60 routes. Radar firmware: 0.0002*raw, no range check; stored next to AUX2_378. 0 while AUX2_378 holds its default.";
CM_ SG_ 122 ANGULAR_WIDTH_COARSE_COPY_CANDIDATE_RAW "Radar firmware: 0.0002*raw, no range check; stored next to AZIMUTH_EDGE_B. Byte 61 equals byte 59 on 99.7-100% of observations.";
BA_ "VFrameFormat" BO_ 124 14;
CM_ SG_ 124 CRC16_RAW "Capture-verified CRC16: polynomial 0x1021, init 0xFFFF, no reflection or xorout; bytes 2:64 then little-endian data ID 0x0fb8. The radar firmware's E2E receive configuration holds data IDs 0x0FAB-0x0FBA.";
CM_ SG_ 124 OBJECT_ID_RAW "Bits 32-39 (radar firmware; 40-47 are unused and never set). Observed 0 empty, 1 through 63 active. IDs move between wire slots and are reused.";
CM_ SG_ 124 LIFECYCLE_RAW "Observed +3 modulo 4096 per consecutive sweep for continuing IDs. Resets or discontinuities require a new track. Not read by the radar firmware.";
CM_ SG_ 124 FRAME_PHASE_RAW "Radar firmware: raw, valid below 16.";
CM_ SG_ 124 POSITION_X_RAW "Radar firmware: 0.05*raw m, valid below 4096, no offset (in the sender's frame). Unsigned 12-bit, bits 48-59; bit 60 belongs to OBJECT_CLASS_RAW. Working decode dRel = 0.05*raw-4.296 m (accepted): the -4.296 m is our measured offset to the bumper reference, not part of the encoding. The stock dash draws HUD_OBJECTS LONG_DIST from raw/4. Normalized closing and azimuth both imply a sensor range origin about 2.3 m behind the dRel origin, which fits the windshield camera that sends this bank.";
CM_ SG_ 124 OBJECT_CLASS_RAW "Object class, bits 60-63. Radar firmware: raw, valid below 16; it names no values. 1 car and 3 truck/large vehicle: accepted against the stock dash HUD_OBJECTS icons on held-out routes (99.6% and 99.2%). 6, 7 and 8 are not motorcycle, pedestrian and bicycle as such: against video within 25 m they name that object on 1 of 11, 3 of 13 and 3 of 12 clear labels, and are most often a car (2026-09-29). The stock dash shows icon 6 for moving two-wheelers, so its motorcycle icon adds a filter on top of class 6. 9-11 unconfirmed. Classes 1 and 3 never share a track with classes 6-11.";
CM_ SG_ 124 POSITION_Y_RAW "Lateral position, 14-bit offset binary, positive left. Radar firmware: 0.01*raw-81.91 m, zero at 8191 (also its initial value), valid below 16384. Until 2026-10-02 production used zero 8192 (1 cm right). The 0.01 m scale and 14-bit extent were accepted on held-out routes before the firmware confirmed them. A 13-bit read wraps past +-40.95 m.";
CM_ SG_ 124 LIFE_STATE_CANDIDATE_RAW "Radar firmware: a separate 2-bit field, raw, valid below 4. Life state 0 newborn, 1 established, 2 ending (2 on 6-26% of a track last three frames vs 0.1-4% mid-life, ten recordings). Shares: 0 9.6%, 1 88.1%, 2 2.3%; 3 never seen.";
CM_ SG_ 124 VELOCITY_RAW "Relative velocity. Radar firmware: 0.1*raw-154.0 m/s, zero at 1540 (also its initial value), valid below 2048; the MY22 firmware (A070) reads it the same way. Production used zero 1539 (+0.1 m/s) until 2026-10-02. Stationary objects read about -0.3 m/s against vEgo with 1539 and -0.4 m/s with 1540, which points at the wheel-speed reference rather than the encoding. Raw 0 (-154 m/s) is a floor saturation on newborn far objects, not a sentinel.";
CM_ SG_ 124 LATERAL_VELOCITY_RAW "Lateral velocity, positive left, relative in the sensor frame (includes the apparent motion of stationary objects from ego yaw). Radar firmware: 0.1*raw-51.1 m/s, zero at 511 (also its initial value), valid below 1024. Accepted 2026-10-02: the research decode 0.1*(raw-511) was provisional only because one held-out scale bracket (0.1004-0.1085) missed 0.1; the firmware settles the scale.";
CM_ SG_ 124 ENUM_106_CANDIDATE_RAW "Radar firmware: one 3-bit field, raw, valid below 5 (formerly read as flags at bits 106 and 107). Shares: 0 14.6%, 1 83.8%, 2 1.0%, 3 0.7%, 4 under 0.1%. Bit 106 (odd values) is set on about 40% of newborn frames and 97-99% after 1 s and agrees with LIFE_STATE 1 on 96%; bit 107 (values 2-3) is mostly on mature same-direction movers. Meaning unresolved.";
CM_ SG_ 124 ENUM_109_CANDIDATE_RAW "Not read by the radar firmware. Values 0-4. 1 on most established tracks; 2-4 mostly on same-direction movers near the path with high existence. Not an object class (metric width about 1.7 m for all values) and not a left/right lane code. Meaning unresolved.";
CM_ SG_ 124 EXISTENCE_PROBABILITY_RAW "Bosch A OBJECT_EXISTENCE_PROBABILITY counterpart (accepted). Radar firmware: 2*raw percent, valid below 51 (100%); observed 0-49, 49 most common. Best survival predictor within range x age strata on ten recordings (AUC 0.67-0.92); falls over the last second before track death; low on short-lived ghosts. 0 marks a degraded measurement (accepted on held-out routes: range innovation and vRel steps at least 2x worse on 17 of 17).";
CM_ SG_ 124 NORMALIZED_RATE_RAW "Bosch A NORMALIZED_CLOSING counterpart. Radar firmware: 0.001*raw-40 (1/s), valid below 65001. Accepted 2026-10-02: the research decode 0.001*(raw-40000) 1/s matches the firmware exactly; approximately vRel/(dRel+2.3 m) and follows Doppler vRel, not range change. 64999 marks invalid in the data (TTC 0, TTC sigma 0 and normalized-closing sigma 0 in the same frame), though the firmware getter accepts it.";
CM_ SG_ 124 QUALITY_CONTAINER_RAW "Bits 144-153 (radar firmware; 154-159 are unused and never set). Radar firmware: 0.05*raw, valid below 1024; the 0.05 step equals the range resolution. Bosch A RANGE_SIGMA candidate (provisional): range-noise specific on 8 of 10 recordings, weak (partial rho 0.08-0.25). Strongly range dependent. Unit unnamed.";
CM_ SG_ 124 REL_VELOCITY_UNCERTAINTY_RAW "Bosch A REL_VELOCITY_UNCERTAINTY counterpart (accepted, raw units): velocity-noise specific and monotonic with empirical vRel noise on ten recordings. Radar firmware: 0.1*raw, valid below 1024, unit unnamed. Nonlinear against our measured vRel noise (the adapter maps it empirically).";
CM_ SG_ 124 UNCERTAINTY_160_CANDIDATE_RAW "Radar firmware: 10 bits, 0.02*raw, valid below 1024. Mostly 1-2; higher on young and laterally offset objects. Weak noise association. Unit unnamed.";
CM_ SG_ 124 ACQUISITION_186_CANDIDATE_RAW "Radar firmware: 6 bits, 0.01*raw, valid below 64. Starts near 23 on newborn tracks and decays to about 2. Carries little information beyond track age.";
CM_ SG_ 124 UNCERTAINTY_192_CANDIDATE_RAW "Radar firmware: 9 bits, 0.1*raw, valid below 512. Decays with age; mixed velocity and lateral noise association, not specific to one noise. Unit unnamed.";
CM_ SG_ 124 TTC_RAW "Time to collision (accepted 2026-09-28 on held-out routes), (raw-1024)/128 s: a constant-velocity TTC, equal to -1/normalized closing within 0.06-0.10 s median. Reported only while an acceleration-aware collision prediction expects impact (lagging it by about 1-2 s); otherwise 2046. 0 = invalid (normalized closing 64999). Not read by the radar firmware, so the scale rests on captures. No Bosch A counterpart.";
CM_ SG_ 124 OBJECT_LENGTH_CANDIDATE_RAW "Object length, provisional (docs/object-length-217.md). Radar firmware: 0.05*raw m, valid below 512. Median 4.25 m for class 1 and 8.7-8.9 m for class 3; 0 for classes 6-8 on 92%; stable within a track (per-track std 0.09 m). A coarse estimate near a per-class default: a 4.8 m Mustang read 4.25 m. Held-out round 2026-10-02: L1, L3, L4 pass, L2 fails (class 3 is under 1.6x class 1 on 8 of 39 routes, where class 3 reads 3.6-6.6 m). X does not refer to the object center: no length term is needed in dRel.";
CM_ SG_ 124 FIELD_226_RAW "Radar firmware: 0.01*raw-1.57, valid below 316 (+-1.57, so likely an angle in rad); initial value 157 (0). Near 0 on moving objects (p5-p95 about +-0.15), spread over +-1.5 on stationary ones. Not the heading from motion: r -0.19 to +0.07 with the sign varying by route (docs/object-length-217.md). Meaning unknown.";
CM_ SG_ 124 TTC_SIGMA_CANDIDATE_RAW "TTC uncertainty (provisional): raw = TTC^2 * NORMALIZED_CLOSING_SIGMA / 64 within 0.1-2.5% on ten recordings. 127 = saturated or not populated; 0 = invalid. Stays populated on 3-26% of frames where TTC is defaulted (TTC about 8-19 s). Not read by the radar firmware.";
CM_ SG_ 124 FIELD_248_RAW "Not read by the radar firmware. Median raw 172. Meaning unknown.";
CM_ SG_ 124 WIDTH_FINE_258_CANDIDATE_RAW "Radar firmware: 8 bits, 0.0002*raw, no range check; stored next to AZIMUTH_CENTER, like the 0.0002 widths stored next to each edge. Values above 63 on 1.7% of frames. Angular extent measure, about 1/range within a track.";
CM_ SG_ 124 NORMALIZED_CLOSING_SIGMA_RAW "Bosch A NORMALIZED_CLOSING_SIGMA counterpart (accepted): specific to normalized-closing noise and monotonic with it on ten recordings; tied to TTC_SIGMA by a fixed 1/64 ratio. 0 when normalized closing is invalid. Radar firmware: 10 bits, 0.001*raw, valid below 1024, the same step as NORMALIZED_RATE. Values above 511 on 0.6% of frames, which the earlier 9-bit read truncated.";
CM_ SG_ 124 AUX_LATERAL_MOTION_304_CANDIDATE_RAW "Radar firmware: one 17-bit offset-binary field, raw*80/2^17-40, valid below 131072 (formerly read as signed 16 bits at 304 plus a direction bit at 320). Bit 320 is its sign: set on 49.7% of frames, which is why it agreed with the 16-bit value being nonnegative. Its scale (0.00061 per count) is far below the earlier 0.005-0.12 m/s bracket, so it is probably not a lateral speed in m/s; with the firmware decode it does not follow the azimuth rate, dY/dt, lateral velocity or its rate either (r < 0.08; docs/object-length-217.md). About 0 when normalized closing is invalid.";
CM_ SG_ 124 AUX_328_CANDIDATE_RAW "Radar firmware: 14 bits, 0.00002*raw, valid below 12501 (0-0.25). Changes nearly every frame; weak association with lateral and angular noise, not specific to one. 0 when normalized closing is invalid. Meaning unresolved.";
CM_ SG_ 124 FIELD_344_RAW "Radar firmware: 0.002*raw-10, valid below 8001 (+-10). Raw 5000 (0) on 68% of frames. Not acceleration: on lead-like objects its 90th-percentile magnitude is 0.04-0.12 against 0.55-1.83 m/s^2 of lead acceleration, r <= 0.2 (docs/object-length-217.md). Meaning unknown.";
CM_ SG_ 124 FIELD_360_RAW "Not read by the A230 radar firmware; the MY22 firmware (A070) defines 362:6 here instead. Median raw 48. Meaning unknown.";
CM_ SG_ 124 FIELD_368_RAW "Radar firmware: 0.0025*raw, valid below 1024. Raw 1 on 64% of frames. Meaning unknown.";
CM_ SG_ 124 AUX2_378_CANDIDATE_RAW "Radar firmware: same encoding as the azimuth fields, 0.00025*raw-1.02375, valid below 8192 (initial value 4095), and the radar passes it through atan like the edges: a tangent. Not signed 13-bit: with this decode its sign matches the azimuth on 98-99% of populated frames (routes 171, 17b, 19d), against 1-2% for a signed read. Shares one subrecord with ANGULAR_WIDTH_480: both hold their defaults together (8190 here; bits 480-487 zero) on about two thirds of observations. The MY22 firmware has no getter for it.";
CM_ SG_ 124 FIELD_391_RAW "Radar firmware: 0.05*raw, valid below 128. Scales with class: median 0.7 for class 1, 1.5 for class 3, 0 for classes 6-8; constant with age and range. Weakly related to how much OBJECT_LENGTH varies within a track (Spearman 0.19). Meaning unknown.";
CM_ SG_ 124 MATURITY_398_CANDIDATE_RAW "Radar firmware: one 7-bit field; not read. Values above 15 on 9.2% of frames. Counts down from about 6 to 1 as a track matures. Adds no velocity-error or survival information once track age is known.";
CM_ SG_ 124 FIELD_405_RAW "Not read by the radar firmware. Raw 49 on 82% of frames. Meaning unknown.";
CM_ SG_ 124 AZIMUTH_CENTER_RAW "Radar firmware: 0.00025*raw-1.02375 (zero at 4095), valid below 8192; unlike the edges, the radar does not pass it through atan here. Positive left. Equals the midpoint of the two edge fields on 97-99.9% of observations, so it is the same quantity as the edges: a tangent. The earlier 2^-12 rad per count, zero 4096, was 2.4% small.";
CM_ SG_ 124 AZIMUTH_EDGE_A_RAW "Left angular edge; same encoding as AZIMUTH_CENTER. The radar firmware passes it through atan, so it is the tangent of the angle: tan +-1.024 is about +-45.7 deg. Always at or left of the center. Clips at 8191.";
CM_ SG_ 124 FIELD_437_RAW "Radar firmware: raw, valid below 5. Shares: 1 55.5%, 2 9.3%, 3 35.0%, 4 0.3%. Meaning unknown.";
CM_ SG_ 124 AZIMUTH_EDGE_B_RAW "Right angular edge; same encoding as AZIMUTH_CENTER, passed through atan by the radar firmware (a tangent). Clips at 0 for near objects at the field-of-view edge. The edge difference is the Bosch A ANGULAR_WIDTH counterpart: it scales as 1/range within a track (log-log slope -0.91 to -0.99, ten recordings).";
CM_ SG_ 124 MOTION_CLASS_CANDIDATE_RAW "Radar firmware: bits 465-467, raw, valid below 5 (bit 464 is unused and never set). Values 0 78.6%, 1 4.0%, 2 17.4% (read as 0, 2, 4 before 2026-10-02). 2: same-direction traffic, and most objects seen only while ego is stopped. 1: oncoming or approaching, and most stationary objects seen while ego moves. 0: unassigned; young tracks, and every object on the 2026-09-10 and 2026-09-16 drives. Not a validated classifier.";
CM_ SG_ 124 ANGULAR_WIDTH_COARSE_CANDIDATE_RAW "Radar firmware: 0.0002*raw, no range check; stored next to AZIMUTH_EDGE_A. Angular extent measure, about 1/range within a track. Not a fixed-scale copy of the edge width (forward vs inverse fits 6-21 vs 14-24 edge counts per unit). Not received power.";
CM_ SG_ 124 ANGULAR_WIDTH_480_RAW "Angular-width measure (accepted 2026-09-29 on held-out routes): follows the azimuth-edge width (Spearman >= 0.8) and scales as about 1/range within tracks on 57 of 60 routes. Radar firmware: 0.0002*raw, no range check; stored next to AUX2_378. 0 while AUX2_378 holds its default.";
CM_ SG_ 124 ANGULAR_WIDTH_COARSE_COPY_CANDIDATE_RAW "Radar firmware: 0.0002*raw, no range check; stored next to AZIMUTH_EDGE_B. Byte 61 equals byte 59 on 99.7-100% of observations.";
BA_ "VFrameFormat" BO_ 126 14;
CM_ SG_ 126 CRC16_RAW "Capture-verified CRC16: polynomial 0x1021, init 0xFFFF, no reflection or xorout; bytes 2:64 then little-endian data ID 0x0fb9. The radar firmware's E2E receive configuration holds data IDs 0x0FAB-0x0FBA.";
CM_ SG_ 126 OBJECT_ID_RAW "Bits 32-39 (radar firmware; 40-47 are unused and never set). Observed 0 empty, 1 through 63 active. IDs move between wire slots and are reused.";
CM_ SG_ 126 LIFECYCLE_RAW "Observed +3 modulo 4096 per consecutive sweep for continuing IDs. Resets or discontinuities require a new track. Not read by the radar firmware.";
CM_ SG_ 126 FRAME_PHASE_RAW "Radar firmware: raw, valid below 16.";
CM_ SG_ 126 POSITION_X_RAW "Radar firmware: 0.05*raw m, valid below 4096, no offset (in the sender's frame). Unsigned 12-bit, bits 48-59; bit 60 belongs to OBJECT_CLASS_RAW. Working decode dRel = 0.05*raw-4.296 m (accepted): the -4.296 m is our measured offset to the bumper reference, not part of the encoding. The stock dash draws HUD_OBJECTS LONG_DIST from raw/4. Normalized closing and azimuth both imply a sensor range origin about 2.3 m behind the dRel origin, which fits the windshield camera that sends this bank.";
CM_ SG_ 126 OBJECT_CLASS_RAW "Object class, bits 60-63. Radar firmware: raw, valid below 16; it names no values. 1 car and 3 truck/large vehicle: accepted against the stock dash HUD_OBJECTS icons on held-out routes (99.6% and 99.2%). 6, 7 and 8 are not motorcycle, pedestrian and bicycle as such: against video within 25 m they name that object on 1 of 11, 3 of 13 and 3 of 12 clear labels, and are most often a car (2026-09-29). The stock dash shows icon 6 for moving two-wheelers, so its motorcycle icon adds a filter on top of class 6. 9-11 unconfirmed. Classes 1 and 3 never share a track with classes 6-11.";
CM_ SG_ 126 POSITION_Y_RAW "Lateral position, 14-bit offset binary, positive left. Radar firmware: 0.01*raw-81.91 m, zero at 8191 (also its initial value), valid below 16384. Until 2026-10-02 production used zero 8192 (1 cm right). The 0.01 m scale and 14-bit extent were accepted on held-out routes before the firmware confirmed them. A 13-bit read wraps past +-40.95 m.";
CM_ SG_ 126 LIFE_STATE_CANDIDATE_RAW "Radar firmware: a separate 2-bit field, raw, valid below 4. Life state 0 newborn, 1 established, 2 ending (2 on 6-26% of a track last three frames vs 0.1-4% mid-life, ten recordings). Shares: 0 9.6%, 1 88.1%, 2 2.3%; 3 never seen.";
CM_ SG_ 126 VELOCITY_RAW "Relative velocity. Radar firmware: 0.1*raw-154.0 m/s, zero at 1540 (also its initial value), valid below 2048; the MY22 firmware (A070) reads it the same way. Production used zero 1539 (+0.1 m/s) until 2026-10-02. Stationary objects read about -0.3 m/s against vEgo with 1539 and -0.4 m/s with 1540, which points at the wheel-speed reference rather than the encoding. Raw 0 (-154 m/s) is a floor saturation on newborn far objects, not a sentinel.";
CM_ SG_ 126 LATERAL_VELOCITY_RAW "Lateral velocity, positive left, relative in the sensor frame (includes the apparent motion of stationary objects from ego yaw). Radar firmware: 0.1*raw-51.1 m/s, zero at 511 (also its initial value), valid below 1024. Accepted 2026-10-02: the research decode 0.1*(raw-511) was provisional only because one held-out scale bracket (0.1004-0.1085) missed 0.1; the firmware settles the scale.";
CM_ SG_ 126 ENUM_106_CANDIDATE_RAW "Radar firmware: one 3-bit field, raw, valid below 5 (formerly read as flags at bits 106 and 107). Shares: 0 14.6%, 1 83.8%, 2 1.0%, 3 0.7%, 4 under 0.1%. Bit 106 (odd values) is set on about 40% of newborn frames and 97-99% after 1 s and agrees with LIFE_STATE 1 on 96%; bit 107 (values 2-3) is mostly on mature same-direction movers. Meaning unresolved.";
CM_ SG_ 126 ENUM_109_CANDIDATE_RAW "Not read by the radar firmware. Values 0-4. 1 on most established tracks; 2-4 mostly on same-direction movers near the path with high existence. Not an object class (metric width about 1.7 m for all values) and not a left/right lane code. Meaning unresolved.";
CM_ SG_ 126 EXISTENCE_PROBABILITY_RAW "Bosch A OBJECT_EXISTENCE_PROBABILITY counterpart (accepted). Radar firmware: 2*raw percent, valid below 51 (100%); observed 0-49, 49 most common. Best survival predictor within range x age strata on ten recordings (AUC 0.67-0.92); falls over the last second before track death; low on short-lived ghosts. 0 marks a degraded measurement (accepted on held-out routes: range innovation and vRel steps at least 2x worse on 17 of 17).";
CM_ SG_ 126 NORMALIZED_RATE_RAW "Bosch A NORMALIZED_CLOSING counterpart. Radar firmware: 0.001*raw-40 (1/s), valid below 65001. Accepted 2026-10-02: the research decode 0.001*(raw-40000) 1/s matches the firmware exactly; approximately vRel/(dRel+2.3 m) and follows Doppler vRel, not range change. 64999 marks invalid in the data (TTC 0, TTC sigma 0 and normalized-closing sigma 0 in the same frame), though the firmware getter accepts it.";
CM_ SG_ 126 QUALITY_CONTAINER_RAW "Bits 144-153 (radar firmware; 154-159 are unused and never set). Radar firmware: 0.05*raw, valid below 1024; the 0.05 step equals the range resolution. Bosch A RANGE_SIGMA candidate (provisional): range-noise specific on 8 of 10 recordings, weak (partial rho 0.08-0.25). Strongly range dependent. Unit unnamed.";
CM_ SG_ 126 REL_VELOCITY_UNCERTAINTY_RAW "Bosch A REL_VELOCITY_UNCERTAINTY counterpart (accepted, raw units): velocity-noise specific and monotonic with empirical vRel noise on ten recordings. Radar firmware: 0.1*raw, valid below 1024, unit unnamed. Nonlinear against our measured vRel noise (the adapter maps it empirically).";
CM_ SG_ 126 UNCERTAINTY_160_CANDIDATE_RAW "Radar firmware: 10 bits, 0.02*raw, valid below 1024. Mostly 1-2; higher on young and laterally offset objects. Weak noise association. Unit unnamed.";
CM_ SG_ 126 ACQUISITION_186_CANDIDATE_RAW "Radar firmware: 6 bits, 0.01*raw, valid below 64. Starts near 23 on newborn tracks and decays to about 2. Carries little information beyond track age.";
CM_ SG_ 126 UNCERTAINTY_192_CANDIDATE_RAW "Radar firmware: 9 bits, 0.1*raw, valid below 512. Decays with age; mixed velocity and lateral noise association, not specific to one noise. Unit unnamed.";
CM_ SG_ 126 TTC_RAW "Time to collision (accepted 2026-09-28 on held-out routes), (raw-1024)/128 s: a constant-velocity TTC, equal to -1/normalized closing within 0.06-0.10 s median. Reported only while an acceleration-aware collision prediction expects impact (lagging it by about 1-2 s); otherwise 2046. 0 = invalid (normalized closing 64999). Not read by the radar firmware, so the scale rests on captures. No Bosch A counterpart.";
CM_ SG_ 126 OBJECT_LENGTH_CANDIDATE_RAW "Object length, provisional (docs/object-length-217.md). Radar firmware: 0.05*raw m, valid below 512. Median 4.25 m for class 1 and 8.7-8.9 m for class 3; 0 for classes 6-8 on 92%; stable within a track (per-track std 0.09 m). A coarse estimate near a per-class default: a 4.8 m Mustang read 4.25 m. Held-out round 2026-10-02: L1, L3, L4 pass, L2 fails (class 3 is under 1.6x class 1 on 8 of 39 routes, where class 3 reads 3.6-6.6 m). X does not refer to the object center: no length term is needed in dRel.";
CM_ SG_ 126 FIELD_226_RAW "Radar firmware: 0.01*raw-1.57, valid below 316 (+-1.57, so likely an angle in rad); initial value 157 (0). Near 0 on moving objects (p5-p95 about +-0.15), spread over +-1.5 on stationary ones. Not the heading from motion: r -0.19 to +0.07 with the sign varying by route (docs/object-length-217.md). Meaning unknown.";
CM_ SG_ 126 TTC_SIGMA_CANDIDATE_RAW "TTC uncertainty (provisional): raw = TTC^2 * NORMALIZED_CLOSING_SIGMA / 64 within 0.1-2.5% on ten recordings. 127 = saturated or not populated; 0 = invalid. Stays populated on 3-26% of frames where TTC is defaulted (TTC about 8-19 s). Not read by the radar firmware.";
CM_ SG_ 126 FIELD_248_RAW "Not read by the radar firmware. Median raw 172. Meaning unknown.";
CM_ SG_ 126 WIDTH_FINE_258_CANDIDATE_RAW "Radar firmware: 8 bits, 0.0002*raw, no range check; stored next to AZIMUTH_CENTER, like the 0.0002 widths stored next to each edge. Values above 63 on 1.7% of frames. Angular extent measure, about 1/range within a track.";
CM_ SG_ 126 NORMALIZED_CLOSING_SIGMA_RAW "Bosch A NORMALIZED_CLOSING_SIGMA counterpart (accepted): specific to normalized-closing noise and monotonic with it on ten recordings; tied to TTC_SIGMA by a fixed 1/64 ratio. 0 when normalized closing is invalid. Radar firmware: 10 bits, 0.001*raw, valid below 1024, the same step as NORMALIZED_RATE. Values above 511 on 0.6% of frames, which the earlier 9-bit read truncated.";
CM_ SG_ 126 AUX_LATERAL_MOTION_304_CANDIDATE_RAW "Radar firmware: one 17-bit offset-binary field, raw*80/2^17-40, valid below 131072 (formerly read as signed 16 bits at 304 plus a direction bit at 320). Bit 320 is its sign: set on 49.7% of frames, which is why it agreed with the 16-bit value being nonnegative. Its scale (0.00061 per count) is far below the earlier 0.005-0.12 m/s bracket, so it is probably not a lateral speed in m/s; with the firmware decode it does not follow the azimuth rate, dY/dt, lateral velocity or its rate either (r < 0.08; docs/object-length-217.md). About 0 when normalized closing is invalid.";
CM_ SG_ 126 AUX_328_CANDIDATE_RAW "Radar firmware: 14 bits, 0.00002*raw, valid below 12501 (0-0.25). Changes nearly every frame; weak association with lateral and angular noise, not specific to one. 0 when normalized closing is invalid. Meaning unresolved.";
CM_ SG_ 126 FIELD_344_RAW "Radar firmware: 0.002*raw-10, valid below 8001 (+-10). Raw 5000 (0) on 68% of frames. Not acceleration: on lead-like objects its 90th-percentile magnitude is 0.04-0.12 against 0.55-1.83 m/s^2 of lead acceleration, r <= 0.2 (docs/object-length-217.md). Meaning unknown.";
CM_ SG_ 126 FIELD_360_RAW "Not read by the A230 radar firmware; the MY22 firmware (A070) defines 362:6 here instead. Median raw 48. Meaning unknown.";
CM_ SG_ 126 FIELD_368_RAW "Radar firmware: 0.0025*raw, valid below 1024. Raw 1 on 64% of frames. Meaning unknown.";
CM_ SG_ 126 AUX2_378_CANDIDATE_RAW "Radar firmware: same encoding as the azimuth fields, 0.00025*raw-1.02375, valid below 8192 (initial value 4095), and the radar passes it through atan like the edges: a tangent. Not signed 13-bit: with this decode its sign matches the azimuth on 98-99% of populated frames (routes 171, 17b, 19d), against 1-2% for a signed read. Shares one subrecord with ANGULAR_WIDTH_480: both hold their defaults together (8190 here; bits 480-487 zero) on about two thirds of observations. The MY22 firmware has no getter for it.";
CM_ SG_ 126 FIELD_391_RAW "Radar firmware: 0.05*raw, valid below 128. Scales with class: median 0.7 for class 1, 1.5 for class 3, 0 for classes 6-8; constant with age and range. Weakly related to how much OBJECT_LENGTH varies within a track (Spearman 0.19). Meaning unknown.";
CM_ SG_ 126 MATURITY_398_CANDIDATE_RAW "Radar firmware: one 7-bit field; not read. Values above 15 on 9.2% of frames. Counts down from about 6 to 1 as a track matures. Adds no velocity-error or survival information once track age is known.";
CM_ SG_ 126 FIELD_405_RAW "Not read by the radar firmware. Raw 49 on 82% of frames. Meaning unknown.";
CM_ SG_ 126 AZIMUTH_CENTER_RAW "Radar firmware: 0.00025*raw-1.02375 (zero at 4095), valid below 8192; unlike the edges, the radar does not pass it through atan here. Positive left. Equals the midpoint of the two edge fields on 97-99.9% of observations, so it is the same quantity as the edges: a tangent. The earlier 2^-12 rad per count, zero 4096, was 2.4% small.";
CM_ SG_ 126 AZIMUTH_EDGE_A_RAW "Left angular edge; same encoding as AZIMUTH_CENTER. The radar firmware passes it through atan, so it is the tangent of the angle: tan +-1.024 is about +-45.7 deg. Always at or left of the center. Clips at 8191.";
CM_ SG_ 126 FIELD_437_RAW "Radar firmware: raw, valid below 5. Shares: 1 55.5%, 2 9.3%, 3 35.0%, 4 0.3%. Meaning unknown.";
CM_ SG_ 126 AZIMUTH_EDGE_B_RAW "Right angular edge; same encoding as AZIMUTH_CENTER, passed through atan by the radar firmware (a tangent). Clips at 0 for near objects at the field-of-view edge. The edge difference is the Bosch A ANGULAR_WIDTH counterpart: it scales as 1/range within a track (log-log slope -0.91 to -0.99, ten recordings).";
CM_ SG_ 126 MOTION_CLASS_CANDIDATE_RAW "Radar firmware: bits 465-467, raw, valid below 5 (bit 464 is unused and never set). Values 0 78.6%, 1 4.0%, 2 17.4% (read as 0, 2, 4 before 2026-10-02). 2: same-direction traffic, and most objects seen only while ego is stopped. 1: oncoming or approaching, and most stationary objects seen while ego moves. 0: unassigned; young tracks, and every object on the 2026-09-10 and 2026-09-16 drives. Not a validated classifier.";
CM_ SG_ 126 ANGULAR_WIDTH_COARSE_CANDIDATE_RAW "Radar firmware: 0.0002*raw, no range check; stored next to AZIMUTH_EDGE_A. Angular extent measure, about 1/range within a track. Not a fixed-scale copy of the edge width (forward vs inverse fits 6-21 vs 14-24 edge counts per unit). Not received power.";
CM_ SG_ 126 ANGULAR_WIDTH_480_RAW "Angular-width measure (accepted 2026-09-29 on held-out routes): follows the azimuth-edge width (Spearman >= 0.8) and scales as about 1/range within tracks on 57 of 60 routes. Radar firmware: 0.0002*raw, no range check; stored next to AUX2_378. 0 while AUX2_378 holds its default.";
CM_ SG_ 126 ANGULAR_WIDTH_COARSE_COPY_CANDIDATE_RAW "Radar firmware: 0.0002*raw, no range check; stored next to AZIMUTH_EDGE_B. Byte 61 equals byte 59 on 99.7-100% of observations.";
BA_ "VFrameFormat" BO_ 128 14;
CM_ SG_ 128 CRC16_RAW "Capture-verified CRC16: polynomial 0x1021, init 0xFFFF, no reflection or xorout; bytes 2:64 then little-endian data ID 0x0fba. The radar firmware's E2E receive configuration holds data IDs 0x0FAB-0x0FBA.";
CM_ SG_ 128 OBJECT_ID_RAW "Bits 32-39 (radar firmware; 40-47 are unused and never set). Observed 0 empty, 1 through 63 active. IDs move between wire slots and are reused.";
CM_ SG_ 128 LIFECYCLE_RAW "Observed +3 modulo 4096 per consecutive sweep for continuing IDs. Resets or discontinuities require a new track. Not read by the radar firmware.";
CM_ SG_ 128 FRAME_PHASE_RAW "Radar firmware: raw, valid below 16.";
CM_ SG_ 128 POSITION_X_RAW "Radar firmware: 0.05*raw m, valid below 4096, no offset (in the sender's frame). Unsigned 12-bit, bits 48-59; bit 60 belongs to OBJECT_CLASS_RAW. Working decode dRel = 0.05*raw-4.296 m (accepted): the -4.296 m is our measured offset to the bumper reference, not part of the encoding. The stock dash draws HUD_OBJECTS LONG_DIST from raw/4. Normalized closing and azimuth both imply a sensor range origin about 2.3 m behind the dRel origin, which fits the windshield camera that sends this bank.";
CM_ SG_ 128 OBJECT_CLASS_RAW "Object class, bits 60-63. Radar firmware: raw, valid below 16; it names no values. 1 car and 3 truck/large vehicle: accepted against the stock dash HUD_OBJECTS icons on held-out routes (99.6% and 99.2%). 6, 7 and 8 are not motorcycle, pedestrian and bicycle as such: against video within 25 m they name that object on 1 of 11, 3 of 13 and 3 of 12 clear labels, and are most often a car (2026-09-29). The stock dash shows icon 6 for moving two-wheelers, so its motorcycle icon adds a filter on top of class 6. 9-11 unconfirmed. Classes 1 and 3 never share a track with classes 6-11.";
CM_ SG_ 128 POSITION_Y_RAW "Lateral position, 14-bit offset binary, positive left. Radar firmware: 0.01*raw-81.91 m, zero at 8191 (also its initial value), valid below 16384. Until 2026-10-02 production used zero 8192 (1 cm right). The 0.01 m scale and 14-bit extent were accepted on held-out routes before the firmware confirmed them. A 13-bit read wraps past +-40.95 m.";
CM_ SG_ 128 LIFE_STATE_CANDIDATE_RAW "Radar firmware: a separate 2-bit field, raw, valid below 4. Life state 0 newborn, 1 established, 2 ending (2 on 6-26% of a track last three frames vs 0.1-4% mid-life, ten recordings). Shares: 0 9.6%, 1 88.1%, 2 2.3%; 3 never seen.";
CM_ SG_ 128 VELOCITY_RAW "Relative velocity. Radar firmware: 0.1*raw-154.0 m/s, zero at 1540 (also its initial value), valid below 2048; the MY22 firmware (A070) reads it the same way. Production used zero 1539 (+0.1 m/s) until 2026-10-02. Stationary objects read about -0.3 m/s against vEgo with 1539 and -0.4 m/s with 1540, which points at the wheel-speed reference rather than the encoding. Raw 0 (-154 m/s) is a floor saturation on newborn far objects, not a sentinel.";
CM_ SG_ 128 LATERAL_VELOCITY_RAW "Lateral velocity, positive left, relative in the sensor frame (includes the apparent motion of stationary objects from ego yaw). Radar firmware: 0.1*raw-51.1 m/s, zero at 511 (also its initial value), valid below 1024. Accepted 2026-10-02: the research decode 0.1*(raw-511) was provisional only because one held-out scale bracket (0.1004-0.1085) missed 0.1; the firmware settles the scale.";
CM_ SG_ 128 ENUM_106_CANDIDATE_RAW "Radar firmware: one 3-bit field, raw, valid below 5 (formerly read as flags at bits 106 and 107). Shares: 0 14.6%, 1 83.8%, 2 1.0%, 3 0.7%, 4 under 0.1%. Bit 106 (odd values) is set on about 40% of newborn frames and 97-99% after 1 s and agrees with LIFE_STATE 1 on 96%; bit 107 (values 2-3) is mostly on mature same-direction movers. Meaning unresolved.";
CM_ SG_ 128 ENUM_109_CANDIDATE_RAW "Not read by the radar firmware. Values 0-4. 1 on most established tracks; 2-4 mostly on same-direction movers near the path with high existence. Not an object class (metric width about 1.7 m for all values) and not a left/right lane code. Meaning unresolved.";
CM_ SG_ 128 EXISTENCE_PROBABILITY_RAW "Bosch A OBJECT_EXISTENCE_PROBABILITY counterpart (accepted). Radar firmware: 2*raw percent, valid below 51 (100%); observed 0-49, 49 most common. Best survival predictor within range x age strata on ten recordings (AUC 0.67-0.92); falls over the last second before track death; low on short-lived ghosts. 0 marks a degraded measurement (accepted on held-out routes: range innovation and vRel steps at least 2x worse on 17 of 17).";
CM_ SG_ 128 NORMALIZED_RATE_RAW "Bosch A NORMALIZED_CLOSING counterpart. Radar firmware: 0.001*raw-40 (1/s), valid below 65001. Accepted 2026-10-02: the research decode 0.001*(raw-40000) 1/s matches the firmware exactly; approximately vRel/(dRel+2.3 m) and follows Doppler vRel, not range change. 64999 marks invalid in the data (TTC 0, TTC sigma 0 and normalized-closing sigma 0 in the same frame), though the firmware getter accepts it.";
CM_ SG_ 128 QUALITY_CONTAINER_RAW "Bits 144-153 (radar firmware; 154-159 are unused and never set). Radar firmware: 0.05*raw, valid below 1024; the 0.05 step equals the range resolution. Bosch A RANGE_SIGMA candidate (provisional): range-noise specific on 8 of 10 recordings, weak (partial rho 0.08-0.25). Strongly range dependent. Unit unnamed.";
CM_ SG_ 128 REL_VELOCITY_UNCERTAINTY_RAW "Bosch A REL_VELOCITY_UNCERTAINTY counterpart (accepted, raw units): velocity-noise specific and monotonic with empirical vRel noise on ten recordings. Radar firmware: 0.1*raw, valid below 1024, unit unnamed. Nonlinear against our measured vRel noise (the adapter maps it empirically).";
CM_ SG_ 128 UNCERTAINTY_160_CANDIDATE_RAW "Radar firmware: 10 bits, 0.02*raw, valid below 1024. Mostly 1-2; higher on young and laterally offset objects. Weak noise association. Unit unnamed.";
CM_ SG_ 128 ACQUISITION_186_CANDIDATE_RAW "Radar firmware: 6 bits, 0.01*raw, valid below 64. Starts near 23 on newborn tracks and decays to about 2. Carries little information beyond track age.";
CM_ SG_ 128 UNCERTAINTY_192_CANDIDATE_RAW "Radar firmware: 9 bits, 0.1*raw, valid below 512. Decays with age; mixed velocity and lateral noise association, not specific to one noise. Unit unnamed.";
CM_ SG_ 128 TTC_RAW "Time to collision (accepted 2026-09-28 on held-out routes), (raw-1024)/128 s: a constant-velocity TTC, equal to -1/normalized closing within 0.06-0.10 s median. Reported only while an acceleration-aware collision prediction expects impact (lagging it by about 1-2 s); otherwise 2046. 0 = invalid (normalized closing 64999). Not read by the radar firmware, so the scale rests on captures. No Bosch A counterpart.";
CM_ SG_ 128 OBJECT_LENGTH_CANDIDATE_RAW "Object length, provisional (docs/object-length-217.md). Radar firmware: 0.05*raw m, valid below 512. Median 4.25 m for class 1 and 8.7-8.9 m for class 3; 0 for classes 6-8 on 92%; stable within a track (per-track std 0.09 m). A coarse estimate near a per-class default: a 4.8 m Mustang read 4.25 m. Held-out round 2026-10-02: L1, L3, L4 pass, L2 fails (class 3 is under 1.6x class 1 on 8 of 39 routes, where class 3 reads 3.6-6.6 m). X does not refer to the object center: no length term is needed in dRel.";
CM_ SG_ 128 FIELD_226_RAW "Radar firmware: 0.01*raw-1.57, valid below 316 (+-1.57, so likely an angle in rad); initial value 157 (0). Near 0 on moving objects (p5-p95 about +-0.15), spread over +-1.5 on stationary ones. Not the heading from motion: r -0.19 to +0.07 with the sign varying by route (docs/object-length-217.md). Meaning unknown.";
CM_ SG_ 128 TTC_SIGMA_CANDIDATE_RAW "TTC uncertainty (provisional): raw = TTC^2 * NORMALIZED_CLOSING_SIGMA / 64 within 0.1-2.5% on ten recordings. 127 = saturated or not populated; 0 = invalid. Stays populated on 3-26% of frames where TTC is defaulted (TTC about 8-19 s). Not read by the radar firmware.";
CM_ SG_ 128 FIELD_248_RAW "Not read by the radar firmware. Median raw 172. Meaning unknown.";
CM_ SG_ 128 WIDTH_FINE_258_CANDIDATE_RAW "Radar firmware: 8 bits, 0.0002*raw, no range check; stored next to AZIMUTH_CENTER, like the 0.0002 widths stored next to each edge. Values above 63 on 1.7% of frames. Angular extent measure, about 1/range within a track.";
CM_ SG_ 128 NORMALIZED_CLOSING_SIGMA_RAW "Bosch A NORMALIZED_CLOSING_SIGMA counterpart (accepted): specific to normalized-closing noise and monotonic with it on ten recordings; tied to TTC_SIGMA by a fixed 1/64 ratio. 0 when normalized closing is invalid. Radar firmware: 10 bits, 0.001*raw, valid below 1024, the same step as NORMALIZED_RATE. Values above 511 on 0.6% of frames, which the earlier 9-bit read truncated.";
CM_ SG_ 128 AUX_LATERAL_MOTION_304_CANDIDATE_RAW "Radar firmware: one 17-bit offset-binary field, raw*80/2^17-40, valid below 131072 (formerly read as signed 16 bits at 304 plus a direction bit at 320). Bit 320 is its sign: set on 49.7% of frames, which is why it agreed with the 16-bit value being nonnegative. Its scale (0.00061 per count) is far below the earlier 0.005-0.12 m/s bracket, so it is probably not a lateral speed in m/s; with the firmware decode it does not follow the azimuth rate, dY/dt, lateral velocity or its rate either (r < 0.08; docs/object-length-217.md). About 0 when normalized closing is invalid.";
CM_ SG_ 128 AUX_328_CANDIDATE_RAW "Radar firmware: 14 bits, 0.00002*raw, valid below 12501 (0-0.25). Changes nearly every frame; weak association with lateral and angular noise, not specific to one. 0 when normalized closing is invalid. Meaning unresolved.";
CM_ SG_ 128 FIELD_344_RAW "Radar firmware: 0.002*raw-10, valid below 8001 (+-10). Raw 5000 (0) on 68% of frames. Not acceleration: on lead-like objects its 90th-percentile magnitude is 0.04-0.12 against 0.55-1.83 m/s^2 of lead acceleration, r <= 0.2 (docs/object-length-217.md). Meaning unknown.";
CM_ SG_ 128 FIELD_360_RAW "Not read by the A230 radar firmware; the MY22 firmware (A070) defines 362:6 here instead. Median raw 48. Meaning unknown.";
CM_ SG_ 128 FIELD_368_RAW "Radar firmware: 0.0025*raw, valid below 1024. Raw 1 on 64% of frames. Meaning unknown.";
CM_ SG_ 128 AUX2_378_CANDIDATE_RAW "Radar firmware: same encoding as the azimuth fields, 0.00025*raw-1.02375, valid below 8192 (initial value 4095), and the radar passes it through atan like the edges: a tangent. Not signed 13-bit: with this decode its sign matches the azimuth on 98-99% of populated frames (routes 171, 17b, 19d), against 1-2% for a signed read. Shares one subrecord with ANGULAR_WIDTH_480: both hold their defaults together (8190 here; bits 480-487 zero) on about two thirds of observations. The MY22 firmware has no getter for it.";
CM_ SG_ 128 FIELD_391_RAW "Radar firmware: 0.05*raw, valid below 128. Scales with class: median 0.7 for class 1, 1.5 for class 3, 0 for classes 6-8; constant with age and range. Weakly related to how much OBJECT_LENGTH varies within a track (Spearman 0.19). Meaning unknown.";
CM_ SG_ 128 MATURITY_398_CANDIDATE_RAW "Radar firmware: one 7-bit field; not read. Values above 15 on 9.2% of frames. Counts down from about 6 to 1 as a track matures. Adds no velocity-error or survival information once track age is known.";
CM_ SG_ 128 FIELD_405_RAW "Not read by the radar firmware. Raw 49 on 82% of frames. Meaning unknown.";
CM_ SG_ 128 AZIMUTH_CENTER_RAW "Radar firmware: 0.00025*raw-1.02375 (zero at 4095), valid below 8192; unlike the edges, the radar does not pass it through atan here. Positive left. Equals the midpoint of the two edge fields on 97-99.9% of observations, so it is the same quantity as the edges: a tangent. The earlier 2^-12 rad per count, zero 4096, was 2.4% small.";
CM_ SG_ 128 AZIMUTH_EDGE_A_RAW "Left angular edge; same encoding as AZIMUTH_CENTER. The radar firmware passes it through atan, so it is the tangent of the angle: tan +-1.024 is about +-45.7 deg. Always at or left of the center. Clips at 8191.";
CM_ SG_ 128 FIELD_437_RAW "Radar firmware: raw, valid below 5. Shares: 1 55.5%, 2 9.3%, 3 35.0%, 4 0.3%. Meaning unknown.";
CM_ SG_ 128 AZIMUTH_EDGE_B_RAW "Right angular edge; same encoding as AZIMUTH_CENTER, passed through atan by the radar firmware (a tangent). Clips at 0 for near objects at the field-of-view edge. The edge difference is the Bosch A ANGULAR_WIDTH counterpart: it scales as 1/range within a track (log-log slope -0.91 to -0.99, ten recordings).";
CM_ SG_ 128 MOTION_CLASS_CANDIDATE_RAW "Radar firmware: bits 465-467, raw, valid below 5 (bit 464 is unused and never set). Values 0 78.6%, 1 4.0%, 2 17.4% (read as 0, 2, 4 before 2026-10-02). 2: same-direction traffic, and most objects seen only while ego is stopped. 1: oncoming or approaching, and most stationary objects seen while ego moves. 0: unassigned; young tracks, and every object on the 2026-09-10 and 2026-09-16 drives. Not a validated classifier.";
CM_ SG_ 128 ANGULAR_WIDTH_COARSE_CANDIDATE_RAW "Radar firmware: 0.0002*raw, no range check; stored next to AZIMUTH_EDGE_A. Angular extent measure, about 1/range within a track. Not a fixed-scale copy of the edge width (forward vs inverse fits 6-21 vs 14-24 edge counts per unit). Not received power.";
CM_ SG_ 128 ANGULAR_WIDTH_480_RAW "Angular-width measure (accepted 2026-09-29 on held-out routes): follows the azimuth-edge width (Spearman >= 0.8) and scales as about 1/range within tracks on 57 of 60 routes. Radar firmware: 0.0002*raw, no range check; stored next to AUX2_378. 0 while AUX2_378 holds its default.";
CM_ SG_ 128 ANGULAR_WIDTH_COARSE_COPY_CANDIDATE_RAW "Radar firmware: 0.0002*raw, no range check; stored next to AZIMUTH_EDGE_B. Byte 61 equals byte 59 on 99.7-100% of observations.";
BA_ "VFrameFormat" BO_ 1025 14;
CM_ BO_ 1025 "Sent by the radar on the private camera-radar bus (bus 1; in the radar firmware's transmit list), 50 Hz. Carries ego motion under stock longitudinal control; the fields read 0 under openpilot longitudinal (all 9 alpha routes), when the radar is disabled.";
CM_ SG_ 1025 YAW_RATE "Accepted 2026-09-29: matches the calibrated gyro yaw rate within 0.004 rad/s median with r >= 0.99 on 48 of 50 held-out stock routes. Positive left. Byte 45 bits 6-0 then byte 46 bits 7-3.";
CM_ SG_ 1025 LAT_ACCEL "Accepted 2026-09-29: lateral acceleration, positive left, about 0.02 g per count; matches vEgo x calibrated yaw rate within 0.15 m/s^2 median with r >= 0.95 on 49 of 50 held-out stock routes. Byte 10.";
CM_ SG_ 1025 SPEED_CANDIDATE_RAW "Ego speed, provisional: 0.0683*raw+0.054 m/s against vEgo (median error 0.07 m/s; passes on 59 of 59 held-out stock routes; the held-out rule failed only on alpha routes, where it reads 0). Byte 3 then byte 4 bits 7-6.";
CM_ SG_ 1025 STEER_ANGLE_CANDIDATE_RAW "Steering angle, provisional: raw is positive right; -2.008*raw+0.3 gives carState steeringAngleDeg in deg (positive left), median error about 1 deg; passes on 59 of 59 held-out stock routes.";
CM_ SG_ 1025 ACCEL_CANDIDATE_RAW "Longitudinal acceleration, provisional: -0.1896*raw m/s^2 against carState aEgo, median error 0.08 m/s^2; passes on 59 of 59 held-out stock routes.";
BA_ "VFrameFormat" BO_ 200 14;
CM_ BO_ 200 "The stock camera's lane lines for the ego lane, sent to the radar on the private camera-radar bus (bus 1) at 15 Hz: left line in bits 24-138, right line in bits 139-253. The radar firmware receives 0xC8-0xCE and unpacks four 32-byte PDUs with this layout (0xCA carries the next lines out); field boundaries here are its receive table. Only the offsets and line codes are accepted.";
CM_ SG_ 200 LEFT_LINE_OFFSET "Accepted 2026-09-29: lateral offset of the left line, (raw-2048)/128 m, positive left; 2048 with no line. The radar firmware decodes it the same way (raw/128 - 16). On 16 held-out routes 0.8484*offset+0.2399 m matches the model lane line 0.2 s earlier within 0.042 m median, slope 1.010. The 1/128 m scale is physically plausible: left minus right offset at highway speed is 3.52 m median on 10 held-out routes (model 3.39 m), close to 3.6-3.7 m US freeway lanes.";
CM_ SG_ 200 LEFT_LINE_CODE "7 = no line (accepted 2026-09-29 by user decision). Radar firmware: raw, valid below 8. Where the model lane probability is below 0.2 it reads 7 on 90.5% of held-out frames, against a frozen 95%; the rest are mostly lines the model doubts, visible on video in 7 of 12 sampled frames. 0-4 when a line is reported (line type, candidate). Raised median curbs can read as lines.";
CM_ SG_ 200 RIGHT_LINE_OFFSET "Accepted 2026-09-29: lateral offset of the right line, (raw-2048)/128 m, positive left; 2048 with no line. The radar firmware decodes it the same way. On 16 held-out routes 0.8796*offset-0.0968 m matches the model lane line 0.2 s earlier within 0.043 m median, slope 0.995. Scale check: see LEFT_LINE_OFFSET.";
CM_ SG_ 200 RIGHT_LINE_CODE "7 = no line (accepted 2026-09-29 by user decision). Radar firmware: raw, valid below 8. Where the model lane probability is below 0.2 it reads 7 on 92.1% of held-out frames, against a frozen 95%. 0-4 when a line is reported (line type, candidate).";
CM_ SG_ 200 LEFT_LINE_COUNTER_RAW "Radar firmware: raw, valid below 16. The record's own counter.";
CM_ SG_ 200 LEFT_LINE_RANGE_CANDIDATE_RAW "Radar firmware: 0.5*raw, valid below 512. 0 when no line; raw 45-151 (5th-95th percentile) on the ego left line when valid. View range in m (candidate).";
CM_ SG_ 200 LEFT_LINE_QUALITY_CANDIDATE_RAW "Radar firmware: 2*raw percent, valid below 51. 0 when no line; raw 35-45 when valid. Quality (candidate).";
CM_ SG_ 200 LEFT_LINE_HEADING_CANDIDATE_RAW "Radar firmware: (raw-2048)/2048, valid below 4096. Heading (candidate; rho 0.53-0.56 with the model's y10 - y0).";
CM_ SG_ 200 LEFT_LINE_67_RAW "Radar firmware: 0.01*raw, no range check. 0 when no line (formerly read as 5 bits).";
CM_ SG_ 200 LEFT_LINE_75_RAW "Radar firmware: raw/128, valid below 512 (formerly read as 3 bits, values 1-5).";
CM_ SG_ 200 LEFT_LINE_CURVATURE_CANDIDATE_RAW "Radar firmware: raw*2^-18 - 1/16, offset binary around 16384, valid below 32768. Curvature in 1/m (candidate; rho 0.28 with the model).";
CM_ SG_ 200 LEFT_LINE_CURVATURE_RATE_CANDIDATE_RAW "Radar firmware: raw*2^-20 - 1/64, offset binary around 16384, valid below 32768 (formerly read as signed 14 bits). Curvature rate (candidate).";
CM_ SG_ 200 LEFT_LINE_117_RAW "Radar firmware: raw, valid below 20. Bit 0 is set on 89-92% of frames with model probability above 0.8 on route 171.";
CM_ SG_ 200 LEFT_LINE_122_RAW "Radar firmware: not read.";
CM_ SG_ 200 LEFT_LINE_130_RAW "Radar firmware: 0.1*raw, valid below 512.";
CM_ SG_ 200 RIGHT_LINE_COUNTER_RAW "Radar firmware: raw, valid below 16. The record's own counter.";
CM_ SG_ 200 RIGHT_LINE_RANGE_CANDIDATE_RAW "Radar firmware: 0.5*raw, valid below 512. 0 when no line; raw 45-151 (5th-95th percentile) on the ego left line when valid. View range in m (candidate).";
CM_ SG_ 200 RIGHT_LINE_QUALITY_CANDIDATE_RAW "Radar firmware: 2*raw percent, valid below 51. 0 when no line; raw 35-45 when valid. Quality (candidate).";
CM_ SG_ 200 RIGHT_LINE_HEADING_CANDIDATE_RAW "Radar firmware: (raw-2048)/2048, valid below 4096. Heading (candidate; rho 0.53-0.56 with the model's y10 - y0).";
CM_ SG_ 200 RIGHT_LINE_182_RAW "Radar firmware: 0.01*raw, no range check. 0 when no line (formerly read as 5 bits).";
CM_ SG_ 200 RIGHT_LINE_190_RAW "Radar firmware: raw/128, valid below 512 (formerly read as 3 bits, values 1-5).";
CM_ SG_ 200 RIGHT_LINE_CURVATURE_CANDIDATE_RAW "Radar firmware: raw*2^-18 - 1/16, offset binary around 16384, valid below 32768. Curvature in 1/m (candidate; rho 0.28 with the model).";
CM_ SG_ 200 RIGHT_LINE_CURVATURE_RATE_CANDIDATE_RAW "Radar firmware: raw*2^-20 - 1/64, offset binary around 16384, valid below 32768 (formerly read as signed 14 bits). Curvature rate (candidate).";
CM_ SG_ 200 RIGHT_LINE_232_RAW "Radar firmware: raw, valid below 20. Bit 0 is set on 89-92% of frames with model probability above 0.8 on route 171.";
CM_ SG_ 200 RIGHT_LINE_237_RAW "Radar firmware: not read.";
CM_ SG_ 200 RIGHT_LINE_245_RAW "Radar firmware: 0.1*raw, valid below 512.";
CM_ SG_ 114 DREL "Accepted: 0.05*raw-4.296 m. The scale is the radar firmware's; the -4.296 m offset is ours, aligning to the HUD lead position (the firmware reads range with no offset, and the sensor origin is about 2.3 m further back).";
CM_ SG_ 114 YREL "Radar firmware decode: 0.01*raw-81.91 m (zero at 8191), 14-bit offset binary at bits 64-77, positive left.";
CM_ SG_ 114 VREL "Radar firmware decode: 0.1*raw-154.0 m/s (zero at 1540). Raw 0 (-154 m/s) is a saturation on newborn far objects.";
CM_ SG_ 114 LATERAL_VELOCITY "Radar firmware decode: 0.1*raw-51.1 m/s (zero at 511), positive left, relative in the sensor frame.";
CM_ SG_ 114 EXISTENCE_PROBABILITY "Radar firmware decode: 2*raw percent; the firmware rejects raw 51 and above. Observed 0-98%.";
CM_ SG_ 114 NORMALIZED_RATE "Radar firmware decode: 0.001*raw-40 (1/s), about vRel/(dRel+2.3 m). Raw 64999 marks invalid in the data.";
CM_ SG_ 114 AZIMUTH_CENTER "Radar firmware decode: 0.00025*raw-1.02375 (zero at 4095), positive left. A tangent (lateral over longitudinal): atan gives the angle. The midpoint of the two edges.";
CM_ SG_ 114 AZIMUTH_EDGE_A "Left edge, same decode as AZIMUTH_CENTER; the radar firmware applies atan to get the angle. Clips at 1.024 (about 45.7 deg).";
CM_ SG_ 114 AZIMUTH_EDGE_B "Right edge, same decode as AZIMUTH_CENTER; the radar firmware applies atan to get the angle. Clips at -1.024.";
CM_ SG_ 114 TTC "Accepted from captures: (raw-1024)/128 s constant-velocity TTC; the radar firmware never reads this field. Raw 2046 (7.98 s) = not reported, raw 0 = invalid; see TTC_RAW.";
CM_ SG_ 116 DREL "Accepted: 0.05*raw-4.296 m. The scale is the radar firmware's; the -4.296 m offset is ours, aligning to the HUD lead position (the firmware reads range with no offset, and the sensor origin is about 2.3 m further back).";
CM_ SG_ 116 YREL "Radar firmware decode: 0.01*raw-81.91 m (zero at 8191), 14-bit offset binary at bits 64-77, positive left.";
CM_ SG_ 116 VREL "Radar firmware decode: 0.1*raw-154.0 m/s (zero at 1540). Raw 0 (-154 m/s) is a saturation on newborn far objects.";
CM_ SG_ 116 LATERAL_VELOCITY "Radar firmware decode: 0.1*raw-51.1 m/s (zero at 511), positive left, relative in the sensor frame.";
CM_ SG_ 116 EXISTENCE_PROBABILITY "Radar firmware decode: 2*raw percent; the firmware rejects raw 51 and above. Observed 0-98%.";
CM_ SG_ 116 NORMALIZED_RATE "Radar firmware decode: 0.001*raw-40 (1/s), about vRel/(dRel+2.3 m). Raw 64999 marks invalid in the data.";
CM_ SG_ 116 AZIMUTH_CENTER "Radar firmware decode: 0.00025*raw-1.02375 (zero at 4095), positive left. A tangent (lateral over longitudinal): atan gives the angle. The midpoint of the two edges.";
CM_ SG_ 116 AZIMUTH_EDGE_A "Left edge, same decode as AZIMUTH_CENTER; the radar firmware applies atan to get the angle. Clips at 1.024 (about 45.7 deg).";
CM_ SG_ 116 AZIMUTH_EDGE_B "Right edge, same decode as AZIMUTH_CENTER; the radar firmware applies atan to get the angle. Clips at -1.024.";
CM_ SG_ 116 TTC "Accepted from captures: (raw-1024)/128 s constant-velocity TTC; the radar firmware never reads this field. Raw 2046 (7.98 s) = not reported, raw 0 = invalid; see TTC_RAW.";
CM_ SG_ 118 DREL "Accepted: 0.05*raw-4.296 m. The scale is the radar firmware's; the -4.296 m offset is ours, aligning to the HUD lead position (the firmware reads range with no offset, and the sensor origin is about 2.3 m further back).";
CM_ SG_ 118 YREL "Radar firmware decode: 0.01*raw-81.91 m (zero at 8191), 14-bit offset binary at bits 64-77, positive left.";
CM_ SG_ 118 VREL "Radar firmware decode: 0.1*raw-154.0 m/s (zero at 1540). Raw 0 (-154 m/s) is a saturation on newborn far objects.";
CM_ SG_ 118 LATERAL_VELOCITY "Radar firmware decode: 0.1*raw-51.1 m/s (zero at 511), positive left, relative in the sensor frame.";
CM_ SG_ 118 EXISTENCE_PROBABILITY "Radar firmware decode: 2*raw percent; the firmware rejects raw 51 and above. Observed 0-98%.";
CM_ SG_ 118 NORMALIZED_RATE "Radar firmware decode: 0.001*raw-40 (1/s), about vRel/(dRel+2.3 m). Raw 64999 marks invalid in the data.";
CM_ SG_ 118 AZIMUTH_CENTER "Radar firmware decode: 0.00025*raw-1.02375 (zero at 4095), positive left. A tangent (lateral over longitudinal): atan gives the angle. The midpoint of the two edges.";
CM_ SG_ 118 AZIMUTH_EDGE_A "Left edge, same decode as AZIMUTH_CENTER; the radar firmware applies atan to get the angle. Clips at 1.024 (about 45.7 deg).";
CM_ SG_ 118 AZIMUTH_EDGE_B "Right edge, same decode as AZIMUTH_CENTER; the radar firmware applies atan to get the angle. Clips at -1.024.";
CM_ SG_ 118 TTC "Accepted from captures: (raw-1024)/128 s constant-velocity TTC; the radar firmware never reads this field. Raw 2046 (7.98 s) = not reported, raw 0 = invalid; see TTC_RAW.";
CM_ SG_ 120 DREL "Accepted: 0.05*raw-4.296 m. The scale is the radar firmware's; the -4.296 m offset is ours, aligning to the HUD lead position (the firmware reads range with no offset, and the sensor origin is about 2.3 m further back).";
CM_ SG_ 120 YREL "Radar firmware decode: 0.01*raw-81.91 m (zero at 8191), 14-bit offset binary at bits 64-77, positive left.";
CM_ SG_ 120 VREL "Radar firmware decode: 0.1*raw-154.0 m/s (zero at 1540). Raw 0 (-154 m/s) is a saturation on newborn far objects.";
CM_ SG_ 120 LATERAL_VELOCITY "Radar firmware decode: 0.1*raw-51.1 m/s (zero at 511), positive left, relative in the sensor frame.";
CM_ SG_ 120 EXISTENCE_PROBABILITY "Radar firmware decode: 2*raw percent; the firmware rejects raw 51 and above. Observed 0-98%.";
CM_ SG_ 120 NORMALIZED_RATE "Radar firmware decode: 0.001*raw-40 (1/s), about vRel/(dRel+2.3 m). Raw 64999 marks invalid in the data.";
CM_ SG_ 120 AZIMUTH_CENTER "Radar firmware decode: 0.00025*raw-1.02375 (zero at 4095), positive left. A tangent (lateral over longitudinal): atan gives the angle. The midpoint of the two edges.";
CM_ SG_ 120 AZIMUTH_EDGE_A "Left edge, same decode as AZIMUTH_CENTER; the radar firmware applies atan to get the angle. Clips at 1.024 (about 45.7 deg).";
CM_ SG_ 120 AZIMUTH_EDGE_B "Right edge, same decode as AZIMUTH_CENTER; the radar firmware applies atan to get the angle. Clips at -1.024.";
CM_ SG_ 120 TTC "Accepted from captures: (raw-1024)/128 s constant-velocity TTC; the radar firmware never reads this field. Raw 2046 (7.98 s) = not reported, raw 0 = invalid; see TTC_RAW.";
CM_ SG_ 122 DREL "Accepted: 0.05*raw-4.296 m. The scale is the radar firmware's; the -4.296 m offset is ours, aligning to the HUD lead position (the firmware reads range with no offset, and the sensor origin is about 2.3 m further back).";
CM_ SG_ 122 YREL "Radar firmware decode: 0.01*raw-81.91 m (zero at 8191), 14-bit offset binary at bits 64-77, positive left.";
CM_ SG_ 122 VREL "Radar firmware decode: 0.1*raw-154.0 m/s (zero at 1540). Raw 0 (-154 m/s) is a saturation on newborn far objects.";
CM_ SG_ 122 LATERAL_VELOCITY "Radar firmware decode: 0.1*raw-51.1 m/s (zero at 511), positive left, relative in the sensor frame.";
CM_ SG_ 122 EXISTENCE_PROBABILITY "Radar firmware decode: 2*raw percent; the firmware rejects raw 51 and above. Observed 0-98%.";
CM_ SG_ 122 NORMALIZED_RATE "Radar firmware decode: 0.001*raw-40 (1/s), about vRel/(dRel+2.3 m). Raw 64999 marks invalid in the data.";
CM_ SG_ 122 AZIMUTH_CENTER "Radar firmware decode: 0.00025*raw-1.02375 (zero at 4095), positive left. A tangent (lateral over longitudinal): atan gives the angle. The midpoint of the two edges.";
CM_ SG_ 122 AZIMUTH_EDGE_A "Left edge, same decode as AZIMUTH_CENTER; the radar firmware applies atan to get the angle. Clips at 1.024 (about 45.7 deg).";
CM_ SG_ 122 AZIMUTH_EDGE_B "Right edge, same decode as AZIMUTH_CENTER; the radar firmware applies atan to get the angle. Clips at -1.024.";
CM_ SG_ 122 TTC "Accepted from captures: (raw-1024)/128 s constant-velocity TTC; the radar firmware never reads this field. Raw 2046 (7.98 s) = not reported, raw 0 = invalid; see TTC_RAW.";
CM_ SG_ 124 DREL "Accepted: 0.05*raw-4.296 m. The scale is the radar firmware's; the -4.296 m offset is ours, aligning to the HUD lead position (the firmware reads range with no offset, and the sensor origin is about 2.3 m further back).";
CM_ SG_ 124 YREL "Radar firmware decode: 0.01*raw-81.91 m (zero at 8191), 14-bit offset binary at bits 64-77, positive left.";
CM_ SG_ 124 VREL "Radar firmware decode: 0.1*raw-154.0 m/s (zero at 1540). Raw 0 (-154 m/s) is a saturation on newborn far objects.";
CM_ SG_ 124 LATERAL_VELOCITY "Radar firmware decode: 0.1*raw-51.1 m/s (zero at 511), positive left, relative in the sensor frame.";
CM_ SG_ 124 EXISTENCE_PROBABILITY "Radar firmware decode: 2*raw percent; the firmware rejects raw 51 and above. Observed 0-98%.";
CM_ SG_ 124 NORMALIZED_RATE "Radar firmware decode: 0.001*raw-40 (1/s), about vRel/(dRel+2.3 m). Raw 64999 marks invalid in the data.";
CM_ SG_ 124 AZIMUTH_CENTER "Radar firmware decode: 0.00025*raw-1.02375 (zero at 4095), positive left. A tangent (lateral over longitudinal): atan gives the angle. The midpoint of the two edges.";
CM_ SG_ 124 AZIMUTH_EDGE_A "Left edge, same decode as AZIMUTH_CENTER; the radar firmware applies atan to get the angle. Clips at 1.024 (about 45.7 deg).";
CM_ SG_ 124 AZIMUTH_EDGE_B "Right edge, same decode as AZIMUTH_CENTER; the radar firmware applies atan to get the angle. Clips at -1.024.";
CM_ SG_ 124 TTC "Accepted from captures: (raw-1024)/128 s constant-velocity TTC; the radar firmware never reads this field. Raw 2046 (7.98 s) = not reported, raw 0 = invalid; see TTC_RAW.";
CM_ SG_ 126 DREL "Accepted: 0.05*raw-4.296 m. The scale is the radar firmware's; the -4.296 m offset is ours, aligning to the HUD lead position (the firmware reads range with no offset, and the sensor origin is about 2.3 m further back).";
CM_ SG_ 126 YREL "Radar firmware decode: 0.01*raw-81.91 m (zero at 8191), 14-bit offset binary at bits 64-77, positive left.";
CM_ SG_ 126 VREL "Radar firmware decode: 0.1*raw-154.0 m/s (zero at 1540). Raw 0 (-154 m/s) is a saturation on newborn far objects.";
CM_ SG_ 126 LATERAL_VELOCITY "Radar firmware decode: 0.1*raw-51.1 m/s (zero at 511), positive left, relative in the sensor frame.";
CM_ SG_ 126 EXISTENCE_PROBABILITY "Radar firmware decode: 2*raw percent; the firmware rejects raw 51 and above. Observed 0-98%.";
CM_ SG_ 126 NORMALIZED_RATE "Radar firmware decode: 0.001*raw-40 (1/s), about vRel/(dRel+2.3 m). Raw 64999 marks invalid in the data.";
CM_ SG_ 126 AZIMUTH_CENTER "Radar firmware decode: 0.00025*raw-1.02375 (zero at 4095), positive left. A tangent (lateral over longitudinal): atan gives the angle. The midpoint of the two edges.";
CM_ SG_ 126 AZIMUTH_EDGE_A "Left edge, same decode as AZIMUTH_CENTER; the radar firmware applies atan to get the angle. Clips at 1.024 (about 45.7 deg).";
CM_ SG_ 126 AZIMUTH_EDGE_B "Right edge, same decode as AZIMUTH_CENTER; the radar firmware applies atan to get the angle. Clips at -1.024.";
CM_ SG_ 126 TTC "Accepted from captures: (raw-1024)/128 s constant-velocity TTC; the radar firmware never reads this field. Raw 2046 (7.98 s) = not reported, raw 0 = invalid; see TTC_RAW.";
CM_ SG_ 128 DREL "Accepted: 0.05*raw-4.296 m. The scale is the radar firmware's; the -4.296 m offset is ours, aligning to the HUD lead position (the firmware reads range with no offset, and the sensor origin is about 2.3 m further back).";
CM_ SG_ 128 YREL "Radar firmware decode: 0.01*raw-81.91 m (zero at 8191), 14-bit offset binary at bits 64-77, positive left.";
CM_ SG_ 128 VREL "Radar firmware decode: 0.1*raw-154.0 m/s (zero at 1540). Raw 0 (-154 m/s) is a saturation on newborn far objects.";
CM_ SG_ 128 LATERAL_VELOCITY "Radar firmware decode: 0.1*raw-51.1 m/s (zero at 511), positive left, relative in the sensor frame.";
CM_ SG_ 128 EXISTENCE_PROBABILITY "Radar firmware decode: 2*raw percent; the firmware rejects raw 51 and above. Observed 0-98%.";
CM_ SG_ 128 NORMALIZED_RATE "Radar firmware decode: 0.001*raw-40 (1/s), about vRel/(dRel+2.3 m). Raw 64999 marks invalid in the data.";
CM_ SG_ 128 AZIMUTH_CENTER "Radar firmware decode: 0.00025*raw-1.02375 (zero at 4095), positive left. A tangent (lateral over longitudinal): atan gives the angle. The midpoint of the two edges.";
CM_ SG_ 128 AZIMUTH_EDGE_A "Left edge, same decode as AZIMUTH_CENTER; the radar firmware applies atan to get the angle. Clips at 1.024 (about 45.7 deg).";
CM_ SG_ 128 AZIMUTH_EDGE_B "Right edge, same decode as AZIMUTH_CENTER; the radar firmware applies atan to get the angle. Clips at -1.024.";
CM_ SG_ 128 TTC "Accepted from captures: (raw-1024)/128 s constant-velocity TTC; the radar firmware never reads this field. Raw 2046 (7.98 s) = not reported, raw 0 = invalid; see TTC_RAW.";
VAL_ 114 OBJECT_CLASS_RAW 3 "TRUCK" 1 "CAR" ;
VAL_ 116 OBJECT_CLASS_RAW 3 "TRUCK" 1 "CAR" ;
VAL_ 118 OBJECT_CLASS_RAW 3 "TRUCK" 1 "CAR" ;
VAL_ 120 OBJECT_CLASS_RAW 3 "TRUCK" 1 "CAR" ;
VAL_ 122 OBJECT_CLASS_RAW 3 "TRUCK" 1 "CAR" ;
VAL_ 124 OBJECT_CLASS_RAW 3 "TRUCK" 1 "CAR" ;
VAL_ 126 OBJECT_CLASS_RAW 3 "TRUCK" 1 "CAR" ;
VAL_ 128 OBJECT_CLASS_RAW 3 "TRUCK" 1 "CAR" ;
VAL_ 200 LEFT_LINE_CODE 7 "NO_LINE" ;
VAL_ 200 RIGHT_LINE_CODE 7 "NO_LINE" ;
