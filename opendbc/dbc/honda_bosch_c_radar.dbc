VERSION "Honda Bosch C radar objects; receive-only; generated by bosch-c-research scripts/make_candidate_dbc.py"
NS_ :

BS_:
BU_: UNKNOWN LOGGER

BO_ 98 BOSCH_C_OBJECT_00: 64 UNKNOWN
 SG_ CRC16_RAW : 0|16@1+ (1,0) [0|65535] "" LOGGER
 SG_ FRAME_COUNTER_RAW : 16|8@1+ (1,0) [0|255] "" LOGGER
 SG_ FRAME_PHASE_RAW : 24|4@1+ (1,0) [0|15] "" LOGGER
 SG_ OBJECT_ID_RAW : 32|8@1+ (1,0) [0|255] "" LOGGER
 SG_ POSITION_X_RAW : 48|12@1+ (1,0) [0|4095] "" LOGGER
 SG_ OBJECT_CLASS_RAW : 60|4@1+ (1,0) [0|15] "" LOGGER
 SG_ POSITION_Y_RAW : 64|14@1+ (1,0) [0|16383] "" LOGGER
 SG_ LIFE_STATE_CANDIDATE_RAW : 78|2@1+ (1,0) [0|3] "" LOGGER
 SG_ VELOCITY_RAW : 80|11@1+ (1,0) [0|2047] "" LOGGER
 SG_ LATERAL_VELOCITY_RAW : 96|10@1+ (1,0) [0|1023] "" LOGGER
 SG_ ENUM_106_CANDIDATE_RAW : 106|3@1+ (1,0) [0|7] "" LOGGER
 SG_ ENUM_109_CANDIDATE_RAW : 109|3@1+ (1,0) [0|7] "" LOGGER
 SG_ EXISTENCE_PROBABILITY_RAW : 121|6@1+ (1,0) [0|63] "" LOGGER
 SG_ NORMALIZED_RATE_RAW : 128|16@1+ (1,0) [0|65535] "" LOGGER
 SG_ QUALITY_CONTAINER_RAW : 144|10@1+ (1,0) [0|1023] "" LOGGER
 SG_ UNCERTAINTY_160_CANDIDATE_RAW : 160|10@1+ (1,0) [0|1023] "" LOGGER
 SG_ REL_VELOCITY_UNCERTAINTY_RAW : 176|10@1+ (1,0) [0|1023] "" LOGGER
 SG_ ACQUISITION_186_CANDIDATE_RAW : 186|6@1+ (1,0) [0|63] "" LOGGER
 SG_ UNCERTAINTY_192_CANDIDATE_RAW : 192|9@1+ (1,0) [0|511] "" LOGGER
 SG_ TTC_RAW : 201|11@1+ (1,0) [0|2047] "" LOGGER
 SG_ OBJECT_LENGTH_CANDIDATE_RAW : 217|9@1+ (1,0) [0|511] "" LOGGER
 SG_ FIELD_226_RAW : 226|9@1+ (1,0) [0|511] "" LOGGER
 SG_ TTC_SIGMA_CANDIDATE_RAW : 240|7@1+ (1,0) [0|127] "" LOGGER
 SG_ FIELD_248_RAW : 248|10@1+ (1,0) [0|1023] "" LOGGER
 SG_ WIDTH_FINE_258_CANDIDATE_RAW : 258|8@1+ (1,0) [0|255] "" LOGGER
 SG_ LIFECYCLE_RAW : 271|12@1+ (1,0) [0|4095] "" LOGGER
 SG_ NORMALIZED_CLOSING_SIGMA_RAW : 288|10@1+ (1,0) [0|1023] "" LOGGER
 SG_ AUX_LATERAL_MOTION_304_CANDIDATE_RAW : 304|17@1+ (1,0) [0|131071] "" LOGGER
 SG_ AUX_328_CANDIDATE_RAW : 328|14@1+ (1,0) [0|16383] "" LOGGER
 SG_ FIELD_344_RAW : 344|13@1+ (1,0) [0|8191] "" LOGGER
 SG_ FIELD_360_RAW : 360|8@1+ (1,0) [0|255] "" LOGGER
 SG_ FIELD_368_RAW : 368|10@1+ (1,0) [0|1023] "" LOGGER
 SG_ AUX2_378_CANDIDATE_RAW : 378|13@1+ (1,0) [0|8191] "" LOGGER
 SG_ FIELD_391_RAW : 391|7@1+ (1,0) [0|127] "" LOGGER
 SG_ MATURITY_398_CANDIDATE_RAW : 398|7@1+ (1,0) [0|127] "" LOGGER
 SG_ FIELD_405_RAW : 405|6@1+ (1,0) [0|63] "" LOGGER
 SG_ AZIMUTH_CENTER_RAW : 411|13@1+ (1,0) [0|8191] "" LOGGER
 SG_ AZIMUTH_EDGE_A_RAW : 424|13@1+ (1,0) [0|8191] "" LOGGER
 SG_ FIELD_437_RAW : 437|3@1+ (1,0) [0|7] "" LOGGER
 SG_ AZIMUTH_EDGE_B_RAW : 440|13@1+ (1,0) [0|8191] "" LOGGER
 SG_ MOTION_CLASS_CANDIDATE_RAW : 465|3@1+ (1,0) [0|7] "" LOGGER
 SG_ ANGULAR_WIDTH_COARSE_CANDIDATE_RAW : 472|8@1+ (1,0) [0|255] "" LOGGER
 SG_ ANGULAR_WIDTH_480_RAW : 480|8@1+ (1,0) [0|255] "" LOGGER
 SG_ ANGULAR_WIDTH_COARSE_COPY_CANDIDATE_RAW : 488|8@1+ (1,0) [0|255] "" LOGGER
 SG_ DREL : 48|12@1+ (0.05,-4.296) [-4.296|200.454] "m" LOGGER
 SG_ YREL : 64|14@1+ (0.01,-81.91) [-81.91|81.92] "m" LOGGER
 SG_ VREL : 80|11@1+ (0.1,-154) [-154|50.7] "m/s" LOGGER
 SG_ LATERAL_VELOCITY : 96|10@1+ (0.1,-51.1) [-51.1|51.2] "m/s" LOGGER
 SG_ EXISTENCE_PROBABILITY : 121|6@1+ (2,0) [0|126] "%" LOGGER
 SG_ NORMALIZED_RATE : 128|16@1+ (0.001,-40) [-40|25.535] "1/s" LOGGER
 SG_ AZIMUTH_CENTER : 411|13@1+ (0.00025,-1.02375) [-1.02375|1.024] "" LOGGER
 SG_ AZIMUTH_EDGE_A : 424|13@1+ (0.00025,-1.02375) [-1.02375|1.024] "" LOGGER
 SG_ AZIMUTH_EDGE_B : 440|13@1+ (0.00025,-1.02375) [-1.02375|1.024] "" LOGGER
 SG_ TTC : 201|11@1+ (0.0078125,-8) [-8|7.9921875] "s" LOGGER

BO_ 100 BOSCH_C_OBJECT_01: 64 UNKNOWN
 SG_ CRC16_RAW : 0|16@1+ (1,0) [0|65535] "" LOGGER
 SG_ FRAME_COUNTER_RAW : 16|8@1+ (1,0) [0|255] "" LOGGER
 SG_ FRAME_PHASE_RAW : 24|4@1+ (1,0) [0|15] "" LOGGER
 SG_ OBJECT_ID_RAW : 32|8@1+ (1,0) [0|255] "" LOGGER
 SG_ POSITION_X_RAW : 48|12@1+ (1,0) [0|4095] "" LOGGER
 SG_ OBJECT_CLASS_RAW : 60|4@1+ (1,0) [0|15] "" LOGGER
 SG_ POSITION_Y_RAW : 64|14@1+ (1,0) [0|16383] "" LOGGER
 SG_ LIFE_STATE_CANDIDATE_RAW : 78|2@1+ (1,0) [0|3] "" LOGGER
 SG_ VELOCITY_RAW : 80|11@1+ (1,0) [0|2047] "" LOGGER
 SG_ LATERAL_VELOCITY_RAW : 96|10@1+ (1,0) [0|1023] "" LOGGER
 SG_ ENUM_106_CANDIDATE_RAW : 106|3@1+ (1,0) [0|7] "" LOGGER
 SG_ ENUM_109_CANDIDATE_RAW : 109|3@1+ (1,0) [0|7] "" LOGGER
 SG_ EXISTENCE_PROBABILITY_RAW : 121|6@1+ (1,0) [0|63] "" LOGGER
 SG_ NORMALIZED_RATE_RAW : 128|16@1+ (1,0) [0|65535] "" LOGGER
 SG_ QUALITY_CONTAINER_RAW : 144|10@1+ (1,0) [0|1023] "" LOGGER
 SG_ UNCERTAINTY_160_CANDIDATE_RAW : 160|10@1+ (1,0) [0|1023] "" LOGGER
 SG_ REL_VELOCITY_UNCERTAINTY_RAW : 176|10@1+ (1,0) [0|1023] "" LOGGER
 SG_ ACQUISITION_186_CANDIDATE_RAW : 186|6@1+ (1,0) [0|63] "" LOGGER
 SG_ UNCERTAINTY_192_CANDIDATE_RAW : 192|9@1+ (1,0) [0|511] "" LOGGER
 SG_ TTC_RAW : 201|11@1+ (1,0) [0|2047] "" LOGGER
 SG_ OBJECT_LENGTH_CANDIDATE_RAW : 217|9@1+ (1,0) [0|511] "" LOGGER
 SG_ FIELD_226_RAW : 226|9@1+ (1,0) [0|511] "" LOGGER
 SG_ TTC_SIGMA_CANDIDATE_RAW : 240|7@1+ (1,0) [0|127] "" LOGGER
 SG_ FIELD_248_RAW : 248|10@1+ (1,0) [0|1023] "" LOGGER
 SG_ WIDTH_FINE_258_CANDIDATE_RAW : 258|8@1+ (1,0) [0|255] "" LOGGER
 SG_ LIFECYCLE_RAW : 271|12@1+ (1,0) [0|4095] "" LOGGER
 SG_ NORMALIZED_CLOSING_SIGMA_RAW : 288|10@1+ (1,0) [0|1023] "" LOGGER
 SG_ AUX_LATERAL_MOTION_304_CANDIDATE_RAW : 304|17@1+ (1,0) [0|131071] "" LOGGER
 SG_ AUX_328_CANDIDATE_RAW : 328|14@1+ (1,0) [0|16383] "" LOGGER
 SG_ FIELD_344_RAW : 344|13@1+ (1,0) [0|8191] "" LOGGER
 SG_ FIELD_360_RAW : 360|8@1+ (1,0) [0|255] "" LOGGER
 SG_ FIELD_368_RAW : 368|10@1+ (1,0) [0|1023] "" LOGGER
 SG_ AUX2_378_CANDIDATE_RAW : 378|13@1+ (1,0) [0|8191] "" LOGGER
 SG_ FIELD_391_RAW : 391|7@1+ (1,0) [0|127] "" LOGGER
 SG_ MATURITY_398_CANDIDATE_RAW : 398|7@1+ (1,0) [0|127] "" LOGGER
 SG_ FIELD_405_RAW : 405|6@1+ (1,0) [0|63] "" LOGGER
 SG_ AZIMUTH_CENTER_RAW : 411|13@1+ (1,0) [0|8191] "" LOGGER
 SG_ AZIMUTH_EDGE_A_RAW : 424|13@1+ (1,0) [0|8191] "" LOGGER
 SG_ FIELD_437_RAW : 437|3@1+ (1,0) [0|7] "" LOGGER
 SG_ AZIMUTH_EDGE_B_RAW : 440|13@1+ (1,0) [0|8191] "" LOGGER
 SG_ MOTION_CLASS_CANDIDATE_RAW : 465|3@1+ (1,0) [0|7] "" LOGGER
 SG_ ANGULAR_WIDTH_COARSE_CANDIDATE_RAW : 472|8@1+ (1,0) [0|255] "" LOGGER
 SG_ ANGULAR_WIDTH_480_RAW : 480|8@1+ (1,0) [0|255] "" LOGGER
 SG_ ANGULAR_WIDTH_COARSE_COPY_CANDIDATE_RAW : 488|8@1+ (1,0) [0|255] "" LOGGER
 SG_ DREL : 48|12@1+ (0.05,-4.296) [-4.296|200.454] "m" LOGGER
 SG_ YREL : 64|14@1+ (0.01,-81.91) [-81.91|81.92] "m" LOGGER
 SG_ VREL : 80|11@1+ (0.1,-154) [-154|50.7] "m/s" LOGGER
 SG_ LATERAL_VELOCITY : 96|10@1+ (0.1,-51.1) [-51.1|51.2] "m/s" LOGGER
 SG_ EXISTENCE_PROBABILITY : 121|6@1+ (2,0) [0|126] "%" LOGGER
 SG_ NORMALIZED_RATE : 128|16@1+ (0.001,-40) [-40|25.535] "1/s" LOGGER
 SG_ AZIMUTH_CENTER : 411|13@1+ (0.00025,-1.02375) [-1.02375|1.024] "" LOGGER
 SG_ AZIMUTH_EDGE_A : 424|13@1+ (0.00025,-1.02375) [-1.02375|1.024] "" LOGGER
 SG_ AZIMUTH_EDGE_B : 440|13@1+ (0.00025,-1.02375) [-1.02375|1.024] "" LOGGER
 SG_ TTC : 201|11@1+ (0.0078125,-8) [-8|7.9921875] "s" LOGGER

BO_ 102 BOSCH_C_OBJECT_02: 64 UNKNOWN
 SG_ CRC16_RAW : 0|16@1+ (1,0) [0|65535] "" LOGGER
 SG_ FRAME_COUNTER_RAW : 16|8@1+ (1,0) [0|255] "" LOGGER
 SG_ FRAME_PHASE_RAW : 24|4@1+ (1,0) [0|15] "" LOGGER
 SG_ OBJECT_ID_RAW : 32|8@1+ (1,0) [0|255] "" LOGGER
 SG_ POSITION_X_RAW : 48|12@1+ (1,0) [0|4095] "" LOGGER
 SG_ OBJECT_CLASS_RAW : 60|4@1+ (1,0) [0|15] "" LOGGER
 SG_ POSITION_Y_RAW : 64|14@1+ (1,0) [0|16383] "" LOGGER
 SG_ LIFE_STATE_CANDIDATE_RAW : 78|2@1+ (1,0) [0|3] "" LOGGER
 SG_ VELOCITY_RAW : 80|11@1+ (1,0) [0|2047] "" LOGGER
 SG_ LATERAL_VELOCITY_RAW : 96|10@1+ (1,0) [0|1023] "" LOGGER
 SG_ ENUM_106_CANDIDATE_RAW : 106|3@1+ (1,0) [0|7] "" LOGGER
 SG_ ENUM_109_CANDIDATE_RAW : 109|3@1+ (1,0) [0|7] "" LOGGER
 SG_ EXISTENCE_PROBABILITY_RAW : 121|6@1+ (1,0) [0|63] "" LOGGER
 SG_ NORMALIZED_RATE_RAW : 128|16@1+ (1,0) [0|65535] "" LOGGER
 SG_ QUALITY_CONTAINER_RAW : 144|10@1+ (1,0) [0|1023] "" LOGGER
 SG_ UNCERTAINTY_160_CANDIDATE_RAW : 160|10@1+ (1,0) [0|1023] "" LOGGER
 SG_ REL_VELOCITY_UNCERTAINTY_RAW : 176|10@1+ (1,0) [0|1023] "" LOGGER
 SG_ ACQUISITION_186_CANDIDATE_RAW : 186|6@1+ (1,0) [0|63] "" LOGGER
 SG_ UNCERTAINTY_192_CANDIDATE_RAW : 192|9@1+ (1,0) [0|511] "" LOGGER
 SG_ TTC_RAW : 201|11@1+ (1,0) [0|2047] "" LOGGER
 SG_ OBJECT_LENGTH_CANDIDATE_RAW : 217|9@1+ (1,0) [0|511] "" LOGGER
 SG_ FIELD_226_RAW : 226|9@1+ (1,0) [0|511] "" LOGGER
 SG_ TTC_SIGMA_CANDIDATE_RAW : 240|7@1+ (1,0) [0|127] "" LOGGER
 SG_ FIELD_248_RAW : 248|10@1+ (1,0) [0|1023] "" LOGGER
 SG_ WIDTH_FINE_258_CANDIDATE_RAW : 258|8@1+ (1,0) [0|255] "" LOGGER
 SG_ LIFECYCLE_RAW : 271|12@1+ (1,0) [0|4095] "" LOGGER
 SG_ NORMALIZED_CLOSING_SIGMA_RAW : 288|10@1+ (1,0) [0|1023] "" LOGGER
 SG_ AUX_LATERAL_MOTION_304_CANDIDATE_RAW : 304|17@1+ (1,0) [0|131071] "" LOGGER
 SG_ AUX_328_CANDIDATE_RAW : 328|14@1+ (1,0) [0|16383] "" LOGGER
 SG_ FIELD_344_RAW : 344|13@1+ (1,0) [0|8191] "" LOGGER
 SG_ FIELD_360_RAW : 360|8@1+ (1,0) [0|255] "" LOGGER
 SG_ FIELD_368_RAW : 368|10@1+ (1,0) [0|1023] "" LOGGER
 SG_ AUX2_378_CANDIDATE_RAW : 378|13@1+ (1,0) [0|8191] "" LOGGER
 SG_ FIELD_391_RAW : 391|7@1+ (1,0) [0|127] "" LOGGER
 SG_ MATURITY_398_CANDIDATE_RAW : 398|7@1+ (1,0) [0|127] "" LOGGER
 SG_ FIELD_405_RAW : 405|6@1+ (1,0) [0|63] "" LOGGER
 SG_ AZIMUTH_CENTER_RAW : 411|13@1+ (1,0) [0|8191] "" LOGGER
 SG_ AZIMUTH_EDGE_A_RAW : 424|13@1+ (1,0) [0|8191] "" LOGGER
 SG_ FIELD_437_RAW : 437|3@1+ (1,0) [0|7] "" LOGGER
 SG_ AZIMUTH_EDGE_B_RAW : 440|13@1+ (1,0) [0|8191] "" LOGGER
 SG_ MOTION_CLASS_CANDIDATE_RAW : 465|3@1+ (1,0) [0|7] "" LOGGER
 SG_ ANGULAR_WIDTH_COARSE_CANDIDATE_RAW : 472|8@1+ (1,0) [0|255] "" LOGGER
 SG_ ANGULAR_WIDTH_480_RAW : 480|8@1+ (1,0) [0|255] "" LOGGER
 SG_ ANGULAR_WIDTH_COARSE_COPY_CANDIDATE_RAW : 488|8@1+ (1,0) [0|255] "" LOGGER
 SG_ DREL : 48|12@1+ (0.05,-4.296) [-4.296|200.454] "m" LOGGER
 SG_ YREL : 64|14@1+ (0.01,-81.91) [-81.91|81.92] "m" LOGGER
 SG_ VREL : 80|11@1+ (0.1,-154) [-154|50.7] "m/s" LOGGER
 SG_ LATERAL_VELOCITY : 96|10@1+ (0.1,-51.1) [-51.1|51.2] "m/s" LOGGER
 SG_ EXISTENCE_PROBABILITY : 121|6@1+ (2,0) [0|126] "%" LOGGER
 SG_ NORMALIZED_RATE : 128|16@1+ (0.001,-40) [-40|25.535] "1/s" LOGGER
 SG_ AZIMUTH_CENTER : 411|13@1+ (0.00025,-1.02375) [-1.02375|1.024] "" LOGGER
 SG_ AZIMUTH_EDGE_A : 424|13@1+ (0.00025,-1.02375) [-1.02375|1.024] "" LOGGER
 SG_ AZIMUTH_EDGE_B : 440|13@1+ (0.00025,-1.02375) [-1.02375|1.024] "" LOGGER
 SG_ TTC : 201|11@1+ (0.0078125,-8) [-8|7.9921875] "s" LOGGER

BO_ 104 BOSCH_C_OBJECT_03: 64 UNKNOWN
 SG_ CRC16_RAW : 0|16@1+ (1,0) [0|65535] "" LOGGER
 SG_ FRAME_COUNTER_RAW : 16|8@1+ (1,0) [0|255] "" LOGGER
 SG_ FRAME_PHASE_RAW : 24|4@1+ (1,0) [0|15] "" LOGGER
 SG_ OBJECT_ID_RAW : 32|8@1+ (1,0) [0|255] "" LOGGER
 SG_ POSITION_X_RAW : 48|12@1+ (1,0) [0|4095] "" LOGGER
 SG_ OBJECT_CLASS_RAW : 60|4@1+ (1,0) [0|15] "" LOGGER
 SG_ POSITION_Y_RAW : 64|14@1+ (1,0) [0|16383] "" LOGGER
 SG_ LIFE_STATE_CANDIDATE_RAW : 78|2@1+ (1,0) [0|3] "" LOGGER
 SG_ VELOCITY_RAW : 80|11@1+ (1,0) [0|2047] "" LOGGER
 SG_ LATERAL_VELOCITY_RAW : 96|10@1+ (1,0) [0|1023] "" LOGGER
 SG_ ENUM_106_CANDIDATE_RAW : 106|3@1+ (1,0) [0|7] "" LOGGER
 SG_ ENUM_109_CANDIDATE_RAW : 109|3@1+ (1,0) [0|7] "" LOGGER
 SG_ EXISTENCE_PROBABILITY_RAW : 121|6@1+ (1,0) [0|63] "" LOGGER
 SG_ NORMALIZED_RATE_RAW : 128|16@1+ (1,0) [0|65535] "" LOGGER
 SG_ QUALITY_CONTAINER_RAW : 144|10@1+ (1,0) [0|1023] "" LOGGER
 SG_ UNCERTAINTY_160_CANDIDATE_RAW : 160|10@1+ (1,0) [0|1023] "" LOGGER
 SG_ REL_VELOCITY_UNCERTAINTY_RAW : 176|10@1+ (1,0) [0|1023] "" LOGGER
 SG_ ACQUISITION_186_CANDIDATE_RAW : 186|6@1+ (1,0) [0|63] "" LOGGER
 SG_ UNCERTAINTY_192_CANDIDATE_RAW : 192|9@1+ (1,0) [0|511] "" LOGGER
 SG_ TTC_RAW : 201|11@1+ (1,0) [0|2047] "" LOGGER
 SG_ OBJECT_LENGTH_CANDIDATE_RAW : 217|9@1+ (1,0) [0|511] "" LOGGER
 SG_ FIELD_226_RAW : 226|9@1+ (1,0) [0|511] "" LOGGER
 SG_ TTC_SIGMA_CANDIDATE_RAW : 240|7@1+ (1,0) [0|127] "" LOGGER
 SG_ FIELD_248_RAW : 248|10@1+ (1,0) [0|1023] "" LOGGER
 SG_ WIDTH_FINE_258_CANDIDATE_RAW : 258|8@1+ (1,0) [0|255] "" LOGGER
 SG_ LIFECYCLE_RAW : 271|12@1+ (1,0) [0|4095] "" LOGGER
 SG_ NORMALIZED_CLOSING_SIGMA_RAW : 288|10@1+ (1,0) [0|1023] "" LOGGER
 SG_ AUX_LATERAL_MOTION_304_CANDIDATE_RAW : 304|17@1+ (1,0) [0|131071] "" LOGGER
 SG_ AUX_328_CANDIDATE_RAW : 328|14@1+ (1,0) [0|16383] "" LOGGER
 SG_ FIELD_344_RAW : 344|13@1+ (1,0) [0|8191] "" LOGGER
 SG_ FIELD_360_RAW : 360|8@1+ (1,0) [0|255] "" LOGGER
 SG_ FIELD_368_RAW : 368|10@1+ (1,0) [0|1023] "" LOGGER
 SG_ AUX2_378_CANDIDATE_RAW : 378|13@1+ (1,0) [0|8191] "" LOGGER
 SG_ FIELD_391_RAW : 391|7@1+ (1,0) [0|127] "" LOGGER
 SG_ MATURITY_398_CANDIDATE_RAW : 398|7@1+ (1,0) [0|127] "" LOGGER
 SG_ FIELD_405_RAW : 405|6@1+ (1,0) [0|63] "" LOGGER
 SG_ AZIMUTH_CENTER_RAW : 411|13@1+ (1,0) [0|8191] "" LOGGER
 SG_ AZIMUTH_EDGE_A_RAW : 424|13@1+ (1,0) [0|8191] "" LOGGER
 SG_ FIELD_437_RAW : 437|3@1+ (1,0) [0|7] "" LOGGER
 SG_ AZIMUTH_EDGE_B_RAW : 440|13@1+ (1,0) [0|8191] "" LOGGER
 SG_ MOTION_CLASS_CANDIDATE_RAW : 465|3@1+ (1,0) [0|7] "" LOGGER
 SG_ ANGULAR_WIDTH_COARSE_CANDIDATE_RAW : 472|8@1+ (1,0) [0|255] "" LOGGER
 SG_ ANGULAR_WIDTH_480_RAW : 480|8@1+ (1,0) [0|255] "" LOGGER
 SG_ ANGULAR_WIDTH_COARSE_COPY_CANDIDATE_RAW : 488|8@1+ (1,0) [0|255] "" LOGGER
 SG_ DREL : 48|12@1+ (0.05,-4.296) [-4.296|200.454] "m" LOGGER
 SG_ YREL : 64|14@1+ (0.01,-81.91) [-81.91|81.92] "m" LOGGER
 SG_ VREL : 80|11@1+ (0.1,-154) [-154|50.7] "m/s" LOGGER
 SG_ LATERAL_VELOCITY : 96|10@1+ (0.1,-51.1) [-51.1|51.2] "m/s" LOGGER
 SG_ EXISTENCE_PROBABILITY : 121|6@1+ (2,0) [0|126] "%" LOGGER
 SG_ NORMALIZED_RATE : 128|16@1+ (0.001,-40) [-40|25.535] "1/s" LOGGER
 SG_ AZIMUTH_CENTER : 411|13@1+ (0.00025,-1.02375) [-1.02375|1.024] "" LOGGER
 SG_ AZIMUTH_EDGE_A : 424|13@1+ (0.00025,-1.02375) [-1.02375|1.024] "" LOGGER
 SG_ AZIMUTH_EDGE_B : 440|13@1+ (0.00025,-1.02375) [-1.02375|1.024] "" LOGGER
 SG_ TTC : 201|11@1+ (0.0078125,-8) [-8|7.9921875] "s" LOGGER

BO_ 106 BOSCH_C_OBJECT_04: 64 UNKNOWN
 SG_ CRC16_RAW : 0|16@1+ (1,0) [0|65535] "" LOGGER
 SG_ FRAME_COUNTER_RAW : 16|8@1+ (1,0) [0|255] "" LOGGER
 SG_ FRAME_PHASE_RAW : 24|4@1+ (1,0) [0|15] "" LOGGER
 SG_ OBJECT_ID_RAW : 32|8@1+ (1,0) [0|255] "" LOGGER
 SG_ POSITION_X_RAW : 48|12@1+ (1,0) [0|4095] "" LOGGER
 SG_ OBJECT_CLASS_RAW : 60|4@1+ (1,0) [0|15] "" LOGGER
 SG_ POSITION_Y_RAW : 64|14@1+ (1,0) [0|16383] "" LOGGER
 SG_ LIFE_STATE_CANDIDATE_RAW : 78|2@1+ (1,0) [0|3] "" LOGGER
 SG_ VELOCITY_RAW : 80|11@1+ (1,0) [0|2047] "" LOGGER
 SG_ LATERAL_VELOCITY_RAW : 96|10@1+ (1,0) [0|1023] "" LOGGER
 SG_ ENUM_106_CANDIDATE_RAW : 106|3@1+ (1,0) [0|7] "" LOGGER
 SG_ ENUM_109_CANDIDATE_RAW : 109|3@1+ (1,0) [0|7] "" LOGGER
 SG_ EXISTENCE_PROBABILITY_RAW : 121|6@1+ (1,0) [0|63] "" LOGGER
 SG_ NORMALIZED_RATE_RAW : 128|16@1+ (1,0) [0|65535] "" LOGGER
 SG_ QUALITY_CONTAINER_RAW : 144|10@1+ (1,0) [0|1023] "" LOGGER
 SG_ UNCERTAINTY_160_CANDIDATE_RAW : 160|10@1+ (1,0) [0|1023] "" LOGGER
 SG_ REL_VELOCITY_UNCERTAINTY_RAW : 176|10@1+ (1,0) [0|1023] "" LOGGER
 SG_ ACQUISITION_186_CANDIDATE_RAW : 186|6@1+ (1,0) [0|63] "" LOGGER
 SG_ UNCERTAINTY_192_CANDIDATE_RAW : 192|9@1+ (1,0) [0|511] "" LOGGER
 SG_ TTC_RAW : 201|11@1+ (1,0) [0|2047] "" LOGGER
 SG_ OBJECT_LENGTH_CANDIDATE_RAW : 217|9@1+ (1,0) [0|511] "" LOGGER
 SG_ FIELD_226_RAW : 226|9@1+ (1,0) [0|511] "" LOGGER
 SG_ TTC_SIGMA_CANDIDATE_RAW : 240|7@1+ (1,0) [0|127] "" LOGGER
 SG_ FIELD_248_RAW : 248|10@1+ (1,0) [0|1023] "" LOGGER
 SG_ WIDTH_FINE_258_CANDIDATE_RAW : 258|8@1+ (1,0) [0|255] "" LOGGER
 SG_ LIFECYCLE_RAW : 271|12@1+ (1,0) [0|4095] "" LOGGER
 SG_ NORMALIZED_CLOSING_SIGMA_RAW : 288|10@1+ (1,0) [0|1023] "" LOGGER
 SG_ AUX_LATERAL_MOTION_304_CANDIDATE_RAW : 304|17@1+ (1,0) [0|131071] "" LOGGER
 SG_ AUX_328_CANDIDATE_RAW : 328|14@1+ (1,0) [0|16383] "" LOGGER
 SG_ FIELD_344_RAW : 344|13@1+ (1,0) [0|8191] "" LOGGER
 SG_ FIELD_360_RAW : 360|8@1+ (1,0) [0|255] "" LOGGER
 SG_ FIELD_368_RAW : 368|10@1+ (1,0) [0|1023] "" LOGGER
 SG_ AUX2_378_CANDIDATE_RAW : 378|13@1+ (1,0) [0|8191] "" LOGGER
 SG_ FIELD_391_RAW : 391|7@1+ (1,0) [0|127] "" LOGGER
 SG_ MATURITY_398_CANDIDATE_RAW : 398|7@1+ (1,0) [0|127] "" LOGGER
 SG_ FIELD_405_RAW : 405|6@1+ (1,0) [0|63] "" LOGGER
 SG_ AZIMUTH_CENTER_RAW : 411|13@1+ (1,0) [0|8191] "" LOGGER
 SG_ AZIMUTH_EDGE_A_RAW : 424|13@1+ (1,0) [0|8191] "" LOGGER
 SG_ FIELD_437_RAW : 437|3@1+ (1,0) [0|7] "" LOGGER
 SG_ AZIMUTH_EDGE_B_RAW : 440|13@1+ (1,0) [0|8191] "" LOGGER
 SG_ MOTION_CLASS_CANDIDATE_RAW : 465|3@1+ (1,0) [0|7] "" LOGGER
 SG_ ANGULAR_WIDTH_COARSE_CANDIDATE_RAW : 472|8@1+ (1,0) [0|255] "" LOGGER
 SG_ ANGULAR_WIDTH_480_RAW : 480|8@1+ (1,0) [0|255] "" LOGGER
 SG_ ANGULAR_WIDTH_COARSE_COPY_CANDIDATE_RAW : 488|8@1+ (1,0) [0|255] "" LOGGER
 SG_ DREL : 48|12@1+ (0.05,-4.296) [-4.296|200.454] "m" LOGGER
 SG_ YREL : 64|14@1+ (0.01,-81.91) [-81.91|81.92] "m" LOGGER
 SG_ VREL : 80|11@1+ (0.1,-154) [-154|50.7] "m/s" LOGGER
 SG_ LATERAL_VELOCITY : 96|10@1+ (0.1,-51.1) [-51.1|51.2] "m/s" LOGGER
 SG_ EXISTENCE_PROBABILITY : 121|6@1+ (2,0) [0|126] "%" LOGGER
 SG_ NORMALIZED_RATE : 128|16@1+ (0.001,-40) [-40|25.535] "1/s" LOGGER
 SG_ AZIMUTH_CENTER : 411|13@1+ (0.00025,-1.02375) [-1.02375|1.024] "" LOGGER
 SG_ AZIMUTH_EDGE_A : 424|13@1+ (0.00025,-1.02375) [-1.02375|1.024] "" LOGGER
 SG_ AZIMUTH_EDGE_B : 440|13@1+ (0.00025,-1.02375) [-1.02375|1.024] "" LOGGER
 SG_ TTC : 201|11@1+ (0.0078125,-8) [-8|7.9921875] "s" LOGGER

BO_ 108 BOSCH_C_OBJECT_05: 64 UNKNOWN
 SG_ CRC16_RAW : 0|16@1+ (1,0) [0|65535] "" LOGGER
 SG_ FRAME_COUNTER_RAW : 16|8@1+ (1,0) [0|255] "" LOGGER
 SG_ FRAME_PHASE_RAW : 24|4@1+ (1,0) [0|15] "" LOGGER
 SG_ OBJECT_ID_RAW : 32|8@1+ (1,0) [0|255] "" LOGGER
 SG_ POSITION_X_RAW : 48|12@1+ (1,0) [0|4095] "" LOGGER
 SG_ OBJECT_CLASS_RAW : 60|4@1+ (1,0) [0|15] "" LOGGER
 SG_ POSITION_Y_RAW : 64|14@1+ (1,0) [0|16383] "" LOGGER
 SG_ LIFE_STATE_CANDIDATE_RAW : 78|2@1+ (1,0) [0|3] "" LOGGER
 SG_ VELOCITY_RAW : 80|11@1+ (1,0) [0|2047] "" LOGGER
 SG_ LATERAL_VELOCITY_RAW : 96|10@1+ (1,0) [0|1023] "" LOGGER
 SG_ ENUM_106_CANDIDATE_RAW : 106|3@1+ (1,0) [0|7] "" LOGGER
 SG_ ENUM_109_CANDIDATE_RAW : 109|3@1+ (1,0) [0|7] "" LOGGER
 SG_ EXISTENCE_PROBABILITY_RAW : 121|6@1+ (1,0) [0|63] "" LOGGER
 SG_ NORMALIZED_RATE_RAW : 128|16@1+ (1,0) [0|65535] "" LOGGER
 SG_ QUALITY_CONTAINER_RAW : 144|10@1+ (1,0) [0|1023] "" LOGGER
 SG_ UNCERTAINTY_160_CANDIDATE_RAW : 160|10@1+ (1,0) [0|1023] "" LOGGER
 SG_ REL_VELOCITY_UNCERTAINTY_RAW : 176|10@1+ (1,0) [0|1023] "" LOGGER
 SG_ ACQUISITION_186_CANDIDATE_RAW : 186|6@1+ (1,0) [0|63] "" LOGGER
 SG_ UNCERTAINTY_192_CANDIDATE_RAW : 192|9@1+ (1,0) [0|511] "" LOGGER
 SG_ TTC_RAW : 201|11@1+ (1,0) [0|2047] "" LOGGER
 SG_ OBJECT_LENGTH_CANDIDATE_RAW : 217|9@1+ (1,0) [0|511] "" LOGGER
 SG_ FIELD_226_RAW : 226|9@1+ (1,0) [0|511] "" LOGGER
 SG_ TTC_SIGMA_CANDIDATE_RAW : 240|7@1+ (1,0) [0|127] "" LOGGER
 SG_ FIELD_248_RAW : 248|10@1+ (1,0) [0|1023] "" LOGGER
 SG_ WIDTH_FINE_258_CANDIDATE_RAW : 258|8@1+ (1,0) [0|255] "" LOGGER
 SG_ LIFECYCLE_RAW : 271|12@1+ (1,0) [0|4095] "" LOGGER
 SG_ NORMALIZED_CLOSING_SIGMA_RAW : 288|10@1+ (1,0) [0|1023] "" LOGGER
 SG_ AUX_LATERAL_MOTION_304_CANDIDATE_RAW : 304|17@1+ (1,0) [0|131071] "" LOGGER
 SG_ AUX_328_CANDIDATE_RAW : 328|14@1+ (1,0) [0|16383] "" LOGGER
 SG_ FIELD_344_RAW : 344|13@1+ (1,0) [0|8191] "" LOGGER
 SG_ FIELD_360_RAW : 360|8@1+ (1,0) [0|255] "" LOGGER
 SG_ FIELD_368_RAW : 368|10@1+ (1,0) [0|1023] "" LOGGER
 SG_ AUX2_378_CANDIDATE_RAW : 378|13@1+ (1,0) [0|8191] "" LOGGER
 SG_ FIELD_391_RAW : 391|7@1+ (1,0) [0|127] "" LOGGER
 SG_ MATURITY_398_CANDIDATE_RAW : 398|7@1+ (1,0) [0|127] "" LOGGER
 SG_ FIELD_405_RAW : 405|6@1+ (1,0) [0|63] "" LOGGER
 SG_ AZIMUTH_CENTER_RAW : 411|13@1+ (1,0) [0|8191] "" LOGGER
 SG_ AZIMUTH_EDGE_A_RAW : 424|13@1+ (1,0) [0|8191] "" LOGGER
 SG_ FIELD_437_RAW : 437|3@1+ (1,0) [0|7] "" LOGGER
 SG_ AZIMUTH_EDGE_B_RAW : 440|13@1+ (1,0) [0|8191] "" LOGGER
 SG_ MOTION_CLASS_CANDIDATE_RAW : 465|3@1+ (1,0) [0|7] "" LOGGER
 SG_ ANGULAR_WIDTH_COARSE_CANDIDATE_RAW : 472|8@1+ (1,0) [0|255] "" LOGGER
 SG_ ANGULAR_WIDTH_480_RAW : 480|8@1+ (1,0) [0|255] "" LOGGER
 SG_ ANGULAR_WIDTH_COARSE_COPY_CANDIDATE_RAW : 488|8@1+ (1,0) [0|255] "" LOGGER
 SG_ DREL : 48|12@1+ (0.05,-4.296) [-4.296|200.454] "m" LOGGER
 SG_ YREL : 64|14@1+ (0.01,-81.91) [-81.91|81.92] "m" LOGGER
 SG_ VREL : 80|11@1+ (0.1,-154) [-154|50.7] "m/s" LOGGER
 SG_ LATERAL_VELOCITY : 96|10@1+ (0.1,-51.1) [-51.1|51.2] "m/s" LOGGER
 SG_ EXISTENCE_PROBABILITY : 121|6@1+ (2,0) [0|126] "%" LOGGER
 SG_ NORMALIZED_RATE : 128|16@1+ (0.001,-40) [-40|25.535] "1/s" LOGGER
 SG_ AZIMUTH_CENTER : 411|13@1+ (0.00025,-1.02375) [-1.02375|1.024] "" LOGGER
 SG_ AZIMUTH_EDGE_A : 424|13@1+ (0.00025,-1.02375) [-1.02375|1.024] "" LOGGER
 SG_ AZIMUTH_EDGE_B : 440|13@1+ (0.00025,-1.02375) [-1.02375|1.024] "" LOGGER
 SG_ TTC : 201|11@1+ (0.0078125,-8) [-8|7.9921875] "s" LOGGER

BO_ 110 BOSCH_C_OBJECT_06: 64 UNKNOWN
 SG_ CRC16_RAW : 0|16@1+ (1,0) [0|65535] "" LOGGER
 SG_ FRAME_COUNTER_RAW : 16|8@1+ (1,0) [0|255] "" LOGGER
 SG_ FRAME_PHASE_RAW : 24|4@1+ (1,0) [0|15] "" LOGGER
 SG_ OBJECT_ID_RAW : 32|8@1+ (1,0) [0|255] "" LOGGER
 SG_ POSITION_X_RAW : 48|12@1+ (1,0) [0|4095] "" LOGGER
 SG_ OBJECT_CLASS_RAW : 60|4@1+ (1,0) [0|15] "" LOGGER
 SG_ POSITION_Y_RAW : 64|14@1+ (1,0) [0|16383] "" LOGGER
 SG_ LIFE_STATE_CANDIDATE_RAW : 78|2@1+ (1,0) [0|3] "" LOGGER
 SG_ VELOCITY_RAW : 80|11@1+ (1,0) [0|2047] "" LOGGER
 SG_ LATERAL_VELOCITY_RAW : 96|10@1+ (1,0) [0|1023] "" LOGGER
 SG_ ENUM_106_CANDIDATE_RAW : 106|3@1+ (1,0) [0|7] "" LOGGER
 SG_ ENUM_109_CANDIDATE_RAW : 109|3@1+ (1,0) [0|7] "" LOGGER
 SG_ EXISTENCE_PROBABILITY_RAW : 121|6@1+ (1,0) [0|63] "" LOGGER
 SG_ NORMALIZED_RATE_RAW : 128|16@1+ (1,0) [0|65535] "" LOGGER
 SG_ QUALITY_CONTAINER_RAW : 144|10@1+ (1,0) [0|1023] "" LOGGER
 SG_ UNCERTAINTY_160_CANDIDATE_RAW : 160|10@1+ (1,0) [0|1023] "" LOGGER
 SG_ REL_VELOCITY_UNCERTAINTY_RAW : 176|10@1+ (1,0) [0|1023] "" LOGGER
 SG_ ACQUISITION_186_CANDIDATE_RAW : 186|6@1+ (1,0) [0|63] "" LOGGER
 SG_ UNCERTAINTY_192_CANDIDATE_RAW : 192|9@1+ (1,0) [0|511] "" LOGGER
 SG_ TTC_RAW : 201|11@1+ (1,0) [0|2047] "" LOGGER
 SG_ OBJECT_LENGTH_CANDIDATE_RAW : 217|9@1+ (1,0) [0|511] "" LOGGER
 SG_ FIELD_226_RAW : 226|9@1+ (1,0) [0|511] "" LOGGER
 SG_ TTC_SIGMA_CANDIDATE_RAW : 240|7@1+ (1,0) [0|127] "" LOGGER
 SG_ FIELD_248_RAW : 248|10@1+ (1,0) [0|1023] "" LOGGER
 SG_ WIDTH_FINE_258_CANDIDATE_RAW : 258|8@1+ (1,0) [0|255] "" LOGGER
 SG_ LIFECYCLE_RAW : 271|12@1+ (1,0) [0|4095] "" LOGGER
 SG_ NORMALIZED_CLOSING_SIGMA_RAW : 288|10@1+ (1,0) [0|1023] "" LOGGER
 SG_ AUX_LATERAL_MOTION_304_CANDIDATE_RAW : 304|17@1+ (1,0) [0|131071] "" LOGGER
 SG_ AUX_328_CANDIDATE_RAW : 328|14@1+ (1,0) [0|16383] "" LOGGER
 SG_ FIELD_344_RAW : 344|13@1+ (1,0) [0|8191] "" LOGGER
 SG_ FIELD_360_RAW : 360|8@1+ (1,0) [0|255] "" LOGGER
 SG_ FIELD_368_RAW : 368|10@1+ (1,0) [0|1023] "" LOGGER
 SG_ AUX2_378_CANDIDATE_RAW : 378|13@1+ (1,0) [0|8191] "" LOGGER
 SG_ FIELD_391_RAW : 391|7@1+ (1,0) [0|127] "" LOGGER
 SG_ MATURITY_398_CANDIDATE_RAW : 398|7@1+ (1,0) [0|127] "" LOGGER
 SG_ FIELD_405_RAW : 405|6@1+ (1,0) [0|63] "" LOGGER
 SG_ AZIMUTH_CENTER_RAW : 411|13@1+ (1,0) [0|8191] "" LOGGER
 SG_ AZIMUTH_EDGE_A_RAW : 424|13@1+ (1,0) [0|8191] "" LOGGER
 SG_ FIELD_437_RAW : 437|3@1+ (1,0) [0|7] "" LOGGER
 SG_ AZIMUTH_EDGE_B_RAW : 440|13@1+ (1,0) [0|8191] "" LOGGER
 SG_ MOTION_CLASS_CANDIDATE_RAW : 465|3@1+ (1,0) [0|7] "" LOGGER
 SG_ ANGULAR_WIDTH_COARSE_CANDIDATE_RAW : 472|8@1+ (1,0) [0|255] "" LOGGER
 SG_ ANGULAR_WIDTH_480_RAW : 480|8@1+ (1,0) [0|255] "" LOGGER
 SG_ ANGULAR_WIDTH_COARSE_COPY_CANDIDATE_RAW : 488|8@1+ (1,0) [0|255] "" LOGGER
 SG_ DREL : 48|12@1+ (0.05,-4.296) [-4.296|200.454] "m" LOGGER
 SG_ YREL : 64|14@1+ (0.01,-81.91) [-81.91|81.92] "m" LOGGER
 SG_ VREL : 80|11@1+ (0.1,-154) [-154|50.7] "m/s" LOGGER
 SG_ LATERAL_VELOCITY : 96|10@1+ (0.1,-51.1) [-51.1|51.2] "m/s" LOGGER
 SG_ EXISTENCE_PROBABILITY : 121|6@1+ (2,0) [0|126] "%" LOGGER
 SG_ NORMALIZED_RATE : 128|16@1+ (0.001,-40) [-40|25.535] "1/s" LOGGER
 SG_ AZIMUTH_CENTER : 411|13@1+ (0.00025,-1.02375) [-1.02375|1.024] "" LOGGER
 SG_ AZIMUTH_EDGE_A : 424|13@1+ (0.00025,-1.02375) [-1.02375|1.024] "" LOGGER
 SG_ AZIMUTH_EDGE_B : 440|13@1+ (0.00025,-1.02375) [-1.02375|1.024] "" LOGGER
 SG_ TTC : 201|11@1+ (0.0078125,-8) [-8|7.9921875] "s" LOGGER

BO_ 112 BOSCH_C_OBJECT_07: 64 UNKNOWN
 SG_ CRC16_RAW : 0|16@1+ (1,0) [0|65535] "" LOGGER
 SG_ FRAME_COUNTER_RAW : 16|8@1+ (1,0) [0|255] "" LOGGER
 SG_ FRAME_PHASE_RAW : 24|4@1+ (1,0) [0|15] "" LOGGER
 SG_ OBJECT_ID_RAW : 32|8@1+ (1,0) [0|255] "" LOGGER
 SG_ POSITION_X_RAW : 48|12@1+ (1,0) [0|4095] "" LOGGER
 SG_ OBJECT_CLASS_RAW : 60|4@1+ (1,0) [0|15] "" LOGGER
 SG_ POSITION_Y_RAW : 64|14@1+ (1,0) [0|16383] "" LOGGER
 SG_ LIFE_STATE_CANDIDATE_RAW : 78|2@1+ (1,0) [0|3] "" LOGGER
 SG_ VELOCITY_RAW : 80|11@1+ (1,0) [0|2047] "" LOGGER
 SG_ LATERAL_VELOCITY_RAW : 96|10@1+ (1,0) [0|1023] "" LOGGER
 SG_ ENUM_106_CANDIDATE_RAW : 106|3@1+ (1,0) [0|7] "" LOGGER
 SG_ ENUM_109_CANDIDATE_RAW : 109|3@1+ (1,0) [0|7] "" LOGGER
 SG_ EXISTENCE_PROBABILITY_RAW : 121|6@1+ (1,0) [0|63] "" LOGGER
 SG_ NORMALIZED_RATE_RAW : 128|16@1+ (1,0) [0|65535] "" LOGGER
 SG_ QUALITY_CONTAINER_RAW : 144|10@1+ (1,0) [0|1023] "" LOGGER
 SG_ UNCERTAINTY_160_CANDIDATE_RAW : 160|10@1+ (1,0) [0|1023] "" LOGGER
 SG_ REL_VELOCITY_UNCERTAINTY_RAW : 176|10@1+ (1,0) [0|1023] "" LOGGER
 SG_ ACQUISITION_186_CANDIDATE_RAW : 186|6@1+ (1,0) [0|63] "" LOGGER
 SG_ UNCERTAINTY_192_CANDIDATE_RAW : 192|9@1+ (1,0) [0|511] "" LOGGER
 SG_ TTC_RAW : 201|11@1+ (1,0) [0|2047] "" LOGGER
 SG_ OBJECT_LENGTH_CANDIDATE_RAW : 217|9@1+ (1,0) [0|511] "" LOGGER
 SG_ FIELD_226_RAW : 226|9@1+ (1,0) [0|511] "" LOGGER
 SG_ TTC_SIGMA_CANDIDATE_RAW : 240|7@1+ (1,0) [0|127] "" LOGGER
 SG_ FIELD_248_RAW : 248|10@1+ (1,0) [0|1023] "" LOGGER
 SG_ WIDTH_FINE_258_CANDIDATE_RAW : 258|8@1+ (1,0) [0|255] "" LOGGER
 SG_ LIFECYCLE_RAW : 271|12@1+ (1,0) [0|4095] "" LOGGER
 SG_ NORMALIZED_CLOSING_SIGMA_RAW : 288|10@1+ (1,0) [0|1023] "" LOGGER
 SG_ AUX_LATERAL_MOTION_304_CANDIDATE_RAW : 304|17@1+ (1,0) [0|131071] "" LOGGER
 SG_ AUX_328_CANDIDATE_RAW : 328|14@1+ (1,0) [0|16383] "" LOGGER
 SG_ FIELD_344_RAW : 344|13@1+ (1,0) [0|8191] "" LOGGER
 SG_ FIELD_360_RAW : 360|8@1+ (1,0) [0|255] "" LOGGER
 SG_ FIELD_368_RAW : 368|10@1+ (1,0) [0|1023] "" LOGGER
 SG_ AUX2_378_CANDIDATE_RAW : 378|13@1+ (1,0) [0|8191] "" LOGGER
 SG_ FIELD_391_RAW : 391|7@1+ (1,0) [0|127] "" LOGGER
 SG_ MATURITY_398_CANDIDATE_RAW : 398|7@1+ (1,0) [0|127] "" LOGGER
 SG_ FIELD_405_RAW : 405|6@1+ (1,0) [0|63] "" LOGGER
 SG_ AZIMUTH_CENTER_RAW : 411|13@1+ (1,0) [0|8191] "" LOGGER
 SG_ AZIMUTH_EDGE_A_RAW : 424|13@1+ (1,0) [0|8191] "" LOGGER
 SG_ FIELD_437_RAW : 437|3@1+ (1,0) [0|7] "" LOGGER
 SG_ AZIMUTH_EDGE_B_RAW : 440|13@1+ (1,0) [0|8191] "" LOGGER
 SG_ MOTION_CLASS_CANDIDATE_RAW : 465|3@1+ (1,0) [0|7] "" LOGGER
 SG_ ANGULAR_WIDTH_COARSE_CANDIDATE_RAW : 472|8@1+ (1,0) [0|255] "" LOGGER
 SG_ ANGULAR_WIDTH_480_RAW : 480|8@1+ (1,0) [0|255] "" LOGGER
 SG_ ANGULAR_WIDTH_COARSE_COPY_CANDIDATE_RAW : 488|8@1+ (1,0) [0|255] "" LOGGER
 SG_ DREL : 48|12@1+ (0.05,-4.296) [-4.296|200.454] "m" LOGGER
 SG_ YREL : 64|14@1+ (0.01,-81.91) [-81.91|81.92] "m" LOGGER
 SG_ VREL : 80|11@1+ (0.1,-154) [-154|50.7] "m/s" LOGGER
 SG_ LATERAL_VELOCITY : 96|10@1+ (0.1,-51.1) [-51.1|51.2] "m/s" LOGGER
 SG_ EXISTENCE_PROBABILITY : 121|6@1+ (2,0) [0|126] "%" LOGGER
 SG_ NORMALIZED_RATE : 128|16@1+ (0.001,-40) [-40|25.535] "1/s" LOGGER
 SG_ AZIMUTH_CENTER : 411|13@1+ (0.00025,-1.02375) [-1.02375|1.024] "" LOGGER
 SG_ AZIMUTH_EDGE_A : 424|13@1+ (0.00025,-1.02375) [-1.02375|1.024] "" LOGGER
 SG_ AZIMUTH_EDGE_B : 440|13@1+ (0.00025,-1.02375) [-1.02375|1.024] "" LOGGER
 SG_ TTC : 201|11@1+ (0.0078125,-8) [-8|7.9921875] "s" LOGGER

CM_ "Receive-only schema for analysis tools. The object bank (0x62-0x80) is sent by the stock camera to the radar on the private bus: the radar firmware (8S302-3A0-A230 and -A070) receives these IDs and transmits none of them. Field boundaries are the radar firmware's own receive table; scaled signals are the accepted conversions, with the firmware's scales and zeros. *_CANDIDATE_RAW names are unaccepted research hypotheses whose status is in each comment; FIELD_<bit>_RAW fields are defined by the firmware with no hypothesis yet. The runtime adapter (opendbc/car/honda/bosch_c_radar.py) decodes these bits itself because it verifies the CRC and 16-message bank coherence.";
BA_DEF_ BO_ "VFrameFormat" ENUM "StandardCAN","ExtendedCAN","reserved","J1939PG","reserved","reserved","reserved","reserved","reserved","reserved","reserved","reserved","reserved","reserved","StandardCAN_FD","ExtendedCAN_FD";
BA_ "VFrameFormat" BO_ 98 14;
CM_ SG_ 98 CRC16_RAW "Capture-verified CRC16: polynomial 0x1021, init 0xFFFF, no reflection or xorout; bytes 2:64 then little-endian data ID 0x0fab. The radar firmware's E2E receive configuration holds data IDs 0x0FAB-0x0FBA.";
CM_ SG_ 98 OBJECT_ID_RAW "Bits 32-39 (radar firmware; 40-47 are unused and never set). Observed 0 empty, 1 through 63 active. IDs move between wire slots and are reused.";
CM_ SG_ 98 LIFECYCLE_RAW "Observed +3 modulo 4096 per consecutive sweep for continuing IDs. Resets or discontinuities require a new track. Not read by the radar firmware.";
CM_ SG_ 98 FRAME_PHASE_RAW "Radar firmware: raw, valid below 16.";
CM_ SG_ 98 POSITION_X_RAW "Radar firmware: 0.05*raw m, valid below 4096, no offset (in the sender's frame). Unsigned 12-bit, bits 48-59; bit 60 belongs to OBJECT_CLASS_RAW. Working decode dRel = 0.05*raw-4.296 m (accepted): the -4.296 m is our measured offset to the bumper reference, not part of the encoding. The stock dash draws HUD_OBJECTS LONG_DIST from raw/4. Normalized closing and azimuth both imply a sensor range origin about 2.3 m behind the dRel origin, which fits the windshield camera that sends this bank.";
CM_ SG_ 98 OBJECT_CLASS_RAW "Object class, bits 60-63. Radar firmware: raw, valid below 16; it names no values. 1 car and 3 truck/large vehicle: accepted against the stock dash HUD_OBJECTS icons on held-out routes (99.6% and 99.2%). 6, 7 and 8 are not motorcycle, pedestrian and bicycle as such: against video within 25 m they name that object on 1 of 11, 3 of 13 and 3 of 12 clear labels, and are most often a car (2026-09-29). The stock dash shows icon 6 for moving two-wheelers, so its motorcycle icon adds a filter on top of class 6. 9-11 unconfirmed. Classes 1 and 3 never share a track with classes 6-11.";
CM_ SG_ 98 POSITION_Y_RAW "Lateral position, 14-bit offset binary, positive left. Radar firmware: 0.01*raw-81.91 m, zero at 8191 (also its initial value), valid below 16384. Until 2026-10-02 production used zero 8192 (1 cm right). The 0.01 m scale and 14-bit extent were accepted on held-out routes before the firmware confirmed them. A 13-bit read wraps past +-40.95 m.";
CM_ SG_ 98 LIFE_STATE_CANDIDATE_RAW "Radar firmware: a separate 2-bit field, raw, valid below 4. Life state 0 newborn, 1 established, 2 ending (2 on 6-26% of a track last three frames vs 0.1-4% mid-life, ten recordings). Shares: 0 9.6%, 1 88.1%, 2 2.3%; 3 never seen.";
CM_ SG_ 98 VELOCITY_RAW "Relative velocity. Radar firmware: 0.1*raw-154.0 m/s, zero at 1540 (also its initial value), valid below 2048; the MY22 firmware (A070) reads it the same way. Production used zero 1539 (+0.1 m/s) until 2026-10-02. Stationary objects read about -0.3 m/s against vEgo with 1539 and -0.4 m/s with 1540, which points at the wheel-speed reference rather than the encoding. Raw 0 (-154 m/s) is a floor saturation on newborn far objects, not a sentinel.";
CM_ SG_ 98 LATERAL_VELOCITY_RAW "Lateral velocity, positive left, relative in the sensor frame (includes the apparent motion of stationary objects from ego yaw). Radar firmware: 0.1*raw-51.1 m/s, zero at 511 (also its initial value), valid below 1024. Accepted 2026-10-02: the research decode 0.1*(raw-511) was provisional only because one held-out scale bracket (0.1004-0.1085) missed 0.1; the firmware settles the scale.";
CM_ SG_ 98 ENUM_106_CANDIDATE_RAW "Radar firmware: one 3-bit field, raw, valid below 5 (formerly read as flags at bits 106 and 107). Shares: 0 14.6%, 1 83.8%, 2 1.0%, 3 0.7%, 4 under 0.1%. Bit 106 (odd values) is set on about 40% of newborn frames and 97-99% after 1 s and agrees with LIFE_STATE 1 on 96%; bit 107 (values 2-3) is mostly on mature same-direction movers. Meaning unresolved.";
CM_ SG_ 98 ENUM_109_CANDIDATE_RAW "Not read by the radar firmware. Values 0-4. 1 on most established tracks; 2-4 mostly on same-direction movers near the path with high existence. Not an object class (metric width about 1.7 m for all values) and not a left/right lane code. Meaning unresolved.";
CM_ SG_ 98 EXISTENCE_PROBABILITY_RAW "Bosch A OBJECT_EXISTENCE_PROBABILITY counterpart (accepted). Radar firmware: 2*raw percent, valid below 51 (100%); observed 0-49, 49 most common. Best survival predictor within range x age strata on ten recordings (AUC 0.67-0.92); falls over the last second before track death; low on short-lived ghosts. 0 marks a degraded measurement (accepted on held-out routes: range innovation and vRel steps at least 2x worse on 17 of 17).";
CM_ SG_ 98 NORMALIZED_RATE_RAW "Bosch A NORMALIZED_CLOSING counterpart. Radar firmware: 0.001*raw-40 (1/s), valid below 65001. Accepted 2026-10-02: the research decode 0.001*(raw-40000) 1/s matches the firmware exactly; approximately vRel/(dRel+2.3 m) and follows Doppler vRel, not range change. 64999 marks invalid in the data (TTC 0, TTC sigma 0 and normalized-closing sigma 0 in the same frame), though the firmware getter accepts it.";
CM_ SG_ 98 QUALITY_CONTAINER_RAW "Bits 144-153 (radar firmware; 154-159 are unused and never set). Radar firmware: 0.05*raw, valid below 1024; the 0.05 step equals the range resolution. Bosch A RANGE_SIGMA candidate (provisional): range-noise specific on 8 of 10 recordings, weak (partial rho 0.08-0.25). Strongly range dependent. Unit unnamed.";
CM_ SG_ 98 REL_VELOCITY_UNCERTAINTY_RAW "Bosch A REL_VELOCITY_UNCERTAINTY counterpart (accepted, raw units): velocity-noise specific and monotonic with empirical vRel noise on ten recordings. Radar firmware: 0.1*raw, valid below 1024, unit unnamed. Nonlinear against our measured vRel noise (the adapter maps it empirically).";
CM_ SG_ 98 UNCERTAINTY_160_CANDIDATE_RAW "Radar firmware: 10 bits, 0.02*raw, valid below 1024. Mostly 1-2; higher on young and laterally offset objects. Weak noise association. Unit unnamed.";
CM_ SG_ 98 ACQUISITION_186_CANDIDATE_RAW "Radar firmware: 6 bits, 0.01*raw, valid below 64. Starts near 23 on newborn tracks and decays to about 2. Carries little information beyond track age.";
CM_ SG_ 98 UNCERTAINTY_192_CANDIDATE_RAW "Radar firmware: 9 bits, 0.1*raw, valid below 512. Decays with age; mixed velocity and lateral noise association, not specific to one noise. Unit unnamed.";
CM_ SG_ 98 TTC_RAW "Time to collision (accepted 2026-09-28 on held-out routes), (raw-1024)/128 s: a constant-velocity TTC, equal to -1/normalized closing within 0.06-0.10 s median. Reported only while an acceleration-aware collision prediction expects impact (lagging it by about 1-2 s); otherwise 2046. 0 = invalid (normalized closing 64999). Not read by the radar firmware, so the scale rests on captures. No Bosch A counterpart.";
CM_ SG_ 98 OBJECT_LENGTH_CANDIDATE_RAW "Object length, provisional (docs/object-length-217.md). Radar firmware: 0.05*raw m, valid below 512. Median 4.25 m for class 1 and 8.7-8.9 m for class 3; 0 for classes 6-8 on 92%; stable within a track (per-track std 0.09 m). A coarse estimate near a per-class default: a 4.8 m Mustang read 4.25 m. Held-out round 2026-10-02: L1, L3, L4 pass, L2 fails (class 3 is under 1.6x class 1 on 8 of 39 routes, where class 3 reads 3.6-6.6 m). X does not refer to the object center: no length term is needed in dRel.";
CM_ SG_ 98 FIELD_226_RAW "Radar firmware: 0.01*raw-1.57, valid below 316 (+-1.57, so likely an angle in rad); initial value 157 (0). Near 0 on moving objects (p5-p95 about +-0.15), spread over +-1.5 on stationary ones. Not the heading from motion: r -0.19 to +0.07 with the sign varying by route (docs/object-length-217.md). Meaning unknown.";
CM_ SG_ 98 TTC_SIGMA_CANDIDATE_RAW "TTC uncertainty (provisional): raw = TTC^2 * NORMALIZED_CLOSING_SIGMA / 64 within 0.1-2.5% on ten recordings. 127 = saturated or not populated; 0 = invalid. Stays populated on 3-26% of frames where TTC is defaulted (TTC about 8-19 s). Not read by the radar firmware.";
CM_ SG_ 98 FIELD_248_RAW "Not read by the radar firmware. Median raw 172. Meaning unknown.";
CM_ SG_ 98 WIDTH_FINE_258_CANDIDATE_RAW "Radar firmware: 8 bits, 0.0002*raw, no range check; stored next to AZIMUTH_CENTER, like the 0.0002 widths stored next to each edge. Values above 63 on 1.7% of frames. Angular extent measure, about 1/range within a track.";
CM_ SG_ 98 NORMALIZED_CLOSING_SIGMA_RAW "Bosch A NORMALIZED_CLOSING_SIGMA counterpart (accepted): specific to normalized-closing noise and monotonic with it on ten recordings; tied to TTC_SIGMA by a fixed 1/64 ratio. 0 when normalized closing is invalid. Radar firmware: 10 bits, 0.001*raw, valid below 1024, the same step as NORMALIZED_RATE. Values above 511 on 0.6% of frames, which the earlier 9-bit read truncated.";
CM_ SG_ 98 AUX_LATERAL_MOTION_304_CANDIDATE_RAW "Radar firmware: one 17-bit offset-binary field, raw*80/2^17-40, valid below 131072 (formerly read as signed 16 bits at 304 plus a direction bit at 320). Bit 320 is its sign: set on 49.7% of frames, which is why it agreed with the 16-bit value being nonnegative. Its scale (0.00061 per count) is far below the earlier 0.005-0.12 m/s bracket, so it is probably not a lateral speed in m/s; with the firmware decode it does not follow the azimuth rate, dY/dt, lateral velocity or its rate either (r < 0.08; docs/object-length-217.md). About 0 when normalized closing is invalid.";
CM_ SG_ 98 AUX_328_CANDIDATE_RAW "Radar firmware: 14 bits, 0.00002*raw, valid below 12501 (0-0.25). Changes nearly every frame; weak association with lateral and angular noise, not specific to one. 0 when normalized closing is invalid. Meaning unresolved.";
CM_ SG_ 98 FIELD_344_RAW "Radar firmware: 0.002*raw-10, valid below 8001 (+-10). Raw 5000 (0) on 68% of frames. Not acceleration: on lead-like objects its 90th-percentile magnitude is 0.04-0.12 against 0.55-1.83 m/s^2 of lead acceleration, r <= 0.2 (docs/object-length-217.md). Meaning unknown.";
CM_ SG_ 98 FIELD_360_RAW "Not read by the A230 radar firmware; the MY22 firmware (A070) defines 362:6 here instead. Median raw 48. Meaning unknown.";
CM_ SG_ 98 FIELD_368_RAW "Radar firmware: 0.0025*raw, valid below 1024. Raw 1 on 64% of frames. Meaning unknown.";
CM_ SG_ 98 AUX2_378_CANDIDATE_RAW "Radar firmware: same encoding as the azimuth fields, 0.00025*raw-1.02375, valid below 8192 (initial value 4095), and the radar passes it through atan like the edges: a tangent. Not signed 13-bit: with this decode its sign matches the azimuth on 98-99% of populated frames (routes 171, 17b, 19d), against 1-2% for a signed read. Shares one subrecord with ANGULAR_WIDTH_480: both hold their defaults together (8190 here; bits 480-487 zero) on about two thirds of observations. The MY22 firmware has no getter for it.";
CM_ SG_ 98 FIELD_391_RAW "Radar firmware: 0.05*raw, valid below 128. Scales with class: median 0.7 for class 1, 1.5 for class 3, 0 for classes 6-8; constant with age and range. Weakly related to how much OBJECT_LENGTH varies within a track (Spearman 0.19). Meaning unknown.";
CM_ SG_ 98 MATURITY_398_CANDIDATE_RAW "Radar firmware: one 7-bit field; not read. Values above 15 on 9.2% of frames. Counts down from about 6 to 1 as a track matures. Adds no velocity-error or survival information once track age is known.";
CM_ SG_ 98 FIELD_405_RAW "Not read by the radar firmware. Raw 49 on 82% of frames. Meaning unknown.";
CM_ SG_ 98 AZIMUTH_CENTER_RAW "Radar firmware: 0.00025*raw-1.02375 (zero at 4095), valid below 8192; unlike the edges, the radar does not pass it through atan here. Positive left. Equals the midpoint of the two edge fields on 97-99.9% of observations, so it is the same quantity as the edges: a tangent. The earlier 2^-12 rad per count, zero 4096, was 2.4% small.";
CM_ SG_ 98 AZIMUTH_EDGE_A_RAW "Left angular edge; same encoding as AZIMUTH_CENTER. The radar firmware passes it through atan, so it is the tangent of the angle: tan +-1.024 is about +-45.7 deg. Always at or left of the center. Clips at 8191.";
CM_ SG_ 98 FIELD_437_RAW "Radar firmware: raw, valid below 5. Shares: 1 55.5%, 2 9.3%, 3 35.0%, 4 0.3%. Meaning unknown.";
CM_ SG_ 98 AZIMUTH_EDGE_B_RAW "Right angular edge; same encoding as AZIMUTH_CENTER, passed through atan by the radar firmware (a tangent). Clips at 0 for near objects at the field-of-view edge. The edge difference is the Bosch A ANGULAR_WIDTH counterpart: it scales as 1/range within a track (log-log slope -0.91 to -0.99, ten recordings).";
CM_ SG_ 98 MOTION_CLASS_CANDIDATE_RAW "Radar firmware: bits 465-467, raw, valid below 5 (bit 464 is unused and never set). Values 0 78.6%, 1 4.0%, 2 17.4% (read as 0, 2, 4 before 2026-10-02). 2: same-direction traffic, and most objects seen only while ego is stopped. 1: oncoming or approaching, and most stationary objects seen while ego moves. 0: unassigned; young tracks, and every object on the 2026-09-10 and 2026-09-16 drives. Not a validated classifier.";
CM_ SG_ 98 ANGULAR_WIDTH_COARSE_CANDIDATE_RAW "Radar firmware: 0.0002*raw, no range check; stored next to AZIMUTH_EDGE_A. Angular extent measure, about 1/range within a track. Not a fixed-scale copy of the edge width (forward vs inverse fits 6-21 vs 14-24 edge counts per unit). Not received power.";
CM_ SG_ 98 ANGULAR_WIDTH_480_RAW "Angular-width measure (accepted 2026-09-29 on held-out routes): follows the azimuth-edge width (Spearman >= 0.8) and scales as about 1/range within tracks on 57 of 60 routes. Radar firmware: 0.0002*raw, no range check; stored next to AUX2_378. 0 while AUX2_378 holds its default.";
CM_ SG_ 98 ANGULAR_WIDTH_COARSE_COPY_CANDIDATE_RAW "Radar firmware: 0.0002*raw, no range check; stored next to AZIMUTH_EDGE_B. Byte 61 equals byte 59 on 99.7-100% of observations.";
BA_ "VFrameFormat" BO_ 100 14;
CM_ SG_ 100 CRC16_RAW "Capture-verified CRC16: polynomial 0x1021, init 0xFFFF, no reflection or xorout; bytes 2:64 then little-endian data ID 0x0fac. The radar firmware's E2E receive configuration holds data IDs 0x0FAB-0x0FBA.";
CM_ SG_ 100 OBJECT_ID_RAW "Bits 32-39 (radar firmware; 40-47 are unused and never set). Observed 0 empty, 1 through 63 active. IDs move between wire slots and are reused.";
CM_ SG_ 100 LIFECYCLE_RAW "Observed +3 modulo 4096 per consecutive sweep for continuing IDs. Resets or discontinuities require a new track. Not read by the radar firmware.";
CM_ SG_ 100 FRAME_PHASE_RAW "Radar firmware: raw, valid below 16.";
CM_ SG_ 100 POSITION_X_RAW "Radar firmware: 0.05*raw m, valid below 4096, no offset (in the sender's frame). Unsigned 12-bit, bits 48-59; bit 60 belongs to OBJECT_CLASS_RAW. Working decode dRel = 0.05*raw-4.296 m (accepted): the -4.296 m is our measured offset to the bumper reference, not part of the encoding. The stock dash draws HUD_OBJECTS LONG_DIST from raw/4. Normalized closing and azimuth both imply a sensor range origin about 2.3 m behind the dRel origin, which fits the windshield camera that sends this bank.";
CM_ SG_ 100 OBJECT_CLASS_RAW "Object class, bits 60-63. Radar firmware: raw, valid below 16; it names no values. 1 car and 3 truck/large vehicle: accepted against the stock dash HUD_OBJECTS icons on held-out routes (99.6% and 99.2%). 6, 7 and 8 are not motorcycle, pedestrian and bicycle as such: against video within 25 m they name that object on 1 of 11, 3 of 13 and 3 of 12 clear labels, and are most often a car (2026-09-29). The stock dash shows icon 6 for moving two-wheelers, so its motorcycle icon adds a filter on top of class 6. 9-11 unconfirmed. Classes 1 and 3 never share a track with classes 6-11.";
CM_ SG_ 100 POSITION_Y_RAW "Lateral position, 14-bit offset binary, positive left. Radar firmware: 0.01*raw-81.91 m, zero at 8191 (also its initial value), valid below 16384. Until 2026-10-02 production used zero 8192 (1 cm right). The 0.01 m scale and 14-bit extent were accepted on held-out routes before the firmware confirmed them. A 13-bit read wraps past +-40.95 m.";
CM_ SG_ 100 LIFE_STATE_CANDIDATE_RAW "Radar firmware: a separate 2-bit field, raw, valid below 4. Life state 0 newborn, 1 established, 2 ending (2 on 6-26% of a track last three frames vs 0.1-4% mid-life, ten recordings). Shares: 0 9.6%, 1 88.1%, 2 2.3%; 3 never seen.";
CM_ SG_ 100 VELOCITY_RAW "Relative velocity. Radar firmware: 0.1*raw-154.0 m/s, zero at 1540 (also its initial value), valid below 2048; the MY22 firmware (A070) reads it the same way. Production used zero 1539 (+0.1 m/s) until 2026-10-02. Stationary objects read about -0.3 m/s against vEgo with 1539 and -0.4 m/s with 1540, which points at the wheel-speed reference rather than the encoding. Raw 0 (-154 m/s) is a floor saturation on newborn far objects, not a sentinel.";
CM_ SG_ 100 LATERAL_VELOCITY_RAW "Lateral velocity, positive left, relative in the sensor frame (includes the apparent motion of stationary objects from ego yaw). Radar firmware: 0.1*raw-51.1 m/s, zero at 511 (also its initial value), valid below 1024. Accepted 2026-10-02: the research decode 0.1*(raw-511) was provisional only because one held-out scale bracket (0.1004-0.1085) missed 0.1; the firmware settles the scale.";
CM_ SG_ 100 ENUM_106_CANDIDATE_RAW "Radar firmware: one 3-bit field, raw, valid below 5 (formerly read as flags at bits 106 and 107). Shares: 0 14.6%, 1 83.8%, 2 1.0%, 3 0.7%, 4 under 0.1%. Bit 106 (odd values) is set on about 40% of newborn frames and 97-99% after 1 s and agrees with LIFE_STATE 1 on 96%; bit 107 (values 2-3) is mostly on mature same-direction movers. Meaning unresolved.";
CM_ SG_ 100 ENUM_109_CANDIDATE_RAW "Not read by the radar firmware. Values 0-4. 1 on most established tracks; 2-4 mostly on same-direction movers near the path with high existence. Not an object class (metric width about 1.7 m for all values) and not a left/right lane code. Meaning unresolved.";
CM_ SG_ 100 EXISTENCE_PROBABILITY_RAW "Bosch A OBJECT_EXISTENCE_PROBABILITY counterpart (accepted). Radar firmware: 2*raw percent, valid below 51 (100%); observed 0-49, 49 most common. Best survival predictor within range x age strata on ten recordings (AUC 0.67-0.92); falls over the last second before track death; low on short-lived ghosts. 0 marks a degraded measurement (accepted on held-out routes: range innovation and vRel steps at least 2x worse on 17 of 17).";
CM_ SG_ 100 NORMALIZED_RATE_RAW "Bosch A NORMALIZED_CLOSING counterpart. Radar firmware: 0.001*raw-40 (1/s), valid below 65001. Accepted 2026-10-02: the research decode 0.001*(raw-40000) 1/s matches the firmware exactly; approximately vRel/(dRel+2.3 m) and follows Doppler vRel, not range change. 64999 marks invalid in the data (TTC 0, TTC sigma 0 and normalized-closing sigma 0 in the same frame), though the firmware getter accepts it.";
CM_ SG_ 100 QUALITY_CONTAINER_RAW "Bits 144-153 (radar firmware; 154-159 are unused and never set). Radar firmware: 0.05*raw, valid below 1024; the 0.05 step equals the range resolution. Bosch A RANGE_SIGMA candidate (provisional): range-noise specific on 8 of 10 recordings, weak (partial rho 0.08-0.25). Strongly range dependent. Unit unnamed.";
CM_ SG_ 100 REL_VELOCITY_UNCERTAINTY_RAW "Bosch A REL_VELOCITY_UNCERTAINTY counterpart (accepted, raw units): velocity-noise specific and monotonic with empirical vRel noise on ten recordings. Radar firmware: 0.1*raw, valid below 1024, unit unnamed. Nonlinear against our measured vRel noise (the adapter maps it empirically).";
CM_ SG_ 100 UNCERTAINTY_160_CANDIDATE_RAW "Radar firmware: 10 bits, 0.02*raw, valid below 1024. Mostly 1-2; higher on young and laterally offset objects. Weak noise association. Unit unnamed.";
CM_ SG_ 100 ACQUISITION_186_CANDIDATE_RAW "Radar firmware: 6 bits, 0.01*raw, valid below 64. Starts near 23 on newborn tracks and decays to about 2. Carries little information beyond track age.";
CM_ SG_ 100 UNCERTAINTY_192_CANDIDATE_RAW "Radar firmware: 9 bits, 0.1*raw, valid below 512. Decays with age; mixed velocity and lateral noise association, not specific to one noise. Unit unnamed.";
CM_ SG_ 100 TTC_RAW "Time to collision (accepted 2026-09-28 on held-out routes), (raw-1024)/128 s: a constant-velocity TTC, equal to -1/normalized closing within 0.06-0.10 s median. Reported only while an acceleration-aware collision prediction expects impact (lagging it by about 1-2 s); otherwise 2046. 0 = invalid (normalized closing 64999). Not read by the radar firmware, so the scale rests on captures. No Bosch A counterpart.";
CM_ SG_ 100 OBJECT_LENGTH_CANDIDATE_RAW "Object length, provisional (docs/object-length-217.md). Radar firmware: 0.05*raw m, valid below 512. Median 4.25 m for class 1 and 8.7-8.9 m for class 3; 0 for classes 6-8 on 92%; stable within a track (per-track std 0.09 m). A coarse estimate near a per-class default: a 4.8 m Mustang read 4.25 m. Held-out round 2026-10-02: L1, L3, L4 pass, L2 fails (class 3 is under 1.6x class 1 on 8 of 39 routes, where class 3 reads 3.6-6.6 m). X does not refer to the object center: no length term is needed in dRel.";
CM_ SG_ 100 FIELD_226_RAW "Radar firmware: 0.01*raw-1.57, valid below 316 (+-1.57, so likely an angle in rad); initial value 157 (0). Near 0 on moving objects (p5-p95 about +-0.15), spread over +-1.5 on stationary ones. Not the heading from motion: r -0.19 to +0.07 with the sign varying by route (docs/object-length-217.md). Meaning unknown.";
CM_ SG_ 100 TTC_SIGMA_CANDIDATE_RAW "TTC uncertainty (provisional): raw = TTC^2 * NORMALIZED_CLOSING_SIGMA / 64 within 0.1-2.5% on ten recordings. 127 = saturated or not populated; 0 = invalid. Stays populated on 3-26% of frames where TTC is defaulted (TTC about 8-19 s). Not read by the radar firmware.";
CM_ SG_ 100 FIELD_248_RAW "Not read by the radar firmware. Median raw 172. Meaning unknown.";
CM_ SG_ 100 WIDTH_FINE_258_CANDIDATE_RAW "Radar firmware: 8 bits, 0.0002*raw, no range check; stored next to AZIMUTH_CENTER, like the 0.0002 widths stored next to each edge. Values above 63 on 1.7% of frames. Angular extent measure, about 1/range within a track.";
CM_ SG_ 100 NORMALIZED_CLOSING_SIGMA_RAW "Bosch A NORMALIZED_CLOSING_SIGMA counterpart (accepted): specific to normalized-closing noise and monotonic with it on ten recordings; tied to TTC_SIGMA by a fixed 1/64 ratio. 0 when normalized closing is invalid. Radar firmware: 10 bits, 0.001*raw, valid below 1024, the same step as NORMALIZED_RATE. Values above 511 on 0.6% of frames, which the earlier 9-bit read truncated.";
CM_ SG_ 100 AUX_LATERAL_MOTION_304_CANDIDATE_RAW "Radar firmware: one 17-bit offset-binary field, raw*80/2^17-40, valid below 131072 (formerly read as signed 16 bits at 304 plus a direction bit at 320). Bit 320 is its sign: set on 49.7% of frames, which is why it agreed with the 16-bit value being nonnegative. Its scale (0.00061 per count) is far below the earlier 0.005-0.12 m/s bracket, so it is probably not a lateral speed in m/s; with the firmware decode it does not follow the azimuth rate, dY/dt, lateral velocity or its rate either (r < 0.08; docs/object-length-217.md). About 0 when normalized closing is invalid.";
CM_ SG_ 100 AUX_328_CANDIDATE_RAW "Radar firmware: 14 bits, 0.00002*raw, valid below 12501 (0-0.25). Changes nearly every frame; weak association with lateral and angular noise, not specific to one. 0 when normalized closing is invalid. Meaning unresolved.";
CM_ SG_ 100 FIELD_344_RAW "Radar firmware: 0.002*raw-10, valid below 8001 (+-10). Raw 5000 (0) on 68% of frames. Not acceleration: on lead-like objects its 90th-percentile magnitude is 0.04-0.12 against 0.55-1.83 m/s^2 of lead acceleration, r <= 0.2 (docs/object-length-217.md). Meaning unknown.";
CM_ SG_ 100 FIELD_360_RAW "Not read by the A230 radar firmware; the MY22 firmware (A070) defines 362:6 here instead. Median raw 48. Meaning unknown.";
CM_ SG_ 100 FIELD_368_RAW "Radar firmware: 0.0025*raw, valid below 1024. Raw 1 on 64% of frames. Meaning unknown.";
CM_ SG_ 100 AUX2_378_CANDIDATE_RAW "Radar firmware: same encoding as the azimuth fields, 0.00025*raw-1.02375, valid below 8192 (initial value 4095), and the radar passes it through atan like the edges: a tangent. Not signed 13-bit: with this decode its sign matches the azimuth on 98-99% of populated frames (routes 171, 17b, 19d), against 1-2% for a signed read. Shares one subrecord with ANGULAR_WIDTH_480: both hold their defaults together (8190 here; bits 480-487 zero) on about two thirds of observations. The MY22 firmware has no getter for it.";
CM_ SG_ 100 FIELD_391_RAW "Radar firmware: 0.05*raw, valid below 128. Scales with class: median 0.7 for class 1, 1.5 for class 3, 0 for classes 6-8; constant with age and range. Weakly related to how much OBJECT_LENGTH varies within a track (Spearman 0.19). Meaning unknown.";
CM_ SG_ 100 MATURITY_398_CANDIDATE_RAW "Radar firmware: one 7-bit field; not read. Values above 15 on 9.2% of frames. Counts down from about 6 to 1 as a track matures. Adds no velocity-error or survival information once track age is known.";
CM_ SG_ 100 FIELD_405_RAW "Not read by the radar firmware. Raw 49 on 82% of frames. Meaning unknown.";
CM_ SG_ 100 AZIMUTH_CENTER_RAW "Radar firmware: 0.00025*raw-1.02375 (zero at 4095), valid below 8192; unlike the edges, the radar does not pass it through atan here. Positive left. Equals the midpoint of the two edge fields on 97-99.9% of observations, so it is the same quantity as the edges: a tangent. The earlier 2^-12 rad per count, zero 4096, was 2.4% small.";
CM_ SG_ 100 AZIMUTH_EDGE_A_RAW "Left angular edge; same encoding as AZIMUTH_CENTER. The radar firmware passes it through atan, so it is the tangent of the angle: tan +-1.024 is about +-45.7 deg. Always at or left of the center. Clips at 8191.";
CM_ SG_ 100 FIELD_437_RAW "Radar firmware: raw, valid below 5. Shares: 1 55.5%, 2 9.3%, 3 35.0%, 4 0.3%. Meaning unknown.";
CM_ SG_ 100 AZIMUTH_EDGE_B_RAW "Right angular edge; same encoding as AZIMUTH_CENTER, passed through atan by the radar firmware (a tangent). Clips at 0 for near objects at the field-of-view edge. The edge difference is the Bosch A ANGULAR_WIDTH counterpart: it scales as 1/range within a track (log-log slope -0.91 to -0.99, ten recordings).";
CM_ SG_ 100 MOTION_CLASS_CANDIDATE_RAW "Radar firmware: bits 465-467, raw, valid below 5 (bit 464 is unused and never set). Values 0 78.6%, 1 4.0%, 2 17.4% (read as 0, 2, 4 before 2026-10-02). 2: same-direction traffic, and most objects seen only while ego is stopped. 1: oncoming or approaching, and most stationary objects seen while ego moves. 0: unassigned; young tracks, and every object on the 2026-09-10 and 2026-09-16 drives. Not a validated classifier.";
CM_ SG_ 100 ANGULAR_WIDTH_COARSE_CANDIDATE_RAW "Radar firmware: 0.0002*raw, no range check; stored next to AZIMUTH_EDGE_A. Angular extent measure, about 1/range within a track. Not a fixed-scale copy of the edge width (forward vs inverse fits 6-21 vs 14-24 edge counts per unit). Not received power.";
CM_ SG_ 100 ANGULAR_WIDTH_480_RAW "Angular-width measure (accepted 2026-09-29 on held-out routes): follows the azimuth-edge width (Spearman >= 0.8) and scales as about 1/range within tracks on 57 of 60 routes. Radar firmware: 0.0002*raw, no range check; stored next to AUX2_378. 0 while AUX2_378 holds its default.";
CM_ SG_ 100 ANGULAR_WIDTH_COARSE_COPY_CANDIDATE_RAW "Radar firmware: 0.0002*raw, no range check; stored next to AZIMUTH_EDGE_B. Byte 61 equals byte 59 on 99.7-100% of observations.";
BA_ "VFrameFormat" BO_ 102 14;
CM_ SG_ 102 CRC16_RAW "Capture-verified CRC16: polynomial 0x1021, init 0xFFFF, no reflection or xorout; bytes 2:64 then little-endian data ID 0x0fad. The radar firmware's E2E receive configuration holds data IDs 0x0FAB-0x0FBA.";
CM_ SG_ 102 OBJECT_ID_RAW "Bits 32-39 (radar firmware; 40-47 are unused and never set). Observed 0 empty, 1 through 63 active. IDs move between wire slots and are reused.";
CM_ SG_ 102 LIFECYCLE_RAW "Observed +3 modulo 4096 per consecutive sweep for continuing IDs. Resets or discontinuities require a new track. Not read by the radar firmware.";
CM_ SG_ 102 FRAME_PHASE_RAW "Radar firmware: raw, valid below 16.";
CM_ SG_ 102 POSITION_X_RAW "Radar firmware: 0.05*raw m, valid below 4096, no offset (in the sender's frame). Unsigned 12-bit, bits 48-59; bit 60 belongs to OBJECT_CLASS_RAW. Working decode dRel = 0.05*raw-4.296 m (accepted): the -4.296 m is our measured offset to the bumper reference, not part of the encoding. The stock dash draws HUD_OBJECTS LONG_DIST from raw/4. Normalized closing and azimuth both imply a sensor range origin about 2.3 m behind the dRel origin, which fits the windshield camera that sends this bank.";
CM_ SG_ 102 OBJECT_CLASS_RAW "Object class, bits 60-63. Radar firmware: raw, valid below 16; it names no values. 1 car and 3 truck/large vehicle: accepted against the stock dash HUD_OBJECTS icons on held-out routes (99.6% and 99.2%). 6, 7 and 8 are not motorcycle, pedestrian and bicycle as such: against video within 25 m they name that object on 1 of 11, 3 of 13 and 3 of 12 clear labels, and are most often a car (2026-09-29). The stock dash shows icon 6 for moving two-wheelers, so its motorcycle icon adds a filter on top of class 6. 9-11 unconfirmed. Classes 1 and 3 never share a track with classes 6-11.";
CM_ SG_ 102 POSITION_Y_RAW "Lateral position, 14-bit offset binary, positive left. Radar firmware: 0.01*raw-81.91 m, zero at 8191 (also its initial value), valid below 16384. Until 2026-10-02 production used zero 8192 (1 cm right). The 0.01 m scale and 14-bit extent were accepted on held-out routes before the firmware confirmed them. A 13-bit read wraps past +-40.95 m.";
CM_ SG_ 102 LIFE_STATE_CANDIDATE_RAW "Radar firmware: a separate 2-bit field, raw, valid below 4. Life state 0 newborn, 1 established, 2 ending (2 on 6-26% of a track last three frames vs 0.1-4% mid-life, ten recordings). Shares: 0 9.6%, 1 88.1%, 2 2.3%; 3 never seen.";
CM_ SG_ 102 VELOCITY_RAW "Relative velocity. Radar firmware: 0.1*raw-154.0 m/s, zero at 1540 (also its initial value), valid below 2048; the MY22 firmware (A070) reads it the same way. Production used zero 1539 (+0.1 m/s) until 2026-10-02. Stationary objects read about -0.3 m/s against vEgo with 1539 and -0.4 m/s with 1540, which points at the wheel-speed reference rather than the encoding. Raw 0 (-154 m/s) is a floor saturation on newborn far objects, not a sentinel.";
CM_ SG_ 102 LATERAL_VELOCITY_RAW "Lateral velocity, positive left, relative in the sensor frame (includes the apparent motion of stationary objects from ego yaw). Radar firmware: 0.1*raw-51.1 m/s, zero at 511 (also its initial value), valid below 1024. Accepted 2026-10-02: the research decode 0.1*(raw-511) was provisional only because one held-out scale bracket (0.1004-0.1085) missed 0.1; the firmware settles the scale.";
CM_ SG_ 102 ENUM_106_CANDIDATE_RAW "Radar firmware: one 3-bit field, raw, valid below 5 (formerly read as flags at bits 106 and 107). Shares: 0 14.6%, 1 83.8%, 2 1.0%, 3 0.7%, 4 under 0.1%. Bit 106 (odd values) is set on about 40% of newborn frames and 97-99% after 1 s and agrees with LIFE_STATE 1 on 96%; bit 107 (values 2-3) is mostly on mature same-direction movers. Meaning unresolved.";
CM_ SG_ 102 ENUM_109_CANDIDATE_RAW "Not read by the radar firmware. Values 0-4. 1 on most established tracks; 2-4 mostly on same-direction movers near the path with high existence. Not an object class (metric width about 1.7 m for all values) and not a left/right lane code. Meaning unresolved.";
CM_ SG_ 102 EXISTENCE_PROBABILITY_RAW "Bosch A OBJECT_EXISTENCE_PROBABILITY counterpart (accepted). Radar firmware: 2*raw percent, valid below 51 (100%); observed 0-49, 49 most common. Best survival predictor within range x age strata on ten recordings (AUC 0.67-0.92); falls over the last second before track death; low on short-lived ghosts. 0 marks a degraded measurement (accepted on held-out routes: range innovation and vRel steps at least 2x worse on 17 of 17).";
CM_ SG_ 102 NORMALIZED_RATE_RAW "Bosch A NORMALIZED_CLOSING counterpart. Radar firmware: 0.001*raw-40 (1/s), valid below 65001. Accepted 2026-10-02: the research decode 0.001*(raw-40000) 1/s matches the firmware exactly; approximately vRel/(dRel+2.3 m) and follows Doppler vRel, not range change. 64999 marks invalid in the data (TTC 0, TTC sigma 0 and normalized-closing sigma 0 in the same frame), though the firmware getter accepts it.";
CM_ SG_ 102 QUALITY_CONTAINER_RAW "Bits 144-153 (radar firmware; 154-159 are unused and never set). Radar firmware: 0.05*raw, valid below 1024; the 0.05 step equals the range resolution. Bosch A RANGE_SIGMA candidate (provisional): range-noise specific on 8 of 10 recordings, weak (partial rho 0.08-0.25). Strongly range dependent. Unit unnamed.";
CM_ SG_ 102 REL_VELOCITY_UNCERTAINTY_RAW "Bosch A REL_VELOCITY_UNCERTAINTY counterpart (accepted, raw units): velocity-noise specific and monotonic with empirical vRel noise on ten recordings. Radar firmware: 0.1*raw, valid below 1024, unit unnamed. Nonlinear against our measured vRel noise (the adapter maps it empirically).";
CM_ SG_ 102 UNCERTAINTY_160_CANDIDATE_RAW "Radar firmware: 10 bits, 0.02*raw, valid below 1024. Mostly 1-2; higher on young and laterally offset objects. Weak noise association. Unit unnamed.";
CM_ SG_ 102 ACQUISITION_186_CANDIDATE_RAW "Radar firmware: 6 bits, 0.01*raw, valid below 64. Starts near 23 on newborn tracks and decays to about 2. Carries little information beyond track age.";
CM_ SG_ 102 UNCERTAINTY_192_CANDIDATE_RAW "Radar firmware: 9 bits, 0.1*raw, valid below 512. Decays with age; mixed velocity and lateral noise association, not specific to one noise. Unit unnamed.";
CM_ SG_ 102 TTC_RAW "Time to collision (accepted 2026-09-28 on held-out routes), (raw-1024)/128 s: a constant-velocity TTC, equal to -1/normalized closing within 0.06-0.10 s median. Reported only while an acceleration-aware collision prediction expects impact (lagging it by about 1-2 s); otherwise 2046. 0 = invalid (normalized closing 64999). Not read by the radar firmware, so the scale rests on captures. No Bosch A counterpart.";
CM_ SG_ 102 OBJECT_LENGTH_CANDIDATE_RAW "Object length, provisional (docs/object-length-217.md). Radar firmware: 0.05*raw m, valid below 512. Median 4.25 m for class 1 and 8.7-8.9 m for class 3; 0 for classes 6-8 on 92%; stable within a track (per-track std 0.09 m). A coarse estimate near a per-class default: a 4.8 m Mustang read 4.25 m. Held-out round 2026-10-02: L1, L3, L4 pass, L2 fails (class 3 is under 1.6x class 1 on 8 of 39 routes, where class 3 reads 3.6-6.6 m). X does not refer to the object center: no length term is needed in dRel.";
CM_ SG_ 102 FIELD_226_RAW "Radar firmware: 0.01*raw-1.57, valid below 316 (+-1.57, so likely an angle in rad); initial value 157 (0). Near 0 on moving objects (p5-p95 about +-0.15), spread over +-1.5 on stationary ones. Not the heading from motion: r -0.19 to +0.07 with the sign varying by route (docs/object-length-217.md). Meaning unknown.";
CM_ SG_ 102 TTC_SIGMA_CANDIDATE_RAW "TTC uncertainty (provisional): raw = TTC^2 * NORMALIZED_CLOSING_SIGMA / 64 within 0.1-2.5% on ten recordings. 127 = saturated or not populated; 0 = invalid. Stays populated on 3-26% of frames where TTC is defaulted (TTC about 8-19 s). Not read by the radar firmware.";
CM_ SG_ 102 FIELD_248_RAW "Not read by the radar firmware. Median raw 172. Meaning unknown.";
CM_ SG_ 102 WIDTH_FINE_258_CANDIDATE_RAW "Radar firmware: 8 bits, 0.0002*raw, no range check; stored next to AZIMUTH_CENTER, like the 0.0002 widths stored next to each edge. Values above 63 on 1.7% of frames. Angular extent measure, about 1/range within a track.";
CM_ SG_ 102 NORMALIZED_CLOSING_SIGMA_RAW "Bosch A NORMALIZED_CLOSING_SIGMA counterpart (accepted): specific to normalized-closing noise and monotonic with it on ten recordings; tied to TTC_SIGMA by a fixed 1/64 ratio. 0 when normalized closing is invalid. Radar firmware: 10 bits, 0.001*raw, valid below 1024, the same step as NORMALIZED_RATE. Values above 511 on 0.6% of frames, which the earlier 9-bit read truncated.";
CM_ SG_ 102 AUX_LATERAL_MOTION_304_CANDIDATE_RAW "Radar firmware: one 17-bit offset-binary field, raw*80/2^17-40, valid below 131072 (formerly read as signed 16 bits at 304 plus a direction bit at 320). Bit 320 is its sign: set on 49.7% of frames, which is why it agreed with the 16-bit value being nonnegative. Its scale (0.00061 per count) is far below the earlier 0.005-0.12 m/s bracket, so it is probably not a lateral speed in m/s; with the firmware decode it does not follow the azimuth rate, dY/dt, lateral velocity or its rate either (r < 0.08; docs/object-length-217.md). About 0 when normalized closing is invalid.";
CM_ SG_ 102 AUX_328_CANDIDATE_RAW "Radar firmware: 14 bits, 0.00002*raw, valid below 12501 (0-0.25). Changes nearly every frame; weak association with lateral and angular noise, not specific to one. 0 when normalized closing is invalid. Meaning unresolved.";
CM_ SG_ 102 FIELD_344_RAW "Radar firmware: 0.002*raw-10, valid below 8001 (+-10). Raw 5000 (0) on 68% of frames. Not acceleration: on lead-like objects its 90th-percentile magnitude is 0.04-0.12 against 0.55-1.83 m/s^2 of lead acceleration, r <= 0.2 (docs/object-length-217.md). Meaning unknown.";
CM_ SG_ 102 FIELD_360_RAW "Not read by the A230 radar firmware; the MY22 firmware (A070) defines 362:6 here instead. Median raw 48. Meaning unknown.";
CM_ SG_ 102 FIELD_368_RAW "Radar firmware: 0.0025*raw, valid below 1024. Raw 1 on 64% of frames. Meaning unknown.";
CM_ SG_ 102 AUX2_378_CANDIDATE_RAW "Radar firmware: same encoding as the azimuth fields, 0.00025*raw-1.02375, valid below 8192 (initial value 4095), and the radar passes it through atan like the edges: a tangent. Not signed 13-bit: with this decode its sign matches the azimuth on 98-99% of populated frames (routes 171, 17b, 19d), against 1-2% for a signed read. Shares one subrecord with ANGULAR_WIDTH_480: both hold their defaults together (8190 here; bits 480-487 zero) on about two thirds of observations. The MY22 firmware has no getter for it.";
CM_ SG_ 102 FIELD_391_RAW "Radar firmware: 0.05*raw, valid below 128. Scales with class: median 0.7 for class 1, 1.5 for class 3, 0 for classes 6-8; constant with age and range. Weakly related to how much OBJECT_LENGTH varies within a track (Spearman 0.19). Meaning unknown.";
CM_ SG_ 102 MATURITY_398_CANDIDATE_RAW "Radar firmware: one 7-bit field; not read. Values above 15 on 9.2% of frames. Counts down from about 6 to 1 as a track matures. Adds no velocity-error or survival information once track age is known.";
CM_ SG_ 102 FIELD_405_RAW "Not read by the radar firmware. Raw 49 on 82% of frames. Meaning unknown.";
CM_ SG_ 102 AZIMUTH_CENTER_RAW "Radar firmware: 0.00025*raw-1.02375 (zero at 4095), valid below 8192; unlike the edges, the radar does not pass it through atan here. Positive left. Equals the midpoint of the two edge fields on 97-99.9% of observations, so it is the same quantity as the edges: a tangent. The earlier 2^-12 rad per count, zero 4096, was 2.4% small.";
CM_ SG_ 102 AZIMUTH_EDGE_A_RAW "Left angular edge; same encoding as AZIMUTH_CENTER. The radar firmware passes it through atan, so it is the tangent of the angle: tan +-1.024 is about +-45.7 deg. Always at or left of the center. Clips at 8191.";
CM_ SG_ 102 FIELD_437_RAW "Radar firmware: raw, valid below 5. Shares: 1 55.5%, 2 9.3%, 3 35.0%, 4 0.3%. Meaning unknown.";
CM_ SG_ 102 AZIMUTH_EDGE_B_RAW "Right angular edge; same encoding as AZIMUTH_CENTER, passed through atan by the radar firmware (a tangent). Clips at 0 for near objects at the field-of-view edge. The edge difference is the Bosch A ANGULAR_WIDTH counterpart: it scales as 1/range within a track (log-log slope -0.91 to -0.99, ten recordings).";
CM_ SG_ 102 MOTION_CLASS_CANDIDATE_RAW "Radar firmware: bits 465-467, raw, valid below 5 (bit 464 is unused and never set). Values 0 78.6%, 1 4.0%, 2 17.4% (read as 0, 2, 4 before 2026-10-02). 2: same-direction traffic, and most objects seen only while ego is stopped. 1: oncoming or approaching, and most stationary objects seen while ego moves. 0: unassigned; young tracks, and every object on the 2026-09-10 and 2026-09-16 drives. Not a validated classifier.";
CM_ SG_ 102 ANGULAR_WIDTH_COARSE_CANDIDATE_RAW "Radar firmware: 0.0002*raw, no range check; stored next to AZIMUTH_EDGE_A. Angular extent measure, about 1/range within a track. Not a fixed-scale copy of the edge width (forward vs inverse fits 6-21 vs 14-24 edge counts per unit). Not received power.";
CM_ SG_ 102 ANGULAR_WIDTH_480_RAW "Angular-width measure (accepted 2026-09-29 on held-out routes): follows the azimuth-edge width (Spearman >= 0.8) and scales as about 1/range within tracks on 57 of 60 routes. Radar firmware: 0.0002*raw, no range check; stored next to AUX2_378. 0 while AUX2_378 holds its default.";
CM_ SG_ 102 ANGULAR_WIDTH_COARSE_COPY_CANDIDATE_RAW "Radar firmware: 0.0002*raw, no range check; stored next to AZIMUTH_EDGE_B. Byte 61 equals byte 59 on 99.7-100% of observations.";
BA_ "VFrameFormat" BO_ 104 14;
CM_ SG_ 104 CRC16_RAW "Capture-verified CRC16: polynomial 0x1021, init 0xFFFF, no reflection or xorout; bytes 2:64 then little-endian data ID 0x0fae. The radar firmware's E2E receive configuration holds data IDs 0x0FAB-0x0FBA.";
CM_ SG_ 104 OBJECT_ID_RAW "Bits 32-39 (radar firmware; 40-47 are unused and never set). Observed 0 empty, 1 through 63 active. IDs move between wire slots and are reused.";
CM_ SG_ 104 LIFECYCLE_RAW "Observed +3 modulo 4096 per consecutive sweep for continuing IDs. Resets or discontinuities require a new track. Not read by the radar firmware.";
CM_ SG_ 104 FRAME_PHASE_RAW "Radar firmware: raw, valid below 16.";
CM_ SG_ 104 POSITION_X_RAW "Radar firmware: 0.05*raw m, valid below 4096, no offset (in the sender's frame). Unsigned 12-bit, bits 48-59; bit 60 belongs to OBJECT_CLASS_RAW. Working decode dRel = 0.05*raw-4.296 m (accepted): the -4.296 m is our measured offset to the bumper reference, not part of the encoding. The stock dash draws HUD_OBJECTS LONG_DIST from raw/4. Normalized closing and azimuth both imply a sensor range origin about 2.3 m behind the dRel origin, which fits the windshield camera that sends this bank.";
CM_ SG_ 104 OBJECT_CLASS_RAW "Object class, bits 60-63. Radar firmware: raw, valid below 16; it names no values. 1 car and 3 truck/large vehicle: accepted against the stock dash HUD_OBJECTS icons on held-out routes (99.6% and 99.2%). 6, 7 and 8 are not motorcycle, pedestrian and bicycle as such: against video within 25 m they name that object on 1 of 11, 3 of 13 and 3 of 12 clear labels, and are most often a car (2026-09-29). The stock dash shows icon 6 for moving two-wheelers, so its motorcycle icon adds a filter on top of class 6. 9-11 unconfirmed. Classes 1 and 3 never share a track with classes 6-11.";
CM_ SG_ 104 POSITION_Y_RAW "Lateral position, 14-bit offset binary, positive left. Radar firmware: 0.01*raw-81.91 m, zero at 8191 (also its initial value), valid below 16384. Until 2026-10-02 production used zero 8192 (1 cm right). The 0.01 m scale and 14-bit extent were accepted on held-out routes before the firmware confirmed them. A 13-bit read wraps past +-40.95 m.";
CM_ SG_ 104 LIFE_STATE_CANDIDATE_RAW "Radar firmware: a separate 2-bit field, raw, valid below 4. Life state 0 newborn, 1 established, 2 ending (2 on 6-26% of a track last three frames vs 0.1-4% mid-life, ten recordings). Shares: 0 9.6%, 1 88.1%, 2 2.3%; 3 never seen.";
CM_ SG_ 104 VELOCITY_RAW "Relative velocity. Radar firmware: 0.1*raw-154.0 m/s, zero at 1540 (also its initial value), valid below 2048; the MY22 firmware (A070) reads it the same way. Production used zero 1539 (+0.1 m/s) until 2026-10-02. Stationary objects read about -0.3 m/s against vEgo with 1539 and -0.4 m/s with 1540, which points at the wheel-speed reference rather than the encoding. Raw 0 (-154 m/s) is a floor saturation on newborn far objects, not a sentinel.";
CM_ SG_ 104 LATERAL_VELOCITY_RAW "Lateral velocity, positive left, relative in the sensor frame (includes the apparent motion of stationary objects from ego yaw). Radar firmware: 0.1*raw-51.1 m/s, zero at 511 (also its initial value), valid below 1024. Accepted 2026-10-02: the research decode 0.1*(raw-511) was provisional only because one held-out scale bracket (0.1004-0.1085) missed 0.1; the firmware settles the scale.";
CM_ SG_ 104 ENUM_106_CANDIDATE_RAW "Radar firmware: one 3-bit field, raw, valid below 5 (formerly read as flags at bits 106 and 107). Shares: 0 14.6%, 1 83.8%, 2 1.0%, 3 0.7%, 4 under 0.1%. Bit 106 (odd values) is set on about 40% of newborn frames and 97-99% after 1 s and agrees with LIFE_STATE 1 on 96%; bit 107 (values 2-3) is mostly on mature same-direction movers. Meaning unresolved.";
CM_ SG_ 104 ENUM_109_CANDIDATE_RAW "Not read by the radar firmware. Values 0-4. 1 on most established tracks; 2-4 mostly on same-direction movers near the path with high existence. Not an object class (metric width about 1.7 m for all values) and not a left/right lane code. Meaning unresolved.";
CM_ SG_ 104 EXISTENCE_PROBABILITY_RAW "Bosch A OBJECT_EXISTENCE_PROBABILITY counterpart (accepted). Radar firmware: 2*raw percent, valid below 51 (100%); observed 0-49, 49 most common. Best survival predictor within range x age strata on ten recordings (AUC 0.67-0.92); falls over the last second before track death; low on short-lived ghosts. 0 marks a degraded measurement (accepted on held-out routes: range innovation and vRel steps at least 2x worse on 17 of 17).";
CM_ SG_ 104 NORMALIZED_RATE_RAW "Bosch A NORMALIZED_CLOSING counterpart. Radar firmware: 0.001*raw-40 (1/s), valid below 65001. Accepted 2026-10-02: the research decode 0.001*(raw-40000) 1/s matches the firmware exactly; approximately vRel/(dRel+2.3 m) and follows Doppler vRel, not range change. 64999 marks invalid in the data (TTC 0, TTC sigma 0 and normalized-closing sigma 0 in the same frame), though the firmware getter accepts it.";
CM_ SG_ 104 QUALITY_CONTAINER_RAW "Bits 144-153 (radar firmware; 154-159 are unused and never set). Radar firmware: 0.05*raw, valid below 1024; the 0.05 step equals the range resolution. Bosch A RANGE_SIGMA candidate (provisional): range-noise specific on 8 of 10 recordings, weak (partial rho 0.08-0.25). Strongly range dependent. Unit unnamed.";
CM_ SG_ 104 REL_VELOCITY_UNCERTAINTY_RAW "Bosch A REL_VELOCITY_UNCERTAINTY counterpart (accepted, raw units): velocity-noise specific and monotonic with empirical vRel noise on ten recordings. Radar firmware: 0.1*raw, valid below 1024, unit unnamed. Nonlinear against our measured vRel noise (the adapter maps it empirically).";
CM_ SG_ 104 UNCERTAINTY_160_CANDIDATE_RAW "Radar firmware: 10 bits, 0.02*raw, valid below 1024. Mostly 1-2; higher on young and laterally offset objects. Weak noise association. Unit unnamed.";
CM_ SG_ 104 ACQUISITION_186_CANDIDATE_RAW "Radar firmware: 6 bits, 0.01*raw, valid below 64. Starts near 23 on newborn tracks and decays to about 2. Carries little information beyond track age.";
CM_ SG_ 104 UNCERTAINTY_192_CANDIDATE_RAW "Radar firmware: 9 bits, 0.1*raw, valid below 512. Decays with age; mixed velocity and lateral noise association, not specific to one noise. Unit unnamed.";
CM_ SG_ 104 TTC_RAW "Time to collision (accepted 2026-09-28 on held-out routes), (raw-1024)/128 s: a constant-velocity TTC, equal to -1/normalized closing within 0.06-0.10 s median. Reported only while an acceleration-aware collision prediction expects impact (lagging it by about 1-2 s); otherwise 2046. 0 = invalid (normalized closing 64999). Not read by the radar firmware, so the scale rests on captures. No Bosch A counterpart.";
CM_ SG_ 104 OBJECT_LENGTH_CANDIDATE_RAW "Object length, provisional (docs/object-length-217.md). Radar firmware: 0.05*raw m, valid below 512. Median 4.25 m for class 1 and 8.7-8.9 m for class 3; 0 for classes 6-8 on 92%; stable within a track (per-track std 0.09 m). A coarse estimate near a per-class default: a 4.8 m Mustang read 4.25 m. Held-out round 2026-10-02: L1, L3, L4 pass, L2 fails (class 3 is under 1.6x class 1 on 8 of 39 routes, where class 3 reads 3.6-6.6 m). X does not refer to the object center: no length term is needed in dRel.";
CM_ SG_ 104 FIELD_226_RAW "Radar firmware: 0.01*raw-1.57, valid below 316 (+-1.57, so likely an angle in rad); initial value 157 (0). Near 0 on moving objects (p5-p95 about +-0.15), spread over +-1.5 on stationary ones. Not the heading from motion: r -0.19 to +0.07 with the sign varying by route (docs/object-length-217.md). Meaning unknown.";
CM_ SG_ 104 TTC_SIGMA_CANDIDATE_RAW "TTC uncertainty (provisional): raw = TTC^2 * NORMALIZED_CLOSING_SIGMA / 64 within 0.1-2.5% on ten recordings. 127 = saturated or not populated; 0 = invalid. Stays populated on 3-26% of frames where TTC is defaulted (TTC about 8-19 s). Not read by the radar firmware.";
CM_ SG_ 104 FIELD_248_RAW "Not read by the radar firmware. Median raw 172. Meaning unknown.";
CM_ SG_ 104 WIDTH_FINE_258_CANDIDATE_RAW "Radar firmware: 8 bits, 0.0002*raw, no range check; stored next to AZIMUTH_CENTER, like the 0.0002 widths stored next to each edge. Values above 63 on 1.7% of frames. Angular extent measure, about 1/range within a track.";
CM_ SG_ 104 NORMALIZED_CLOSING_SIGMA_RAW "Bosch A NORMALIZED_CLOSING_SIGMA counterpart (accepted): specific to normalized-closing noise and monotonic with it on ten recordings; tied to TTC_SIGMA by a fixed 1/64 ratio. 0 when normalized closing is invalid. Radar firmware: 10 bits, 0.001*raw, valid below 1024, the same step as NORMALIZED_RATE. Values above 511 on 0.6% of frames, which the earlier 9-bit read truncated.";
CM_ SG_ 104 AUX_LATERAL_MOTION_304_CANDIDATE_RAW "Radar firmware: one 17-bit offset-binary field, raw*80/2^17-40, valid below 131072 (formerly read as signed 16 bits at 304 plus a direction bit at 320). Bit 320 is its sign: set on 49.7% of frames, which is why it agreed with the 16-bit value being nonnegative. Its scale (0.00061 per count) is far below the earlier 0.005-0.12 m/s bracket, so it is probably not a lateral speed in m/s; with the firmware decode it does not follow the azimuth rate, dY/dt, lateral velocity or its rate either (r < 0.08; docs/object-length-217.md). About 0 when normalized closing is invalid.";
CM_ SG_ 104 AUX_328_CANDIDATE_RAW "Radar firmware: 14 bits, 0.00002*raw, valid below 12501 (0-0.25). Changes nearly every frame; weak association with lateral and angular noise, not specific to one. 0 when normalized closing is invalid. Meaning unresolved.";
CM_ SG_ 104 FIELD_344_RAW "Radar firmware: 0.002*raw-10, valid below 8001 (+-10). Raw 5000 (0) on 68% of frames. Not acceleration: on lead-like objects its 90th-percentile magnitude is 0.04-0.12 against 0.55-1.83 m/s^2 of lead acceleration, r <= 0.2 (docs/object-length-217.md). Meaning unknown.";
CM_ SG_ 104 FIELD_360_RAW "Not read by the A230 radar firmware; the MY22 firmware (A070) defines 362:6 here instead. Median raw 48. Meaning unknown.";
CM_ SG_ 104 FIELD_368_RAW "Radar firmware: 0.0025*raw, valid below 1024. Raw 1 on 64% of frames. Meaning unknown.";
CM_ SG_ 104 AUX2_378_CANDIDATE_RAW "Radar firmware: same encoding as the azimuth fields, 0.00025*raw-1.02375, valid below 8192 (initial value 4095), and the radar passes it through atan like the edges: a tangent. Not signed 13-bit: with this decode its sign matches the azimuth on 98-99% of populated frames (routes 171, 17b, 19d), against 1-2% for a signed read. Shares one subrecord with ANGULAR_WIDTH_480: both hold their defaults together (8190 here; bits 480-487 zero) on about two thirds of observations. The MY22 firmware has no getter for it.";
CM_ SG_ 104 FIELD_391_RAW "Radar firmware: 0.05*raw, valid below 128. Scales with class: median 0.7 for class 1, 1.5 for class 3, 0 for classes 6-8; constant with age and range. Weakly related to how much OBJECT_LENGTH varies within a track (Spearman 0.19). Meaning unknown.";
CM_ SG_ 104 MATURITY_398_CANDIDATE_RAW "Radar firmware: one 7-bit field; not read. Values above 15 on 9.2% of frames. Counts down from about 6 to 1 as a track matures. Adds no velocity-error or survival information once track age is known.";
CM_ SG_ 104 FIELD_405_RAW "Not read by the radar firmware. Raw 49 on 82% of frames. Meaning unknown.";
CM_ SG_ 104 AZIMUTH_CENTER_RAW "Radar firmware: 0.00025*raw-1.02375 (zero at 4095), valid below 8192; unlike the edges, the radar does not pass it through atan here. Positive left. Equals the midpoint of the two edge fields on 97-99.9% of observations, so it is the same quantity as the edges: a tangent. The earlier 2^-12 rad per count, zero 4096, was 2.4% small.";
CM_ SG_ 104 AZIMUTH_EDGE_A_RAW "Left angular edge; same encoding as AZIMUTH_CENTER. The radar firmware passes it through atan, so it is the tangent of the angle: tan +-1.024 is about +-45.7 deg. Always at or left of the center. Clips at 8191.";
CM_ SG_ 104 FIELD_437_RAW "Radar firmware: raw, valid below 5. Shares: 1 55.5%, 2 9.3%, 3 35.0%, 4 0.3%. Meaning unknown.";
CM_ SG_ 104 AZIMUTH_EDGE_B_RAW "Right angular edge; same encoding as AZIMUTH_CENTER, passed through atan by the radar firmware (a tangent). Clips at 0 for near objects at the field-of-view edge. The edge difference is the Bosch A ANGULAR_WIDTH counterpart: it scales as 1/range within a track (log-log slope -0.91 to -0.99, ten recordings).";
CM_ SG_ 104 MOTION_CLASS_CANDIDATE_RAW "Radar firmware: bits 465-467, raw, valid below 5 (bit 464 is unused and never set). Values 0 78.6%, 1 4.0%, 2 17.4% (read as 0, 2, 4 before 2026-10-02). 2: same-direction traffic, and most objects seen only while ego is stopped. 1: oncoming or approaching, and most stationary objects seen while ego moves. 0: unassigned; young tracks, and every object on the 2026-09-10 and 2026-09-16 drives. Not a validated classifier.";
CM_ SG_ 104 ANGULAR_WIDTH_COARSE_CANDIDATE_RAW "Radar firmware: 0.0002*raw, no range check; stored next to AZIMUTH_EDGE_A. Angular extent measure, about 1/range within a track. Not a fixed-scale copy of the edge width (forward vs inverse fits 6-21 vs 14-24 edge counts per unit). Not received power.";
CM_ SG_ 104 ANGULAR_WIDTH_480_RAW "Angular-width measure (accepted 2026-09-29 on held-out routes): follows the azimuth-edge width (Spearman >= 0.8) and scales as about 1/range within tracks on 57 of 60 routes. Radar firmware: 0.0002*raw, no range check; stored next to AUX2_378. 0 while AUX2_378 holds its default.";
CM_ SG_ 104 ANGULAR_WIDTH_COARSE_COPY_CANDIDATE_RAW "Radar firmware: 0.0002*raw, no range check; stored next to AZIMUTH_EDGE_B. Byte 61 equals byte 59 on 99.7-100% of observations.";
BA_ "VFrameFormat" BO_ 106 14;
CM_ SG_ 106 CRC16_RAW "Capture-verified CRC16: polynomial 0x1021, init 0xFFFF, no reflection or xorout; bytes 2:64 then little-endian data ID 0x0faf. The radar firmware's E2E receive configuration holds data IDs 0x0FAB-0x0FBA.";
CM_ SG_ 106 OBJECT_ID_RAW "Bits 32-39 (radar firmware; 40-47 are unused and never set). Observed 0 empty, 1 through 63 active. IDs move between wire slots and are reused.";
CM_ SG_ 106 LIFECYCLE_RAW "Observed +3 modulo 4096 per consecutive sweep for continuing IDs. Resets or discontinuities require a new track. Not read by the radar firmware.";
CM_ SG_ 106 FRAME_PHASE_RAW "Radar firmware: raw, valid below 16.";
CM_ SG_ 106 POSITION_X_RAW "Radar firmware: 0.05*raw m, valid below 4096, no offset (in the sender's frame). Unsigned 12-bit, bits 48-59; bit 60 belongs to OBJECT_CLASS_RAW. Working decode dRel = 0.05*raw-4.296 m (accepted): the -4.296 m is our measured offset to the bumper reference, not part of the encoding. The stock dash draws HUD_OBJECTS LONG_DIST from raw/4. Normalized closing and azimuth both imply a sensor range origin about 2.3 m behind the dRel origin, which fits the windshield camera that sends this bank.";
CM_ SG_ 106 OBJECT_CLASS_RAW "Object class, bits 60-63. Radar firmware: raw, valid below 16; it names no values. 1 car and 3 truck/large vehicle: accepted against the stock dash HUD_OBJECTS icons on held-out routes (99.6% and 99.2%). 6, 7 and 8 are not motorcycle, pedestrian and bicycle as such: against video within 25 m they name that object on 1 of 11, 3 of 13 and 3 of 12 clear labels, and are most often a car (2026-09-29). The stock dash shows icon 6 for moving two-wheelers, so its motorcycle icon adds a filter on top of class 6. 9-11 unconfirmed. Classes 1 and 3 never share a track with classes 6-11.";
CM_ SG_ 106 POSITION_Y_RAW "Lateral position, 14-bit offset binary, positive left. Radar firmware: 0.01*raw-81.91 m, zero at 8191 (also its initial value), valid below 16384. Until 2026-10-02 production used zero 8192 (1 cm right). The 0.01 m scale and 14-bit extent were accepted on held-out routes before the firmware confirmed them. A 13-bit read wraps past +-40.95 m.";
CM_ SG_ 106 LIFE_STATE_CANDIDATE_RAW "Radar firmware: a separate 2-bit field, raw, valid below 4. Life state 0 newborn, 1 established, 2 ending (2 on 6-26% of a track last three frames vs 0.1-4% mid-life, ten recordings). Shares: 0 9.6%, 1 88.1%, 2 2.3%; 3 never seen.";
CM_ SG_ 106 VELOCITY_RAW "Relative velocity. Radar firmware: 0.1*raw-154.0 m/s, zero at 1540 (also its initial value), valid below 2048; the MY22 firmware (A070) reads it the same way. Production used zero 1539 (+0.1 m/s) until 2026-10-02. Stationary objects read about -0.3 m/s against vEgo with 1539 and -0.4 m/s with 1540, which points at the wheel-speed reference rather than the encoding. Raw 0 (-154 m/s) is a floor saturation on newborn far objects, not a sentinel.";
CM_ SG_ 106 LATERAL_VELOCITY_RAW "Lateral velocity, positive left, relative in the sensor frame (includes the apparent motion of stationary objects from ego yaw). Radar firmware: 0.1*raw-51.1 m/s, zero at 511 (also its initial value), valid below 1024. Accepted 2026-10-02: the research decode 0.1*(raw-511) was provisional only because one held-out scale bracket (0.1004-0.1085) missed 0.1; the firmware settles the scale.";
CM_ SG_ 106 ENUM_106_CANDIDATE_RAW "Radar firmware: one 3-bit field, raw, valid below 5 (formerly read as flags at bits 106 and 107). Shares: 0 14.6%, 1 83.8%, 2 1.0%, 3 0.7%, 4 under 0.1%. Bit 106 (odd values) is set on about 40% of newborn frames and 97-99% after 1 s and agrees with LIFE_STATE 1 on 96%; bit 107 (values 2-3) is mostly on mature same-direction movers. Meaning unresolved.";
CM_ SG_ 106 ENUM_109_CANDIDATE_RAW "Not read by the radar firmware. Values 0-4. 1 on most established tracks; 2-4 mostly on same-direction movers near the path with high existence. Not an object class (metric width about 1.7 m for all values) and not a left/right lane code. Meaning unresolved.";
CM_ SG_ 106 EXISTENCE_PROBABILITY_RAW "Bosch A OBJECT_EXISTENCE_PROBABILITY counterpart (accepted). Radar firmware: 2*raw percent, valid below 51 (100%); observed 0-49, 49 most common. Best survival predictor within range x age strata on ten recordings (AUC 0.67-0.92); falls over the last second before track death; low on short-lived ghosts. 0 marks a degraded measurement (accepted on held-out routes: range innovation and vRel steps at least 2x worse on 17 of 17).";
CM_ SG_ 106 NORMALIZED_RATE_RAW "Bosch A NORMALIZED_CLOSING counterpart. Radar firmware: 0.001*raw-40 (1/s), valid below 65001. Accepted 2026-10-02: the research decode 0.001*(raw-40000) 1/s matches the firmware exactly; approximately vRel/(dRel+2.3 m) and follows Doppler vRel, not range change. 64999 marks invalid in the data (TTC 0, TTC sigma 0 and normalized-closing sigma 0 in the same frame), though the firmware getter accepts it.";
CM_ SG_ 106 QUALITY_CONTAINER_RAW "Bits 144-153 (radar firmware; 154-159 are unused and never set). Radar firmware: 0.05*raw, valid below 1024; the 0.05 step equals the range resolution. Bosch A RANGE_SIGMA candidate (provisional): range-noise specific on 8 of 10 recordings, weak (partial rho 0.08-0.25). Strongly range dependent. Unit unnamed.";
CM_ SG_ 106 REL_VELOCITY_UNCERTAINTY_RAW "Bosch A REL_VELOCITY_UNCERTAINTY counterpart (accepted, raw units): velocity-noise specific and monotonic with empirical vRel noise on ten recordings. Radar firmware: 0.1*raw, valid below 1024, unit unnamed. Nonlinear against our measured vRel noise (the adapter maps it empirically).";
CM_ SG_ 106 UNCERTAINTY_160_CANDIDATE_RAW "Radar firmware: 10 bits, 0.02*raw, valid below 1024. Mostly 1-2; higher on young and laterally offset objects. Weak noise association. Unit unnamed.";
CM_ SG_ 106 ACQUISITION_186_CANDIDATE_RAW "Radar firmware: 6 bits, 0.01*raw, valid below 64. Starts near 23 on newborn tracks and decays to about 2. Carries little information beyond track age.";
CM_ SG_ 106 UNCERTAINTY_192_CANDIDATE_RAW "Radar firmware: 9 bits, 0.1*raw, valid below 512. Decays with age; mixed velocity and lateral noise association, not specific to one noise. Unit unnamed.";
CM_ SG_ 106 TTC_RAW "Time to collision (accepted 2026-09-28 on held-out routes), (raw-1024)/128 s: a constant-velocity TTC, equal to -1/normalized closing within 0.06-0.10 s median. Reported only while an acceleration-aware collision prediction expects impact (lagging it by about 1-2 s); otherwise 2046. 0 = invalid (normalized closing 64999). Not read by the radar firmware, so the scale rests on captures. No Bosch A counterpart.";
CM_ SG_ 106 OBJECT_LENGTH_CANDIDATE_RAW "Object length, provisional (docs/object-length-217.md). Radar firmware: 0.05*raw m, valid below 512. Median 4.25 m for class 1 and 8.7-8.9 m for class 3; 0 for classes 6-8 on 92%; stable within a track (per-track std 0.09 m). A coarse estimate near a per-class default: a 4.8 m Mustang read 4.25 m. Held-out round 2026-10-02: L1, L3, L4 pass, L2 fails (class 3 is under 1.6x class 1 on 8 of 39 routes, where class 3 reads 3.6-6.6 m). X does not refer to the object center: no length term is needed in dRel.";
CM_ SG_ 106 FIELD_226_RAW "Radar firmware: 0.01*raw-1.57, valid below 316 (+-1.57, so likely an angle in rad); initial value 157 (0). Near 0 on moving objects (p5-p95 about +-0.15), spread over +-1.5 on stationary ones. Not the heading from motion: r -0.19 to +0.07 with the sign varying by route (docs/object-length-217.md). Meaning unknown.";
CM_ SG_ 106 TTC_SIGMA_CANDIDATE_RAW "TTC uncertainty (provisional): raw = TTC^2 * NORMALIZED_CLOSING_SIGMA / 64 within 0.1-2.5% on ten recordings. 127 = saturated or not populated; 0 = invalid. Stays populated on 3-26% of frames where TTC is defaulted (TTC about 8-19 s). Not read by the radar firmware.";
CM_ SG_ 106 FIELD_248_RAW "Not read by the radar firmware. Median raw 172. Meaning unknown.";
CM_ SG_ 106 WIDTH_FINE_258_CANDIDATE_RAW "Radar firmware: 8 bits, 0.0002*raw, no range check; stored next to AZIMUTH_CENTER, like the 0.0002 widths stored next to each edge. Values above 63 on 1.7% of frames. Angular extent measure, about 1/range within a track.";
CM_ SG_ 106 NORMALIZED_CLOSING_SIGMA_RAW "Bosch A NORMALIZED_CLOSING_SIGMA counterpart (accepted): specific to normalized-closing noise and monotonic with it on ten recordings; tied to TTC_SIGMA by a fixed 1/64 ratio. 0 when normalized closing is invalid. Radar firmware: 10 bits, 0.001*raw, valid below 1024, the same step as NORMALIZED_RATE. Values above 511 on 0.6% of frames, which the earlier 9-bit read truncated.";
CM_ SG_ 106 AUX_LATERAL_MOTION_304_CANDIDATE_RAW "Radar firmware: one 17-bit offset-binary field, raw*80/2^17-40, valid below 131072 (formerly read as signed 16 bits at 304 plus a direction bit at 320). Bit 320 is its sign: set on 49.7% of frames, which is why it agreed with the 16-bit value being nonnegative. Its scale (0.00061 per count) is far below the earlier 0.005-0.12 m/s bracket, so it is probably not a lateral speed in m/s; with the firmware decode it does not follow the azimuth rate, dY/dt, lateral velocity or its rate either (r < 0.08; docs/object-length-217.md). About 0 when normalized closing is invalid.";
CM_ SG_ 106 AUX_328_CANDIDATE_RAW "Radar firmware: 14 bits, 0.00002*raw, valid below 12501 (0-0.25). Changes nearly every frame; weak association with lateral and angular noise, not specific to one. 0 when normalized closing is invalid. Meaning unresolved.";
CM_ SG_ 106 FIELD_344_RAW "Radar firmware: 0.002*raw-10, valid below 8001 (+-10). Raw 5000 (0) on 68% of frames. Not acceleration: on lead-like objects its 90th-percentile magnitude is 0.04-0.12 against 0.55-1.83 m/s^2 of lead acceleration, r <= 0.2 (docs/object-length-217.md). Meaning unknown.";
CM_ SG_ 106 FIELD_360_RAW "Not read by the A230 radar firmware; the MY22 firmware (A070) defines 362:6 here instead. Median raw 48. Meaning unknown.";
CM_ SG_ 106 FIELD_368_RAW "Radar firmware: 0.0025*raw, valid below 1024. Raw 1 on 64% of frames. Meaning unknown.";
CM_ SG_ 106 AUX2_378_CANDIDATE_RAW "Radar firmware: same encoding as the azimuth fields, 0.00025*raw-1.02375, valid below 8192 (initial value 4095), and the radar passes it through atan like the edges: a tangent. Not signed 13-bit: with this decode its sign matches the azimuth on 98-99% of populated frames (routes 171, 17b, 19d), against 1-2% for a signed read. Shares one subrecord with ANGULAR_WIDTH_480: both hold their defaults together (8190 here; bits 480-487 zero) on about two thirds of observations. The MY22 firmware has no getter for it.";
CM_ SG_ 106 FIELD_391_RAW "Radar firmware: 0.05*raw, valid below 128. Scales with class: median 0.7 for class 1, 1.5 for class 3, 0 for classes 6-8; constant with age and range. Weakly related to how much OBJECT_LENGTH varies within a track (Spearman 0.19). Meaning unknown.";
CM_ SG_ 106 MATURITY_398_CANDIDATE_RAW "Radar firmware: one 7-bit field; not read. Values above 15 on 9.2% of frames. Counts down from about 6 to 1 as a track matures. Adds no velocity-error or survival information once track age is known.";
CM_ SG_ 106 FIELD_405_RAW "Not read by the radar firmware. Raw 49 on 82% of frames. Meaning unknown.";
CM_ SG_ 106 AZIMUTH_CENTER_RAW "Radar firmware: 0.00025*raw-1.02375 (zero at 4095), valid below 8192; unlike the edges, the radar does not pass it through atan here. Positive left. Equals the midpoint of the two edge fields on 97-99.9% of observations, so it is the same quantity as the edges: a tangent. The earlier 2^-12 rad per count, zero 4096, was 2.4% small.";
CM_ SG_ 106 AZIMUTH_EDGE_A_RAW "Left angular edge; same encoding as AZIMUTH_CENTER. The radar firmware passes it through atan, so it is the tangent of the angle: tan +-1.024 is about +-45.7 deg. Always at or left of the center. Clips at 8191.";
CM_ SG_ 106 FIELD_437_RAW "Radar firmware: raw, valid below 5. Shares: 1 55.5%, 2 9.3%, 3 35.0%, 4 0.3%. Meaning unknown.";
CM_ SG_ 106 AZIMUTH_EDGE_B_RAW "Right angular edge; same encoding as AZIMUTH_CENTER, passed through atan by the radar firmware (a tangent). Clips at 0 for near objects at the field-of-view edge. The edge difference is the Bosch A ANGULAR_WIDTH counterpart: it scales as 1/range within a track (log-log slope -0.91 to -0.99, ten recordings).";
CM_ SG_ 106 MOTION_CLASS_CANDIDATE_RAW "Radar firmware: bits 465-467, raw, valid below 5 (bit 464 is unused and never set). Values 0 78.6%, 1 4.0%, 2 17.4% (read as 0, 2, 4 before 2026-10-02). 2: same-direction traffic, and most objects seen only while ego is stopped. 1: oncoming or approaching, and most stationary objects seen while ego moves. 0: unassigned; young tracks, and every object on the 2026-09-10 and 2026-09-16 drives. Not a validated classifier.";
CM_ SG_ 106 ANGULAR_WIDTH_COARSE_CANDIDATE_RAW "Radar firmware: 0.0002*raw, no range check; stored next to AZIMUTH_EDGE_A. Angular extent measure, about 1/range within a track. Not a fixed-scale copy of the edge width (forward vs inverse fits 6-21 vs 14-24 edge counts per unit). Not received power.";
CM_ SG_ 106 ANGULAR_WIDTH_480_RAW "Angular-width measure (accepted 2026-09-29 on held-out routes): follows the azimuth-edge width (Spearman >= 0.8) and scales as about 1/range within tracks on 57 of 60 routes. Radar firmware: 0.0002*raw, no range check; stored next to AUX2_378. 0 while AUX2_378 holds its default.";
CM_ SG_ 106 ANGULAR_WIDTH_COARSE_COPY_CANDIDATE_RAW "Radar firmware: 0.0002*raw, no range check; stored next to AZIMUTH_EDGE_B. Byte 61 equals byte 59 on 99.7-100% of observations.";
BA_ "VFrameFormat" BO_ 108 14;
CM_ SG_ 108 CRC16_RAW "Capture-verified CRC16: polynomial 0x1021, init 0xFFFF, no reflection or xorout; bytes 2:64 then little-endian data ID 0x0fb0. The radar firmware's E2E receive configuration holds data IDs 0x0FAB-0x0FBA.";
CM_ SG_ 108 OBJECT_ID_RAW "Bits 32-39 (radar firmware; 40-47 are unused and never set). Observed 0 empty, 1 through 63 active. IDs move between wire slots and are reused.";
CM_ SG_ 108 LIFECYCLE_RAW "Observed +3 modulo 4096 per consecutive sweep for continuing IDs. Resets or discontinuities require a new track. Not read by the radar firmware.";
CM_ SG_ 108 FRAME_PHASE_RAW "Radar firmware: raw, valid below 16.";
CM_ SG_ 108 POSITION_X_RAW "Radar firmware: 0.05*raw m, valid below 4096, no offset (in the sender's frame). Unsigned 12-bit, bits 48-59; bit 60 belongs to OBJECT_CLASS_RAW. Working decode dRel = 0.05*raw-4.296 m (accepted): the -4.296 m is our measured offset to the bumper reference, not part of the encoding. The stock dash draws HUD_OBJECTS LONG_DIST from raw/4. Normalized closing and azimuth both imply a sensor range origin about 2.3 m behind the dRel origin, which fits the windshield camera that sends this bank.";
CM_ SG_ 108 OBJECT_CLASS_RAW "Object class, bits 60-63. Radar firmware: raw, valid below 16; it names no values. 1 car and 3 truck/large vehicle: accepted against the stock dash HUD_OBJECTS icons on held-out routes (99.6% and 99.2%). 6, 7 and 8 are not motorcycle, pedestrian and bicycle as such: against video within 25 m they name that object on 1 of 11, 3 of 13 and 3 of 12 clear labels, and are most often a car (2026-09-29). The stock dash shows icon 6 for moving two-wheelers, so its motorcycle icon adds a filter on top of class 6. 9-11 unconfirmed. Classes 1 and 3 never share a track with classes 6-11.";
CM_ SG_ 108 POSITION_Y_RAW "Lateral position, 14-bit offset binary, positive left. Radar firmware: 0.01*raw-81.91 m, zero at 8191 (also its initial value), valid below 16384. Until 2026-10-02 production used zero 8192 (1 cm right). The 0.01 m scale and 14-bit extent were accepted on held-out routes before the firmware confirmed them. A 13-bit read wraps past +-40.95 m.";
CM_ SG_ 108 LIFE_STATE_CANDIDATE_RAW "Radar firmware: a separate 2-bit field, raw, valid below 4. Life state 0 newborn, 1 established, 2 ending (2 on 6-26% of a track last three frames vs 0.1-4% mid-life, ten recordings). Shares: 0 9.6%, 1 88.1%, 2 2.3%; 3 never seen.";
CM_ SG_ 108 VELOCITY_RAW "Relative velocity. Radar firmware: 0.1*raw-154.0 m/s, zero at 1540 (also its initial value), valid below 2048; the MY22 firmware (A070) reads it the same way. Production used zero 1539 (+0.1 m/s) until 2026-10-02. Stationary objects read about -0.3 m/s against vEgo with 1539 and -0.4 m/s with 1540, which points at the wheel-speed reference rather than the encoding. Raw 0 (-154 m/s) is a floor saturation on newborn far objects, not a sentinel.";
CM_ SG_ 108 LATERAL_VELOCITY_RAW "Lateral velocity, positive left, relative in the sensor frame (includes the apparent motion of stationary objects from ego yaw). Radar firmware: 0.1*raw-51.1 m/s, zero at 511 (also its initial value), valid below 1024. Accepted 2026-10-02: the research decode 0.1*(raw-511) was provisional only because one held-out scale bracket (0.1004-0.1085) missed 0.1; the firmware settles the scale.";
CM_ SG_ 108 ENUM_106_CANDIDATE_RAW "Radar firmware: one 3-bit field, raw, valid below 5 (formerly read as flags at bits 106 and 107). Shares: 0 14.6%, 1 83.8%, 2 1.0%, 3 0.7%, 4 under 0.1%. Bit 106 (odd values) is set on about 40% of newborn frames and 97-99% after 1 s and agrees with LIFE_STATE 1 on 96%; bit 107 (values 2-3) is mostly on mature same-direction movers. Meaning unresolved.";
CM_ SG_ 108 ENUM_109_CANDIDATE_RAW "Not read by the radar firmware. Values 0-4. 1 on most established tracks; 2-4 mostly on same-direction movers near the path with high existence. Not an object class (metric width about 1.7 m for all values) and not a left/right lane code. Meaning unresolved.";
CM_ SG_ 108 EXISTENCE_PROBABILITY_RAW "Bosch A OBJECT_EXISTENCE_PROBABILITY counterpart (accepted). Radar firmware: 2*raw percent, valid below 51 (100%); observed 0-49, 49 most common. Best survival predictor within range x age strata on ten recordings (AUC 0.67-0.92); falls over the last second before track death; low on short-lived ghosts. 0 marks a degraded measurement (accepted on held-out routes: range innovation and vRel steps at least 2x worse on 17 of 17).";
CM_ SG_ 108 NORMALIZED_RATE_RAW "Bosch A NORMALIZED_CLOSING counterpart. Radar firmware: 0.001*raw-40 (1/s), valid below 65001. Accepted 2026-10-02: the research decode 0.001*(raw-40000) 1/s matches the firmware exactly; approximately vRel/(dRel+2.3 m) and follows Doppler vRel, not range change. 64999 marks invalid in the data (TTC 0, TTC sigma 0 and normalized-closing sigma 0 in the same frame), though the firmware getter accepts it.";
CM_ SG_ 108 QUALITY_CONTAINER_RAW "Bits 144-153 (radar firmware; 154-159 are unused and never set). Radar firmware: 0.05*raw, valid below 1024; the 0.05 step equals the range resolution. Bosch A RANGE_SIGMA candidate (provisional): range-noise specific on 8 of 10 recordings, weak (partial rho 0.08-0.25). Strongly range dependent. Unit unnamed.";
CM_ SG_ 108 REL_VELOCITY_UNCERTAINTY_RAW "Bosch A REL_VELOCITY_UNCERTAINTY counterpart (accepted, raw units): velocity-noise specific and monotonic with empirical vRel noise on ten recordings. Radar firmware: 0.1*raw, valid below 1024, unit unnamed. Nonlinear against our measured vRel noise (the adapter maps it empirically).";
CM_ SG_ 108 UNCERTAINTY_160_CANDIDATE_RAW "Radar firmware: 10 bits, 0.02*raw, valid below 1024. Mostly 1-2; higher on young and laterally offset objects. Weak noise association. Unit unnamed.";
CM_ SG_ 108 ACQUISITION_186_CANDIDATE_RAW "Radar firmware: 6 bits, 0.01*raw, valid below 64. Starts near 23 on newborn tracks and decays to about 2. Carries little information beyond track age.";
CM_ SG_ 108 UNCERTAINTY_192_CANDIDATE_RAW "Radar firmware: 9 bits, 0.1*raw, valid below 512. Decays with age; mixed velocity and lateral noise association, not specific to one noise. Unit unnamed.";
CM_ SG_ 108 TTC_RAW "Time to collision (accepted 2026-09-28 on held-out routes), (raw-1024)/128 s: a constant-velocity TTC, equal to -1/normalized closing within 0.06-0.10 s median. Reported only while an acceleration-aware collision prediction expects impact (lagging it by about 1-2 s); otherwise 2046. 0 = invalid (normalized closing 64999). Not read by the radar firmware, so the scale rests on captures. No Bosch A counterpart.";
CM_ SG_ 108 OBJECT_LENGTH_CANDIDATE_RAW "Object length, provisional (docs/object-length-217.md). Radar firmware: 0.05*raw m, valid below 512. Median 4.25 m for class 1 and 8.7-8.9 m for class 3; 0 for classes 6-8 on 92%; stable within a track (per-track std 0.09 m). A coarse estimate near a per-class default: a 4.8 m Mustang read 4.25 m. Held-out round 2026-10-02: L1, L3, L4 pass, L2 fails (class 3 is under 1.6x class 1 on 8 of 39 routes, where class 3 reads 3.6-6.6 m). X does not refer to the object center: no length term is needed in dRel.";
CM_ SG_ 108 FIELD_226_RAW "Radar firmware: 0.01*raw-1.57, valid below 316 (+-1.57, so likely an angle in rad); initial value 157 (0). Near 0 on moving objects (p5-p95 about +-0.15), spread over +-1.5 on stationary ones. Not the heading from motion: r -0.19 to +0.07 with the sign varying by route (docs/object-length-217.md). Meaning unknown.";
CM_ SG_ 108 TTC_SIGMA_CANDIDATE_RAW "TTC uncertainty (provisional): raw = TTC^2 * NORMALIZED_CLOSING_SIGMA / 64 within 0.1-2.5% on ten recordings. 127 = saturated or not populated; 0 = invalid. Stays populated on 3-26% of frames where TTC is defaulted (TTC about 8-19 s). Not read by the radar firmware.";
CM_ SG_ 108 FIELD_248_RAW "Not read by the radar firmware. Median raw 172. Meaning unknown.";
CM_ SG_ 108 WIDTH_FINE_258_CANDIDATE_RAW "Radar firmware: 8 bits, 0.0002*raw, no range check; stored next to AZIMUTH_CENTER, like the 0.0002 widths stored next to each edge. Values above 63 on 1.7% of frames. Angular extent measure, about 1/range within a track.";
CM_ SG_ 108 NORMALIZED_CLOSING_SIGMA_RAW "Bosch A NORMALIZED_CLOSING_SIGMA counterpart (accepted): specific to normalized-closing noise and monotonic with it on ten recordings; tied to TTC_SIGMA by a fixed 1/64 ratio. 0 when normalized closing is invalid. Radar firmware: 10 bits, 0.001*raw, valid below 1024, the same step as NORMALIZED_RATE. Values above 511 on 0.6% of frames, which the earlier 9-bit read truncated.";
CM_ SG_ 108 AUX_LATERAL_MOTION_304_CANDIDATE_RAW "Radar firmware: one 17-bit offset-binary field, raw*80/2^17-40, valid below 131072 (formerly read as signed 16 bits at 304 plus a direction bit at 320). Bit 320 is its sign: set on 49.7% of frames, which is why it agreed with the 16-bit value being nonnegative. Its scale (0.00061 per count) is far below the earlier 0.005-0.12 m/s bracket, so it is probably not a lateral speed in m/s; with the firmware decode it does not follow the azimuth rate, dY/dt, lateral velocity or its rate either (r < 0.08; docs/object-length-217.md). About 0 when normalized closing is invalid.";
CM_ SG_ 108 AUX_328_CANDIDATE_RAW "Radar firmware: 14 bits, 0.00002*raw, valid below 12501 (0-0.25). Changes nearly every frame; weak association with lateral and angular noise, not specific to one. 0 when normalized closing is invalid. Meaning unresolved.";
CM_ SG_ 108 FIELD_344_RAW "Radar firmware: 0.002*raw-10, valid below 8001 (+-10). Raw 5000 (0) on 68% of frames. Not acceleration: on lead-like objects its 90th-percentile magnitude is 0.04-0.12 against 0.55-1.83 m/s^2 of lead acceleration, r <= 0.2 (docs/object-length-217.md). Meaning unknown.";
CM_ SG_ 108 FIELD_360_RAW "Not read by the A230 radar firmware; the MY22 firmware (A070) defines 362:6 here instead. Median raw 48. Meaning unknown.";
CM_ SG_ 108 FIELD_368_RAW "Radar firmware: 0.0025*raw, valid below 1024. Raw 1 on 64% of frames. Meaning unknown.";
CM_ SG_ 108 AUX2_378_CANDIDATE_RAW "Radar firmware: same encoding as the azimuth fields, 0.00025*raw-1.02375, valid below 8192 (initial value 4095), and the radar passes it through atan like the edges: a tangent. Not signed 13-bit: with this decode its sign matches the azimuth on 98-99% of populated frames (routes 171, 17b, 19d), against 1-2% for a signed read. Shares one subrecord with ANGULAR_WIDTH_480: both hold their defaults together (8190 here; bits 480-487 zero) on about two thirds of observations. The MY22 firmware has no getter for it.";
CM_ SG_ 108 FIELD_391_RAW "Radar firmware: 0.05*raw, valid below 128. Scales with class: median 0.7 for class 1, 1.5 for class 3, 0 for classes 6-8; constant with age and range. Weakly related to how much OBJECT_LENGTH varies within a track (Spearman 0.19). Meaning unknown.";
CM_ SG_ 108 MATURITY_398_CANDIDATE_RAW "Radar firmware: one 7-bit field; not read. Values above 15 on 9.2% of frames. Counts down from about 6 to 1 as a track matures. Adds no velocity-error or survival information once track age is known.";
CM_ SG_ 108 FIELD_405_RAW "Not read by the radar firmware. Raw 49 on 82% of frames. Meaning unknown.";
CM_ SG_ 108 AZIMUTH_CENTER_RAW "Radar firmware: 0.00025*raw-1.02375 (zero at 4095), valid below 8192; unlike the edges, the radar does not pass it through atan here. Positive left. Equals the midpoint of the two edge fields on 97-99.9% of observations, so it is the same quantity as the edges: a tangent. The earlier 2^-12 rad per count, zero 4096, was 2.4% small.";
CM_ SG_ 108 AZIMUTH_EDGE_A_RAW "Left angular edge; same encoding as AZIMUTH_CENTER. The radar firmware passes it through atan, so it is the tangent of the angle: tan +-1.024 is about +-45.7 deg. Always at or left of the center. Clips at 8191.";
CM_ SG_ 108 FIELD_437_RAW "Radar firmware: raw, valid below 5. Shares: 1 55.5%, 2 9.3%, 3 35.0%, 4 0.3%. Meaning unknown.";
CM_ SG_ 108 AZIMUTH_EDGE_B_RAW "Right angular edge; same encoding as AZIMUTH_CENTER, passed through atan by the radar firmware (a tangent). Clips at 0 for near objects at the field-of-view edge. The edge difference is the Bosch A ANGULAR_WIDTH counterpart: it scales as 1/range within a track (log-log slope -0.91 to -0.99, ten recordings).";
CM_ SG_ 108 MOTION_CLASS_CANDIDATE_RAW "Radar firmware: bits 465-467, raw, valid below 5 (bit 464 is unused and never set). Values 0 78.6%, 1 4.0%, 2 17.4% (read as 0, 2, 4 before 2026-10-02). 2: same-direction traffic, and most objects seen only while ego is stopped. 1: oncoming or approaching, and most stationary objects seen while ego moves. 0: unassigned; young tracks, and every object on the 2026-09-10 and 2026-09-16 drives. Not a validated classifier.";
CM_ SG_ 108 ANGULAR_WIDTH_COARSE_CANDIDATE_RAW "Radar firmware: 0.0002*raw, no range check; stored next to AZIMUTH_EDGE_A. Angular extent measure, about 1/range within a track. Not a fixed-scale copy of the edge width (forward vs inverse fits 6-21 vs 14-24 edge counts per unit). Not received power.";
CM_ SG_ 108 ANGULAR_WIDTH_480_RAW "Angular-width measure (accepted 2026-09-29 on held-out routes): follows the azimuth-edge width (Spearman >= 0.8) and scales as about 1/range within tracks on 57 of 60 routes. Radar firmware: 0.0002*raw, no range check; stored next to AUX2_378. 0 while AUX2_378 holds its default.";
CM_ SG_ 108 ANGULAR_WIDTH_COARSE_COPY_CANDIDATE_RAW "Radar firmware: 0.0002*raw, no range check; stored next to AZIMUTH_EDGE_B. Byte 61 equals byte 59 on 99.7-100% of observations.";
BA_ "VFrameFormat" BO_ 110 14;
CM_ SG_ 110 CRC16_RAW "Capture-verified CRC16: polynomial 0x1021, init 0xFFFF, no reflection or xorout; bytes 2:64 then little-endian data ID 0x0fb1. The radar firmware's E2E receive configuration holds data IDs 0x0FAB-0x0FBA.";
CM_ SG_ 110 OBJECT_ID_RAW "Bits 32-39 (radar firmware; 40-47 are unused and never set). Observed 0 empty, 1 through 63 active. IDs move between wire slots and are reused.";
CM_ SG_ 110 LIFECYCLE_RAW "Observed +3 modulo 4096 per consecutive sweep for continuing IDs. Resets or discontinuities require a new track. Not read by the radar firmware.";
CM_ SG_ 110 FRAME_PHASE_RAW "Radar firmware: raw, valid below 16.";
CM_ SG_ 110 POSITION_X_RAW "Radar firmware: 0.05*raw m, valid below 4096, no offset (in the sender's frame). Unsigned 12-bit, bits 48-59; bit 60 belongs to OBJECT_CLASS_RAW. Working decode dRel = 0.05*raw-4.296 m (accepted): the -4.296 m is our measured offset to the bumper reference, not part of the encoding. The stock dash draws HUD_OBJECTS LONG_DIST from raw/4. Normalized closing and azimuth both imply a sensor range origin about 2.3 m behind the dRel origin, which fits the windshield camera that sends this bank.";
CM_ SG_ 110 OBJECT_CLASS_RAW "Object class, bits 60-63. Radar firmware: raw, valid below 16; it names no values. 1 car and 3 truck/large vehicle: accepted against the stock dash HUD_OBJECTS icons on held-out routes (99.6% and 99.2%). 6, 7 and 8 are not motorcycle, pedestrian and bicycle as such: against video within 25 m they name that object on 1 of 11, 3 of 13 and 3 of 12 clear labels, and are most often a car (2026-09-29). The stock dash shows icon 6 for moving two-wheelers, so its motorcycle icon adds a filter on top of class 6. 9-11 unconfirmed. Classes 1 and 3 never share a track with classes 6-11.";
CM_ SG_ 110 POSITION_Y_RAW "Lateral position, 14-bit offset binary, positive left. Radar firmware: 0.01*raw-81.91 m, zero at 8191 (also its initial value), valid below 16384. Until 2026-10-02 production used zero 8192 (1 cm right). The 0.01 m scale and 14-bit extent were accepted on held-out routes before the firmware confirmed them. A 13-bit read wraps past +-40.95 m.";
CM_ SG_ 110 LIFE_STATE_CANDIDATE_RAW "Radar firmware: a separate 2-bit field, raw, valid below 4. Life state 0 newborn, 1 established, 2 ending (2 on 6-26% of a track last three frames vs 0.1-4% mid-life, ten recordings). Shares: 0 9.6%, 1 88.1%, 2 2.3%; 3 never seen.";
CM_ SG_ 110 VELOCITY_RAW "Relative velocity. Radar firmware: 0.1*raw-154.0 m/s, zero at 1540 (also its initial value), valid below 2048; the MY22 firmware (A070) reads it the same way. Production used zero 1539 (+0.1 m/s) until 2026-10-02. Stationary objects read about -0.3 m/s against vEgo with 1539 and -0.4 m/s with 1540, which points at the wheel-speed reference rather than the encoding. Raw 0 (-154 m/s) is a floor saturation on newborn far objects, not a sentinel.";
CM_ SG_ 110 LATERAL_VELOCITY_RAW "Lateral velocity, positive left, relative in the sensor frame (includes the apparent motion of stationary objects from ego yaw). Radar firmware: 0.1*raw-51.1 m/s, zero at 511 (also its initial value), valid below 1024. Accepted 2026-10-02: the research decode 0.1*(raw-511) was provisional only because one held-out scale bracket (0.1004-0.1085) missed 0.1; the firmware settles the scale.";
CM_ SG_ 110 ENUM_106_CANDIDATE_RAW "Radar firmware: one 3-bit field, raw, valid below 5 (formerly read as flags at bits 106 and 107). Shares: 0 14.6%, 1 83.8%, 2 1.0%, 3 0.7%, 4 under 0.1%. Bit 106 (odd values) is set on about 40% of newborn frames and 97-99% after 1 s and agrees with LIFE_STATE 1 on 96%; bit 107 (values 2-3) is mostly on mature same-direction movers. Meaning unresolved.";
CM_ SG_ 110 ENUM_109_CANDIDATE_RAW "Not read by the radar firmware. Values 0-4. 1 on most established tracks; 2-4 mostly on same-direction movers near the path with high existence. Not an object class (metric width about 1.7 m for all values) and not a left/right lane code. Meaning unresolved.";
CM_ SG_ 110 EXISTENCE_PROBABILITY_RAW "Bosch A OBJECT_EXISTENCE_PROBABILITY counterpart (accepted). Radar firmware: 2*raw percent, valid below 51 (100%); observed 0-49, 49 most common. Best survival predictor within range x age strata on ten recordings (AUC 0.67-0.92); falls over the last second before track death; low on short-lived ghosts. 0 marks a degraded measurement (accepted on held-out routes: range innovation and vRel steps at least 2x worse on 17 of 17).";
CM_ SG_ 110 NORMALIZED_RATE_RAW "Bosch A NORMALIZED_CLOSING counterpart. Radar firmware: 0.001*raw-40 (1/s), valid below 65001. Accepted 2026-10-02: the research decode 0.001*(raw-40000) 1/s matches the firmware exactly; approximately vRel/(dRel+2.3 m) and follows Doppler vRel, not range change. 64999 marks invalid in the data (TTC 0, TTC sigma 0 and normalized-closing sigma 0 in the same frame), though the firmware getter accepts it.";
CM_ SG_ 110 QUALITY_CONTAINER_RAW "Bits 144-153 (radar firmware; 154-159 are unused and never set). Radar firmware: 0.05*raw, valid below 1024; the 0.05 step equals the range resolution. Bosch A RANGE_SIGMA candidate (provisional): range-noise specific on 8 of 10 recordings, weak (partial rho 0.08-0.25). Strongly range dependent. Unit unnamed.";
CM_ SG_ 110 REL_VELOCITY_UNCERTAINTY_RAW "Bosch A REL_VELOCITY_UNCERTAINTY counterpart (accepted, raw units): velocity-noise specific and monotonic with empirical vRel noise on ten recordings. Radar firmware: 0.1*raw, valid below 1024, unit unnamed. Nonlinear against our measured vRel noise (the adapter maps it empirically).";
CM_ SG_ 110 UNCERTAINTY_160_CANDIDATE_RAW "Radar firmware: 10 bits, 0.02*raw, valid below 1024. Mostly 1-2; higher on young and laterally offset objects. Weak noise association. Unit unnamed.";
CM_ SG_ 110 ACQUISITION_186_CANDIDATE_RAW "Radar firmware: 6 bits, 0.01*raw, valid below 64. Starts near 23 on newborn tracks and decays to about 2. Carries little information beyond track age.";
CM_ SG_ 110 UNCERTAINTY_192_CANDIDATE_RAW "Radar firmware: 9 bits, 0.1*raw, valid below 512. Decays with age; mixed velocity and lateral noise association, not specific to one noise. Unit unnamed.";
CM_ SG_ 110 TTC_RAW "Time to collision (accepted 2026-09-28 on held-out routes), (raw-1024)/128 s: a constant-velocity TTC, equal to -1/normalized closing within 0.06-0.10 s median. Reported only while an acceleration-aware collision prediction expects impact (lagging it by about 1-2 s); otherwise 2046. 0 = invalid (normalized closing 64999). Not read by the radar firmware, so the scale rests on captures. No Bosch A counterpart.";
CM_ SG_ 110 OBJECT_LENGTH_CANDIDATE_RAW "Object length, provisional (docs/object-length-217.md). Radar firmware: 0.05*raw m, valid below 512. Median 4.25 m for class 1 and 8.7-8.9 m for class 3; 0 for classes 6-8 on 92%; stable within a track (per-track std 0.09 m). A coarse estimate near a per-class default: a 4.8 m Mustang read 4.25 m. Held-out round 2026-10-02: L1, L3, L4 pass, L2 fails (class 3 is under 1.6x class 1 on 8 of 39 routes, where class 3 reads 3.6-6.6 m). X does not refer to the object center: no length term is needed in dRel.";
CM_ SG_ 110 FIELD_226_RAW "Radar firmware: 0.01*raw-1.57, valid below 316 (+-1.57, so likely an angle in rad); initial value 157 (0). Near 0 on moving objects (p5-p95 about +-0.15), spread over +-1.5 on stationary ones. Not the heading from motion: r -0.19 to +0.07 with the sign varying by route (docs/object-length-217.md). Meaning unknown.";
CM_ SG_ 110 TTC_SIGMA_CANDIDATE_RAW "TTC uncertainty (provisional): raw = TTC^2 * NORMALIZED_CLOSING_SIGMA / 64 within 0.1-2.5% on ten recordings. 127 = saturated or not populated; 0 = invalid. Stays populated on 3-26% of frames where TTC is defaulted (TTC about 8-19 s). Not read by the radar firmware.";
CM_ SG_ 110 FIELD_248_RAW "Not read by the radar firmware. Median raw 172. Meaning unknown.";
CM_ SG_ 110 WIDTH_FINE_258_CANDIDATE_RAW "Radar firmware: 8 bits, 0.0002*raw, no range check; stored next to AZIMUTH_CENTER, like the 0.0002 widths stored next to each edge. Values above 63 on 1.7% of frames. Angular extent measure, about 1/range within a track.";
CM_ SG_ 110 NORMALIZED_CLOSING_SIGMA_RAW "Bosch A NORMALIZED_CLOSING_SIGMA counterpart (accepted): specific to normalized-closing noise and monotonic with it on ten recordings; tied to TTC_SIGMA by a fixed 1/64 ratio. 0 when normalized closing is invalid. Radar firmware: 10 bits, 0.001*raw, valid below 1024, the same step as NORMALIZED_RATE. Values above 511 on 0.6% of frames, which the earlier 9-bit read truncated.";
CM_ SG_ 110 AUX_LATERAL_MOTION_304_CANDIDATE_RAW "Radar firmware: one 17-bit offset-binary field, raw*80/2^17-40, valid below 131072 (formerly read as signed 16 bits at 304 plus a direction bit at 320). Bit 320 is its sign: set on 49.7% of frames, which is why it agreed with the 16-bit value being nonnegative. Its scale (0.00061 per count) is far below the earlier 0.005-0.12 m/s bracket, so it is probably not a lateral speed in m/s; with the firmware decode it does not follow the azimuth rate, dY/dt, lateral velocity or its rate either (r < 0.08; docs/object-length-217.md). About 0 when normalized closing is invalid.";
CM_ SG_ 110 AUX_328_CANDIDATE_RAW "Radar firmware: 14 bits, 0.00002*raw, valid below 12501 (0-0.25). Changes nearly every frame; weak association with lateral and angular noise, not specific to one. 0 when normalized closing is invalid. Meaning unresolved.";
CM_ SG_ 110 FIELD_344_RAW "Radar firmware: 0.002*raw-10, valid below 8001 (+-10). Raw 5000 (0) on 68% of frames. Not acceleration: on lead-like objects its 90th-percentile magnitude is 0.04-0.12 against 0.55-1.83 m/s^2 of lead acceleration, r <= 0.2 (docs/object-length-217.md). Meaning unknown.";
CM_ SG_ 110 FIELD_360_RAW "Not read by the A230 radar firmware; the MY22 firmware (A070) defines 362:6 here instead. Median raw 48. Meaning unknown.";
CM_ SG_ 110 FIELD_368_RAW "Radar firmware: 0.0025*raw, valid below 1024. Raw 1 on 64% of frames. Meaning unknown.";
CM_ SG_ 110 AUX2_378_CANDIDATE_RAW "Radar firmware: same encoding as the azimuth fields, 0.00025*raw-1.02375, valid below 8192 (initial value 4095), and the radar passes it through atan like the edges: a tangent. Not signed 13-bit: with this decode its sign matches the azimuth on 98-99% of populated frames (routes 171, 17b, 19d), against 1-2% for a signed read. Shares one subrecord with ANGULAR_WIDTH_480: both hold their defaults together (8190 here; bits 480-487 zero) on about two thirds of observations. The MY22 firmware has no getter for it.";
CM_ SG_ 110 FIELD_391_RAW "Radar firmware: 0.05*raw, valid below 128. Scales with class: median 0.7 for class 1, 1.5 for class 3, 0 for classes 6-8; constant with age and range. Weakly related to how much OBJECT_LENGTH varies within a track (Spearman 0.19). Meaning unknown.";
CM_ SG_ 110 MATURITY_398_CANDIDATE_RAW "Radar firmware: one 7-bit field; not read. Values above 15 on 9.2% of frames. Counts down from about 6 to 1 as a track matures. Adds no velocity-error or survival information once track age is known.";
CM_ SG_ 110 FIELD_405_RAW "Not read by the radar firmware. Raw 49 on 82% of frames. Meaning unknown.";
CM_ SG_ 110 AZIMUTH_CENTER_RAW "Radar firmware: 0.00025*raw-1.02375 (zero at 4095), valid below 8192; unlike the edges, the radar does not pass it through atan here. Positive left. Equals the midpoint of the two edge fields on 97-99.9% of observations, so it is the same quantity as the edges: a tangent. The earlier 2^-12 rad per count, zero 4096, was 2.4% small.";
CM_ SG_ 110 AZIMUTH_EDGE_A_RAW "Left angular edge; same encoding as AZIMUTH_CENTER. The radar firmware passes it through atan, so it is the tangent of the angle: tan +-1.024 is about +-45.7 deg. Always at or left of the center. Clips at 8191.";
CM_ SG_ 110 FIELD_437_RAW "Radar firmware: raw, valid below 5. Shares: 1 55.5%, 2 9.3%, 3 35.0%, 4 0.3%. Meaning unknown.";
CM_ SG_ 110 AZIMUTH_EDGE_B_RAW "Right angular edge; same encoding as AZIMUTH_CENTER, passed through atan by the radar firmware (a tangent). Clips at 0 for near objects at the field-of-view edge. The edge difference is the Bosch A ANGULAR_WIDTH counterpart: it scales as 1/range within a track (log-log slope -0.91 to -0.99, ten recordings).";
CM_ SG_ 110 MOTION_CLASS_CANDIDATE_RAW "Radar firmware: bits 465-467, raw, valid below 5 (bit 464 is unused and never set). Values 0 78.6%, 1 4.0%, 2 17.4% (read as 0, 2, 4 before 2026-10-02). 2: same-direction traffic, and most objects seen only while ego is stopped. 1: oncoming or approaching, and most stationary objects seen while ego moves. 0: unassigned; young tracks, and every object on the 2026-09-10 and 2026-09-16 drives. Not a validated classifier.";
CM_ SG_ 110 ANGULAR_WIDTH_COARSE_CANDIDATE_RAW "Radar firmware: 0.0002*raw, no range check; stored next to AZIMUTH_EDGE_A. Angular extent measure, about 1/range within a track. Not a fixed-scale copy of the edge width (forward vs inverse fits 6-21 vs 14-24 edge counts per unit). Not received power.";
CM_ SG_ 110 ANGULAR_WIDTH_480_RAW "Angular-width measure (accepted 2026-09-29 on held-out routes): follows the azimuth-edge width (Spearman >= 0.8) and scales as about 1/range within tracks on 57 of 60 routes. Radar firmware: 0.0002*raw, no range check; stored next to AUX2_378. 0 while AUX2_378 holds its default.";
CM_ SG_ 110 ANGULAR_WIDTH_COARSE_COPY_CANDIDATE_RAW "Radar firmware: 0.0002*raw, no range check; stored next to AZIMUTH_EDGE_B. Byte 61 equals byte 59 on 99.7-100% of observations.";
BA_ "VFrameFormat" BO_ 112 14;
CM_ SG_ 112 CRC16_RAW "Capture-verified CRC16: polynomial 0x1021, init 0xFFFF, no reflection or xorout; bytes 2:64 then little-endian data ID 0x0fb2. The radar firmware's E2E receive configuration holds data IDs 0x0FAB-0x0FBA.";
CM_ SG_ 112 OBJECT_ID_RAW "Bits 32-39 (radar firmware; 40-47 are unused and never set). Observed 0 empty, 1 through 63 active. IDs move between wire slots and are reused.";
CM_ SG_ 112 LIFECYCLE_RAW "Observed +3 modulo 4096 per consecutive sweep for continuing IDs. Resets or discontinuities require a new track. Not read by the radar firmware.";
CM_ SG_ 112 FRAME_PHASE_RAW "Radar firmware: raw, valid below 16.";
CM_ SG_ 112 POSITION_X_RAW "Radar firmware: 0.05*raw m, valid below 4096, no offset (in the sender's frame). Unsigned 12-bit, bits 48-59; bit 60 belongs to OBJECT_CLASS_RAW. Working decode dRel = 0.05*raw-4.296 m (accepted): the -4.296 m is our measured offset to the bumper reference, not part of the encoding. The stock dash draws HUD_OBJECTS LONG_DIST from raw/4. Normalized closing and azimuth both imply a sensor range origin about 2.3 m behind the dRel origin, which fits the windshield camera that sends this bank.";
CM_ SG_ 112 OBJECT_CLASS_RAW "Object class, bits 60-63. Radar firmware: raw, valid below 16; it names no values. 1 car and 3 truck/large vehicle: accepted against the stock dash HUD_OBJECTS icons on held-out routes (99.6% and 99.2%). 6, 7 and 8 are not motorcycle, pedestrian and bicycle as such: against video within 25 m they name that object on 1 of 11, 3 of 13 and 3 of 12 clear labels, and are most often a car (2026-09-29). The stock dash shows icon 6 for moving two-wheelers, so its motorcycle icon adds a filter on top of class 6. 9-11 unconfirmed. Classes 1 and 3 never share a track with classes 6-11.";
CM_ SG_ 112 POSITION_Y_RAW "Lateral position, 14-bit offset binary, positive left. Radar firmware: 0.01*raw-81.91 m, zero at 8191 (also its initial value), valid below 16384. Until 2026-10-02 production used zero 8192 (1 cm right). The 0.01 m scale and 14-bit extent were accepted on held-out routes before the firmware confirmed them. A 13-bit read wraps past +-40.95 m.";
CM_ SG_ 112 LIFE_STATE_CANDIDATE_RAW "Radar firmware: a separate 2-bit field, raw, valid below 4. Life state 0 newborn, 1 established, 2 ending (2 on 6-26% of a track last three frames vs 0.1-4% mid-life, ten recordings). Shares: 0 9.6%, 1 88.1%, 2 2.3%; 3 never seen.";
CM_ SG_ 112 VELOCITY_RAW "Relative velocity. Radar firmware: 0.1*raw-154.0 m/s, zero at 1540 (also its initial value), valid below 2048; the MY22 firmware (A070) reads it the same way. Production used zero 1539 (+0.1 m/s) until 2026-10-02. Stationary objects read about -0.3 m/s against vEgo with 1539 and -0.4 m/s with 1540, which points at the wheel-speed reference rather than the encoding. Raw 0 (-154 m/s) is a floor saturation on newborn far objects, not a sentinel.";
CM_ SG_ 112 LATERAL_VELOCITY_RAW "Lateral velocity, positive left, relative in the sensor frame (includes the apparent motion of stationary objects from ego yaw). Radar firmware: 0.1*raw-51.1 m/s, zero at 511 (also its initial value), valid below 1024. Accepted 2026-10-02: the research decode 0.1*(raw-511) was provisional only because one held-out scale bracket (0.1004-0.1085) missed 0.1; the firmware settles the scale.";
CM_ SG_ 112 ENUM_106_CANDIDATE_RAW "Radar firmware: one 3-bit field, raw, valid below 5 (formerly read as flags at bits 106 and 107). Shares: 0 14.6%, 1 83.8%, 2 1.0%, 3 0.7%, 4 under 0.1%. Bit 106 (odd values) is set on about 40% of newborn frames and 97-99% after 1 s and agrees with LIFE_STATE 1 on 96%; bit 107 (values 2-3) is mostly on mature same-direction movers. Meaning unresolved.";
CM_ SG_ 112 ENUM_109_CANDIDATE_RAW "Not read by the radar firmware. Values 0-4. 1 on most established tracks; 2-4 mostly on same-direction movers near the path with high existence. Not an object class (metric width about 1.7 m for all values) and not a left/right lane code. Meaning unresolved.";
CM_ SG_ 112 EXISTENCE_PROBABILITY_RAW "Bosch A OBJECT_EXISTENCE_PROBABILITY counterpart (accepted). Radar firmware: 2*raw percent, valid below 51 (100%); observed 0-49, 49 most common. Best survival predictor within range x age strata on ten recordings (AUC 0.67-0.92); falls over the last second before track death; low on short-lived ghosts. 0 marks a degraded measurement (accepted on held-out routes: range innovation and vRel steps at least 2x worse on 17 of 17).";
CM_ SG_ 112 NORMALIZED_RATE_RAW "Bosch A NORMALIZED_CLOSING counterpart. Radar firmware: 0.001*raw-40 (1/s), valid below 65001. Accepted 2026-10-02: the research decode 0.001*(raw-40000) 1/s matches the firmware exactly; approximately vRel/(dRel+2.3 m) and follows Doppler vRel, not range change. 64999 marks invalid in the data (TTC 0, TTC sigma 0 and normalized-closing sigma 0 in the same frame), though the firmware getter accepts it.";
CM_ SG_ 112 QUALITY_CONTAINER_RAW "Bits 144-153 (radar firmware; 154-159 are unused and never set). Radar firmware: 0.05*raw, valid below 1024; the 0.05 step equals the range resolution. Bosch A RANGE_SIGMA candidate (provisional): range-noise specific on 8 of 10 recordings, weak (partial rho 0.08-0.25). Strongly range dependent. Unit unnamed.";
CM_ SG_ 112 REL_VELOCITY_UNCERTAINTY_RAW "Bosch A REL_VELOCITY_UNCERTAINTY counterpart (accepted, raw units): velocity-noise specific and monotonic with empirical vRel noise on ten recordings. Radar firmware: 0.1*raw, valid below 1024, unit unnamed. Nonlinear against our measured vRel noise (the adapter maps it empirically).";
CM_ SG_ 112 UNCERTAINTY_160_CANDIDATE_RAW "Radar firmware: 10 bits, 0.02*raw, valid below 1024. Mostly 1-2; higher on young and laterally offset objects. Weak noise association. Unit unnamed.";
CM_ SG_ 112 ACQUISITION_186_CANDIDATE_RAW "Radar firmware: 6 bits, 0.01*raw, valid below 64. Starts near 23 on newborn tracks and decays to about 2. Carries little information beyond track age.";
CM_ SG_ 112 UNCERTAINTY_192_CANDIDATE_RAW "Radar firmware: 9 bits, 0.1*raw, valid below 512. Decays with age; mixed velocity and lateral noise association, not specific to one noise. Unit unnamed.";
CM_ SG_ 112 TTC_RAW "Time to collision (accepted 2026-09-28 on held-out routes), (raw-1024)/128 s: a constant-velocity TTC, equal to -1/normalized closing within 0.06-0.10 s median. Reported only while an acceleration-aware collision prediction expects impact (lagging it by about 1-2 s); otherwise 2046. 0 = invalid (normalized closing 64999). Not read by the radar firmware, so the scale rests on captures. No Bosch A counterpart.";
CM_ SG_ 112 OBJECT_LENGTH_CANDIDATE_RAW "Object length, provisional (docs/object-length-217.md). Radar firmware: 0.05*raw m, valid below 512. Median 4.25 m for class 1 and 8.7-8.9 m for class 3; 0 for classes 6-8 on 92%; stable within a track (per-track std 0.09 m). A coarse estimate near a per-class default: a 4.8 m Mustang read 4.25 m. Held-out round 2026-10-02: L1, L3, L4 pass, L2 fails (class 3 is under 1.6x class 1 on 8 of 39 routes, where class 3 reads 3.6-6.6 m). X does not refer to the object center: no length term is needed in dRel.";
CM_ SG_ 112 FIELD_226_RAW "Radar firmware: 0.01*raw-1.57, valid below 316 (+-1.57, so likely an angle in rad); initial value 157 (0). Near 0 on moving objects (p5-p95 about +-0.15), spread over +-1.5 on stationary ones. Not the heading from motion: r -0.19 to +0.07 with the sign varying by route (docs/object-length-217.md). Meaning unknown.";
CM_ SG_ 112 TTC_SIGMA_CANDIDATE_RAW "TTC uncertainty (provisional): raw = TTC^2 * NORMALIZED_CLOSING_SIGMA / 64 within 0.1-2.5% on ten recordings. 127 = saturated or not populated; 0 = invalid. Stays populated on 3-26% of frames where TTC is defaulted (TTC about 8-19 s). Not read by the radar firmware.";
CM_ SG_ 112 FIELD_248_RAW "Not read by the radar firmware. Median raw 172. Meaning unknown.";
CM_ SG_ 112 WIDTH_FINE_258_CANDIDATE_RAW "Radar firmware: 8 bits, 0.0002*raw, no range check; stored next to AZIMUTH_CENTER, like the 0.0002 widths stored next to each edge. Values above 63 on 1.7% of frames. Angular extent measure, about 1/range within a track.";
CM_ SG_ 112 NORMALIZED_CLOSING_SIGMA_RAW "Bosch A NORMALIZED_CLOSING_SIGMA counterpart (accepted): specific to normalized-closing noise and monotonic with it on ten recordings; tied to TTC_SIGMA by a fixed 1/64 ratio. 0 when normalized closing is invalid. Radar firmware: 10 bits, 0.001*raw, valid below 1024, the same step as NORMALIZED_RATE. Values above 511 on 0.6% of frames, which the earlier 9-bit read truncated.";
CM_ SG_ 112 AUX_LATERAL_MOTION_304_CANDIDATE_RAW "Radar firmware: one 17-bit offset-binary field, raw*80/2^17-40, valid below 131072 (formerly read as signed 16 bits at 304 plus a direction bit at 320). Bit 320 is its sign: set on 49.7% of frames, which is why it agreed with the 16-bit value being nonnegative. Its scale (0.00061 per count) is far below the earlier 0.005-0.12 m/s bracket, so it is probably not a lateral speed in m/s; with the firmware decode it does not follow the azimuth rate, dY/dt, lateral velocity or its rate either (r < 0.08; docs/object-length-217.md). About 0 when normalized closing is invalid.";
CM_ SG_ 112 AUX_328_CANDIDATE_RAW "Radar firmware: 14 bits, 0.00002*raw, valid below 12501 (0-0.25). Changes nearly every frame; weak association with lateral and angular noise, not specific to one. 0 when normalized closing is invalid. Meaning unresolved.";
CM_ SG_ 112 FIELD_344_RAW "Radar firmware: 0.002*raw-10, valid below 8001 (+-10). Raw 5000 (0) on 68% of frames. Not acceleration: on lead-like objects its 90th-percentile magnitude is 0.04-0.12 against 0.55-1.83 m/s^2 of lead acceleration, r <= 0.2 (docs/object-length-217.md). Meaning unknown.";
CM_ SG_ 112 FIELD_360_RAW "Not read by the A230 radar firmware; the MY22 firmware (A070) defines 362:6 here instead. Median raw 48. Meaning unknown.";
CM_ SG_ 112 FIELD_368_RAW "Radar firmware: 0.0025*raw, valid below 1024. Raw 1 on 64% of frames. Meaning unknown.";
CM_ SG_ 112 AUX2_378_CANDIDATE_RAW "Radar firmware: same encoding as the azimuth fields, 0.00025*raw-1.02375, valid below 8192 (initial value 4095), and the radar passes it through atan like the edges: a tangent. Not signed 13-bit: with this decode its sign matches the azimuth on 98-99% of populated frames (routes 171, 17b, 19d), against 1-2% for a signed read. Shares one subrecord with ANGULAR_WIDTH_480: both hold their defaults together (8190 here; bits 480-487 zero) on about two thirds of observations. The MY22 firmware has no getter for it.";
CM_ SG_ 112 FIELD_391_RAW "Radar firmware: 0.05*raw, valid below 128. Scales with class: median 0.7 for class 1, 1.5 for class 3, 0 for classes 6-8; constant with age and range. Weakly related to how much OBJECT_LENGTH varies within a track (Spearman 0.19). Meaning unknown.";
CM_ SG_ 112 MATURITY_398_CANDIDATE_RAW "Radar firmware: one 7-bit field; not read. Values above 15 on 9.2% of frames. Counts down from about 6 to 1 as a track matures. Adds no velocity-error or survival information once track age is known.";
CM_ SG_ 112 FIELD_405_RAW "Not read by the radar firmware. Raw 49 on 82% of frames. Meaning unknown.";
CM_ SG_ 112 AZIMUTH_CENTER_RAW "Radar firmware: 0.00025*raw-1.02375 (zero at 4095), valid below 8192; unlike the edges, the radar does not pass it through atan here. Positive left. Equals the midpoint of the two edge fields on 97-99.9% of observations, so it is the same quantity as the edges: a tangent. The earlier 2^-12 rad per count, zero 4096, was 2.4% small.";
CM_ SG_ 112 AZIMUTH_EDGE_A_RAW "Left angular edge; same encoding as AZIMUTH_CENTER. The radar firmware passes it through atan, so it is the tangent of the angle: tan +-1.024 is about +-45.7 deg. Always at or left of the center. Clips at 8191.";
CM_ SG_ 112 FIELD_437_RAW "Radar firmware: raw, valid below 5. Shares: 1 55.5%, 2 9.3%, 3 35.0%, 4 0.3%. Meaning unknown.";
CM_ SG_ 112 AZIMUTH_EDGE_B_RAW "Right angular edge; same encoding as AZIMUTH_CENTER, passed through atan by the radar firmware (a tangent). Clips at 0 for near objects at the field-of-view edge. The edge difference is the Bosch A ANGULAR_WIDTH counterpart: it scales as 1/range within a track (log-log slope -0.91 to -0.99, ten recordings).";
CM_ SG_ 112 MOTION_CLASS_CANDIDATE_RAW "Radar firmware: bits 465-467, raw, valid below 5 (bit 464 is unused and never set). Values 0 78.6%, 1 4.0%, 2 17.4% (read as 0, 2, 4 before 2026-10-02). 2: same-direction traffic, and most objects seen only while ego is stopped. 1: oncoming or approaching, and most stationary objects seen while ego moves. 0: unassigned; young tracks, and every object on the 2026-09-10 and 2026-09-16 drives. Not a validated classifier.";
CM_ SG_ 112 ANGULAR_WIDTH_COARSE_CANDIDATE_RAW "Radar firmware: 0.0002*raw, no range check; stored next to AZIMUTH_EDGE_A. Angular extent measure, about 1/range within a track. Not a fixed-scale copy of the edge width (forward vs inverse fits 6-21 vs 14-24 edge counts per unit). Not received power.";
CM_ SG_ 112 ANGULAR_WIDTH_480_RAW "Angular-width measure (accepted 2026-09-29 on held-out routes): follows the azimuth-edge width (Spearman >= 0.8) and scales as about 1/range within tracks on 57 of 60 routes. Radar firmware: 0.0002*raw, no range check; stored next to AUX2_378. 0 while AUX2_378 holds its default.";
CM_ SG_ 112 ANGULAR_WIDTH_COARSE_COPY_CANDIDATE_RAW "Radar firmware: 0.0002*raw, no range check; stored next to AZIMUTH_EDGE_B. Byte 61 equals byte 59 on 99.7-100% of observations.";
CM_ SG_ 98 DREL "Accepted: 0.05*raw-4.296 m. The scale is the radar firmware's; the -4.296 m offset is ours, aligning to the HUD lead position (the firmware reads range with no offset, and the sensor origin is about 2.3 m further back).";
CM_ SG_ 98 YREL "Radar firmware decode: 0.01*raw-81.91 m (zero at 8191), 14-bit offset binary at bits 64-77, positive left.";
CM_ SG_ 98 VREL "Radar firmware decode: 0.1*raw-154.0 m/s (zero at 1540). Raw 0 (-154 m/s) is a saturation on newborn far objects.";
CM_ SG_ 98 LATERAL_VELOCITY "Radar firmware decode: 0.1*raw-51.1 m/s (zero at 511), positive left, relative in the sensor frame.";
CM_ SG_ 98 EXISTENCE_PROBABILITY "Radar firmware decode: 2*raw percent; the firmware rejects raw 51 and above. Observed 0-98%.";
CM_ SG_ 98 NORMALIZED_RATE "Radar firmware decode: 0.001*raw-40 (1/s), about vRel/(dRel+2.3 m). Raw 64999 marks invalid in the data.";
CM_ SG_ 98 AZIMUTH_CENTER "Radar firmware decode: 0.00025*raw-1.02375 (zero at 4095), positive left. A tangent (lateral over longitudinal): atan gives the angle. The midpoint of the two edges.";
CM_ SG_ 98 AZIMUTH_EDGE_A "Left edge, same decode as AZIMUTH_CENTER; the radar firmware applies atan to get the angle. Clips at 1.024 (about 45.7 deg).";
CM_ SG_ 98 AZIMUTH_EDGE_B "Right edge, same decode as AZIMUTH_CENTER; the radar firmware applies atan to get the angle. Clips at -1.024.";
CM_ SG_ 98 TTC "Accepted from captures: (raw-1024)/128 s constant-velocity TTC; the radar firmware never reads this field. Raw 2046 (7.98 s) = not reported, raw 0 = invalid; see TTC_RAW.";
CM_ SG_ 100 DREL "Accepted: 0.05*raw-4.296 m. The scale is the radar firmware's; the -4.296 m offset is ours, aligning to the HUD lead position (the firmware reads range with no offset, and the sensor origin is about 2.3 m further back).";
CM_ SG_ 100 YREL "Radar firmware decode: 0.01*raw-81.91 m (zero at 8191), 14-bit offset binary at bits 64-77, positive left.";
CM_ SG_ 100 VREL "Radar firmware decode: 0.1*raw-154.0 m/s (zero at 1540). Raw 0 (-154 m/s) is a saturation on newborn far objects.";
CM_ SG_ 100 LATERAL_VELOCITY "Radar firmware decode: 0.1*raw-51.1 m/s (zero at 511), positive left, relative in the sensor frame.";
CM_ SG_ 100 EXISTENCE_PROBABILITY "Radar firmware decode: 2*raw percent; the firmware rejects raw 51 and above. Observed 0-98%.";
CM_ SG_ 100 NORMALIZED_RATE "Radar firmware decode: 0.001*raw-40 (1/s), about vRel/(dRel+2.3 m). Raw 64999 marks invalid in the data.";
CM_ SG_ 100 AZIMUTH_CENTER "Radar firmware decode: 0.00025*raw-1.02375 (zero at 4095), positive left. A tangent (lateral over longitudinal): atan gives the angle. The midpoint of the two edges.";
CM_ SG_ 100 AZIMUTH_EDGE_A "Left edge, same decode as AZIMUTH_CENTER; the radar firmware applies atan to get the angle. Clips at 1.024 (about 45.7 deg).";
CM_ SG_ 100 AZIMUTH_EDGE_B "Right edge, same decode as AZIMUTH_CENTER; the radar firmware applies atan to get the angle. Clips at -1.024.";
CM_ SG_ 100 TTC "Accepted from captures: (raw-1024)/128 s constant-velocity TTC; the radar firmware never reads this field. Raw 2046 (7.98 s) = not reported, raw 0 = invalid; see TTC_RAW.";
CM_ SG_ 102 DREL "Accepted: 0.05*raw-4.296 m. The scale is the radar firmware's; the -4.296 m offset is ours, aligning to the HUD lead position (the firmware reads range with no offset, and the sensor origin is about 2.3 m further back).";
CM_ SG_ 102 YREL "Radar firmware decode: 0.01*raw-81.91 m (zero at 8191), 14-bit offset binary at bits 64-77, positive left.";
CM_ SG_ 102 VREL "Radar firmware decode: 0.1*raw-154.0 m/s (zero at 1540). Raw 0 (-154 m/s) is a saturation on newborn far objects.";
CM_ SG_ 102 LATERAL_VELOCITY "Radar firmware decode: 0.1*raw-51.1 m/s (zero at 511), positive left, relative in the sensor frame.";
CM_ SG_ 102 EXISTENCE_PROBABILITY "Radar firmware decode: 2*raw percent; the firmware rejects raw 51 and above. Observed 0-98%.";
CM_ SG_ 102 NORMALIZED_RATE "Radar firmware decode: 0.001*raw-40 (1/s), about vRel/(dRel+2.3 m). Raw 64999 marks invalid in the data.";
CM_ SG_ 102 AZIMUTH_CENTER "Radar firmware decode: 0.00025*raw-1.02375 (zero at 4095), positive left. A tangent (lateral over longitudinal): atan gives the angle. The midpoint of the two edges.";
CM_ SG_ 102 AZIMUTH_EDGE_A "Left edge, same decode as AZIMUTH_CENTER; the radar firmware applies atan to get the angle. Clips at 1.024 (about 45.7 deg).";
CM_ SG_ 102 AZIMUTH_EDGE_B "Right edge, same decode as AZIMUTH_CENTER; the radar firmware applies atan to get the angle. Clips at -1.024.";
CM_ SG_ 102 TTC "Accepted from captures: (raw-1024)/128 s constant-velocity TTC; the radar firmware never reads this field. Raw 2046 (7.98 s) = not reported, raw 0 = invalid; see TTC_RAW.";
CM_ SG_ 104 DREL "Accepted: 0.05*raw-4.296 m. The scale is the radar firmware's; the -4.296 m offset is ours, aligning to the HUD lead position (the firmware reads range with no offset, and the sensor origin is about 2.3 m further back).";
CM_ SG_ 104 YREL "Radar firmware decode: 0.01*raw-81.91 m (zero at 8191), 14-bit offset binary at bits 64-77, positive left.";
CM_ SG_ 104 VREL "Radar firmware decode: 0.1*raw-154.0 m/s (zero at 1540). Raw 0 (-154 m/s) is a saturation on newborn far objects.";
CM_ SG_ 104 LATERAL_VELOCITY "Radar firmware decode: 0.1*raw-51.1 m/s (zero at 511), positive left, relative in the sensor frame.";
CM_ SG_ 104 EXISTENCE_PROBABILITY "Radar firmware decode: 2*raw percent; the firmware rejects raw 51 and above. Observed 0-98%.";
CM_ SG_ 104 NORMALIZED_RATE "Radar firmware decode: 0.001*raw-40 (1/s), about vRel/(dRel+2.3 m). Raw 64999 marks invalid in the data.";
CM_ SG_ 104 AZIMUTH_CENTER "Radar firmware decode: 0.00025*raw-1.02375 (zero at 4095), positive left. A tangent (lateral over longitudinal): atan gives the angle. The midpoint of the two edges.";
CM_ SG_ 104 AZIMUTH_EDGE_A "Left edge, same decode as AZIMUTH_CENTER; the radar firmware applies atan to get the angle. Clips at 1.024 (about 45.7 deg).";
CM_ SG_ 104 AZIMUTH_EDGE_B "Right edge, same decode as AZIMUTH_CENTER; the radar firmware applies atan to get the angle. Clips at -1.024.";
CM_ SG_ 104 TTC "Accepted from captures: (raw-1024)/128 s constant-velocity TTC; the radar firmware never reads this field. Raw 2046 (7.98 s) = not reported, raw 0 = invalid; see TTC_RAW.";
CM_ SG_ 106 DREL "Accepted: 0.05*raw-4.296 m. The scale is the radar firmware's; the -4.296 m offset is ours, aligning to the HUD lead position (the firmware reads range with no offset, and the sensor origin is about 2.3 m further back).";
CM_ SG_ 106 YREL "Radar firmware decode: 0.01*raw-81.91 m (zero at 8191), 14-bit offset binary at bits 64-77, positive left.";
CM_ SG_ 106 VREL "Radar firmware decode: 0.1*raw-154.0 m/s (zero at 1540). Raw 0 (-154 m/s) is a saturation on newborn far objects.";
CM_ SG_ 106 LATERAL_VELOCITY "Radar firmware decode: 0.1*raw-51.1 m/s (zero at 511), positive left, relative in the sensor frame.";
CM_ SG_ 106 EXISTENCE_PROBABILITY "Radar firmware decode: 2*raw percent; the firmware rejects raw 51 and above. Observed 0-98%.";
CM_ SG_ 106 NORMALIZED_RATE "Radar firmware decode: 0.001*raw-40 (1/s), about vRel/(dRel+2.3 m). Raw 64999 marks invalid in the data.";
CM_ SG_ 106 AZIMUTH_CENTER "Radar firmware decode: 0.00025*raw-1.02375 (zero at 4095), positive left. A tangent (lateral over longitudinal): atan gives the angle. The midpoint of the two edges.";
CM_ SG_ 106 AZIMUTH_EDGE_A "Left edge, same decode as AZIMUTH_CENTER; the radar firmware applies atan to get the angle. Clips at 1.024 (about 45.7 deg).";
CM_ SG_ 106 AZIMUTH_EDGE_B "Right edge, same decode as AZIMUTH_CENTER; the radar firmware applies atan to get the angle. Clips at -1.024.";
CM_ SG_ 106 TTC "Accepted from captures: (raw-1024)/128 s constant-velocity TTC; the radar firmware never reads this field. Raw 2046 (7.98 s) = not reported, raw 0 = invalid; see TTC_RAW.";
CM_ SG_ 108 DREL "Accepted: 0.05*raw-4.296 m. The scale is the radar firmware's; the -4.296 m offset is ours, aligning to the HUD lead position (the firmware reads range with no offset, and the sensor origin is about 2.3 m further back).";
CM_ SG_ 108 YREL "Radar firmware decode: 0.01*raw-81.91 m (zero at 8191), 14-bit offset binary at bits 64-77, positive left.";
CM_ SG_ 108 VREL "Radar firmware decode: 0.1*raw-154.0 m/s (zero at 1540). Raw 0 (-154 m/s) is a saturation on newborn far objects.";
CM_ SG_ 108 LATERAL_VELOCITY "Radar firmware decode: 0.1*raw-51.1 m/s (zero at 511), positive left, relative in the sensor frame.";
CM_ SG_ 108 EXISTENCE_PROBABILITY "Radar firmware decode: 2*raw percent; the firmware rejects raw 51 and above. Observed 0-98%.";
CM_ SG_ 108 NORMALIZED_RATE "Radar firmware decode: 0.001*raw-40 (1/s), about vRel/(dRel+2.3 m). Raw 64999 marks invalid in the data.";
CM_ SG_ 108 AZIMUTH_CENTER "Radar firmware decode: 0.00025*raw-1.02375 (zero at 4095), positive left. A tangent (lateral over longitudinal): atan gives the angle. The midpoint of the two edges.";
CM_ SG_ 108 AZIMUTH_EDGE_A "Left edge, same decode as AZIMUTH_CENTER; the radar firmware applies atan to get the angle. Clips at 1.024 (about 45.7 deg).";
CM_ SG_ 108 AZIMUTH_EDGE_B "Right edge, same decode as AZIMUTH_CENTER; the radar firmware applies atan to get the angle. Clips at -1.024.";
CM_ SG_ 108 TTC "Accepted from captures: (raw-1024)/128 s constant-velocity TTC; the radar firmware never reads this field. Raw 2046 (7.98 s) = not reported, raw 0 = invalid; see TTC_RAW.";
CM_ SG_ 110 DREL "Accepted: 0.05*raw-4.296 m. The scale is the radar firmware's; the -4.296 m offset is ours, aligning to the HUD lead position (the firmware reads range with no offset, and the sensor origin is about 2.3 m further back).";
CM_ SG_ 110 YREL "Radar firmware decode: 0.01*raw-81.91 m (zero at 8191), 14-bit offset binary at bits 64-77, positive left.";
CM_ SG_ 110 VREL "Radar firmware decode: 0.1*raw-154.0 m/s (zero at 1540). Raw 0 (-154 m/s) is a saturation on newborn far objects.";
CM_ SG_ 110 LATERAL_VELOCITY "Radar firmware decode: 0.1*raw-51.1 m/s (zero at 511), positive left, relative in the sensor frame.";
CM_ SG_ 110 EXISTENCE_PROBABILITY "Radar firmware decode: 2*raw percent; the firmware rejects raw 51 and above. Observed 0-98%.";
CM_ SG_ 110 NORMALIZED_RATE "Radar firmware decode: 0.001*raw-40 (1/s), about vRel/(dRel+2.3 m). Raw 64999 marks invalid in the data.";
CM_ SG_ 110 AZIMUTH_CENTER "Radar firmware decode: 0.00025*raw-1.02375 (zero at 4095), positive left. A tangent (lateral over longitudinal): atan gives the angle. The midpoint of the two edges.";
CM_ SG_ 110 AZIMUTH_EDGE_A "Left edge, same decode as AZIMUTH_CENTER; the radar firmware applies atan to get the angle. Clips at 1.024 (about 45.7 deg).";
CM_ SG_ 110 AZIMUTH_EDGE_B "Right edge, same decode as AZIMUTH_CENTER; the radar firmware applies atan to get the angle. Clips at -1.024.";
CM_ SG_ 110 TTC "Accepted from captures: (raw-1024)/128 s constant-velocity TTC; the radar firmware never reads this field. Raw 2046 (7.98 s) = not reported, raw 0 = invalid; see TTC_RAW.";
CM_ SG_ 112 DREL "Accepted: 0.05*raw-4.296 m. The scale is the radar firmware's; the -4.296 m offset is ours, aligning to the HUD lead position (the firmware reads range with no offset, and the sensor origin is about 2.3 m further back).";
CM_ SG_ 112 YREL "Radar firmware decode: 0.01*raw-81.91 m (zero at 8191), 14-bit offset binary at bits 64-77, positive left.";
CM_ SG_ 112 VREL "Radar firmware decode: 0.1*raw-154.0 m/s (zero at 1540). Raw 0 (-154 m/s) is a saturation on newborn far objects.";
CM_ SG_ 112 LATERAL_VELOCITY "Radar firmware decode: 0.1*raw-51.1 m/s (zero at 511), positive left, relative in the sensor frame.";
CM_ SG_ 112 EXISTENCE_PROBABILITY "Radar firmware decode: 2*raw percent; the firmware rejects raw 51 and above. Observed 0-98%.";
CM_ SG_ 112 NORMALIZED_RATE "Radar firmware decode: 0.001*raw-40 (1/s), about vRel/(dRel+2.3 m). Raw 64999 marks invalid in the data.";
CM_ SG_ 112 AZIMUTH_CENTER "Radar firmware decode: 0.00025*raw-1.02375 (zero at 4095), positive left. A tangent (lateral over longitudinal): atan gives the angle. The midpoint of the two edges.";
CM_ SG_ 112 AZIMUTH_EDGE_A "Left edge, same decode as AZIMUTH_CENTER; the radar firmware applies atan to get the angle. Clips at 1.024 (about 45.7 deg).";
CM_ SG_ 112 AZIMUTH_EDGE_B "Right edge, same decode as AZIMUTH_CENTER; the radar firmware applies atan to get the angle. Clips at -1.024.";
CM_ SG_ 112 TTC "Accepted from captures: (raw-1024)/128 s constant-velocity TTC; the radar firmware never reads this field. Raw 2046 (7.98 s) = not reported, raw 0 = invalid; see TTC_RAW.";
VAL_ 98 OBJECT_CLASS_RAW 3 "TRUCK" 1 "CAR" ;
VAL_ 100 OBJECT_CLASS_RAW 3 "TRUCK" 1 "CAR" ;
VAL_ 102 OBJECT_CLASS_RAW 3 "TRUCK" 1 "CAR" ;
VAL_ 104 OBJECT_CLASS_RAW 3 "TRUCK" 1 "CAR" ;
VAL_ 106 OBJECT_CLASS_RAW 3 "TRUCK" 1 "CAR" ;
VAL_ 108 OBJECT_CLASS_RAW 3 "TRUCK" 1 "CAR" ;
VAL_ 110 OBJECT_CLASS_RAW 3 "TRUCK" 1 "CAR" ;
VAL_ 112 OBJECT_CLASS_RAW 3 "TRUCK" 1 "CAR" ;
